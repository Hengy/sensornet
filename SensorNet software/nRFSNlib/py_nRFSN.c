/* Generated by Cython 0.15.1 on Thu Mar 26 13:34:00 2015 */

#define PY_SSIZE_T_CLEAN
#include "Python.h"
#ifndef Py_PYTHON_H
    #error Python headers needed to compile C extensions, please install development version of Python.
#else

#include <stddef.h> /* For offsetof */
#ifndef offsetof
#define offsetof(type, member) ( (size_t) & ((type*)0) -> member )
#endif

#if !defined(WIN32) && !defined(MS_WINDOWS)
  #ifndef __stdcall
    #define __stdcall
  #endif
  #ifndef __cdecl
    #define __cdecl
  #endif
  #ifndef __fastcall
    #define __fastcall
  #endif
#endif

#ifndef DL_IMPORT
  #define DL_IMPORT(t) t
#endif
#ifndef DL_EXPORT
  #define DL_EXPORT(t) t
#endif

#ifndef PY_LONG_LONG
  #define PY_LONG_LONG LONG_LONG
#endif

#if PY_VERSION_HEX < 0x02040000
  #define METH_COEXIST 0
  #define PyDict_CheckExact(op) (Py_TYPE(op) == &PyDict_Type)
  #define PyDict_Contains(d,o)   PySequence_Contains(d,o)
#endif

#if PY_VERSION_HEX < 0x02050000
  typedef int Py_ssize_t;
  #define PY_SSIZE_T_MAX INT_MAX
  #define PY_SSIZE_T_MIN INT_MIN
  #define PY_FORMAT_SIZE_T ""
  #define PyInt_FromSsize_t(z) PyInt_FromLong(z)
  #define PyInt_AsSsize_t(o)   __Pyx_PyInt_AsInt(o)
  #define PyNumber_Index(o)    PyNumber_Int(o)
  #define PyIndex_Check(o)     PyNumber_Check(o)
  #define PyErr_WarnEx(category, message, stacklevel) PyErr_Warn(category, message)
#endif

#if PY_VERSION_HEX < 0x02060000
  #define Py_REFCNT(ob) (((PyObject*)(ob))->ob_refcnt)
  #define Py_TYPE(ob)   (((PyObject*)(ob))->ob_type)
  #define Py_SIZE(ob)   (((PyVarObject*)(ob))->ob_size)
  #define PyVarObject_HEAD_INIT(type, size) \
          PyObject_HEAD_INIT(type) size,
  #define PyType_Modified(t)

  typedef struct {
     void *buf;
     PyObject *obj;
     Py_ssize_t len;
     Py_ssize_t itemsize;
     int readonly;
     int ndim;
     char *format;
     Py_ssize_t *shape;
     Py_ssize_t *strides;
     Py_ssize_t *suboffsets;
     void *internal;
  } Py_buffer;

  #define PyBUF_SIMPLE 0
  #define PyBUF_WRITABLE 0x0001
  #define PyBUF_FORMAT 0x0004
  #define PyBUF_ND 0x0008
  #define PyBUF_STRIDES (0x0010 | PyBUF_ND)
  #define PyBUF_C_CONTIGUOUS (0x0020 | PyBUF_STRIDES)
  #define PyBUF_F_CONTIGUOUS (0x0040 | PyBUF_STRIDES)
  #define PyBUF_ANY_CONTIGUOUS (0x0080 | PyBUF_STRIDES)
  #define PyBUF_INDIRECT (0x0100 | PyBUF_STRIDES)

#endif

#if PY_MAJOR_VERSION < 3
  #define __Pyx_BUILTIN_MODULE_NAME "__builtin__"
#else
  #define __Pyx_BUILTIN_MODULE_NAME "builtins"
#endif

#if PY_MAJOR_VERSION >= 3
  #define Py_TPFLAGS_CHECKTYPES 0
  #define Py_TPFLAGS_HAVE_INDEX 0
#endif

#if (PY_VERSION_HEX < 0x02060000) || (PY_MAJOR_VERSION >= 3)
  #define Py_TPFLAGS_HAVE_NEWBUFFER 0
#endif

#if PY_MAJOR_VERSION >= 3
  #define PyBaseString_Type            PyUnicode_Type
  #define PyStringObject               PyUnicodeObject
  #define PyString_Type                PyUnicode_Type
  #define PyString_Check               PyUnicode_Check
  #define PyString_CheckExact          PyUnicode_CheckExact
#endif

#if PY_VERSION_HEX < 0x02060000
  #define PyBytesObject                PyStringObject
  #define PyBytes_Type                 PyString_Type
  #define PyBytes_Check                PyString_Check
  #define PyBytes_CheckExact           PyString_CheckExact
  #define PyBytes_FromString           PyString_FromString
  #define PyBytes_FromStringAndSize    PyString_FromStringAndSize
  #define PyBytes_FromFormat           PyString_FromFormat
  #define PyBytes_DecodeEscape         PyString_DecodeEscape
  #define PyBytes_AsString             PyString_AsString
  #define PyBytes_AsStringAndSize      PyString_AsStringAndSize
  #define PyBytes_Size                 PyString_Size
  #define PyBytes_AS_STRING            PyString_AS_STRING
  #define PyBytes_GET_SIZE             PyString_GET_SIZE
  #define PyBytes_Repr                 PyString_Repr
  #define PyBytes_Concat               PyString_Concat
  #define PyBytes_ConcatAndDel         PyString_ConcatAndDel
#endif

#if PY_VERSION_HEX < 0x02060000
  #define PySet_Check(obj)             PyObject_TypeCheck(obj, &PySet_Type)
  #define PyFrozenSet_Check(obj)       PyObject_TypeCheck(obj, &PyFrozenSet_Type)
#endif
#ifndef PySet_CheckExact
  #define PySet_CheckExact(obj)        (Py_TYPE(obj) == &PySet_Type)
#endif

#define __Pyx_TypeCheck(obj, type) PyObject_TypeCheck(obj, (PyTypeObject *)type)

#if PY_MAJOR_VERSION >= 3
  #define PyIntObject                  PyLongObject
  #define PyInt_Type                   PyLong_Type
  #define PyInt_Check(op)              PyLong_Check(op)
  #define PyInt_CheckExact(op)         PyLong_CheckExact(op)
  #define PyInt_FromString             PyLong_FromString
  #define PyInt_FromUnicode            PyLong_FromUnicode
  #define PyInt_FromLong               PyLong_FromLong
  #define PyInt_FromSize_t             PyLong_FromSize_t
  #define PyInt_FromSsize_t            PyLong_FromSsize_t
  #define PyInt_AsLong                 PyLong_AsLong
  #define PyInt_AS_LONG                PyLong_AS_LONG
  #define PyInt_AsSsize_t              PyLong_AsSsize_t
  #define PyInt_AsUnsignedLongMask     PyLong_AsUnsignedLongMask
  #define PyInt_AsUnsignedLongLongMask PyLong_AsUnsignedLongLongMask
#endif

#if PY_MAJOR_VERSION >= 3
  #define PyBoolObject                 PyLongObject
#endif

#if PY_VERSION_HEX < 0x03020000
  typedef long Py_hash_t;
  #define __Pyx_PyInt_FromHash_t PyInt_FromLong
  #define __Pyx_PyInt_AsHash_t   PyInt_AsLong
#else
  #define __Pyx_PyInt_FromHash_t PyInt_FromSsize_t
  #define __Pyx_PyInt_AsHash_t   PyInt_AsSsize_t
#endif


#if PY_MAJOR_VERSION >= 3
  #define __Pyx_PyNumber_Divide(x,y)         PyNumber_TrueDivide(x,y)
  #define __Pyx_PyNumber_InPlaceDivide(x,y)  PyNumber_InPlaceTrueDivide(x,y)
#else
  #define __Pyx_PyNumber_Divide(x,y)         PyNumber_Divide(x,y)
  #define __Pyx_PyNumber_InPlaceDivide(x,y)  PyNumber_InPlaceDivide(x,y)
#endif

#if (PY_MAJOR_VERSION < 3) || (PY_VERSION_HEX >= 0x03010300)
  #define __Pyx_PySequence_GetSlice(obj, a, b) PySequence_GetSlice(obj, a, b)
  #define __Pyx_PySequence_SetSlice(obj, a, b, value) PySequence_SetSlice(obj, a, b, value)
  #define __Pyx_PySequence_DelSlice(obj, a, b) PySequence_DelSlice(obj, a, b)
#else
  #define __Pyx_PySequence_GetSlice(obj, a, b) (unlikely(!(obj)) ? \
        (PyErr_SetString(PyExc_SystemError, "null argument to internal routine"), (PyObject*)0) : \
        (likely((obj)->ob_type->tp_as_mapping) ? (PySequence_GetSlice(obj, a, b)) : \
            (PyErr_Format(PyExc_TypeError, "'%.200s' object is unsliceable", (obj)->ob_type->tp_name), (PyObject*)0)))
  #define __Pyx_PySequence_SetSlice(obj, a, b, value) (unlikely(!(obj)) ? \
        (PyErr_SetString(PyExc_SystemError, "null argument to internal routine"), -1) : \
        (likely((obj)->ob_type->tp_as_mapping) ? (PySequence_SetSlice(obj, a, b, value)) : \
            (PyErr_Format(PyExc_TypeError, "'%.200s' object doesn't support slice assignment", (obj)->ob_type->tp_name), -1)))
  #define __Pyx_PySequence_DelSlice(obj, a, b) (unlikely(!(obj)) ? \
        (PyErr_SetString(PyExc_SystemError, "null argument to internal routine"), -1) : \
        (likely((obj)->ob_type->tp_as_mapping) ? (PySequence_DelSlice(obj, a, b)) : \
            (PyErr_Format(PyExc_TypeError, "'%.200s' object doesn't support slice deletion", (obj)->ob_type->tp_name), -1)))
#endif

#if PY_MAJOR_VERSION >= 3
  #define PyMethod_New(func, self, klass) ((self) ? PyMethod_New(func, self) : PyInstanceMethod_New(func))
#endif

#if PY_VERSION_HEX < 0x02050000
  #define __Pyx_GetAttrString(o,n)   PyObject_GetAttrString((o),((char *)(n)))
  #define __Pyx_SetAttrString(o,n,a) PyObject_SetAttrString((o),((char *)(n)),(a))
  #define __Pyx_DelAttrString(o,n)   PyObject_DelAttrString((o),((char *)(n)))
#else
  #define __Pyx_GetAttrString(o,n)   PyObject_GetAttrString((o),(n))
  #define __Pyx_SetAttrString(o,n,a) PyObject_SetAttrString((o),(n),(a))
  #define __Pyx_DelAttrString(o,n)   PyObject_DelAttrString((o),(n))
#endif

#if PY_VERSION_HEX < 0x02050000
  #define __Pyx_NAMESTR(n) ((char *)(n))
  #define __Pyx_DOCSTR(n)  ((char *)(n))
#else
  #define __Pyx_NAMESTR(n) (n)
  #define __Pyx_DOCSTR(n)  (n)
#endif

#ifndef __PYX_EXTERN_C
  #ifdef __cplusplus
    #define __PYX_EXTERN_C extern "C"
  #else
    #define __PYX_EXTERN_C extern
  #endif
#endif

#if defined(WIN32) || defined(MS_WINDOWS)
#define _USE_MATH_DEFINES
#endif
#include <math.h>
#define __PYX_HAVE__py_nRFSN
#define __PYX_HAVE_API__py_nRFSN
#include "nRFSN.h"
#include "stdlib.h"
#ifdef _OPENMP
#include <omp.h>
#endif /* _OPENMP */

#ifdef PYREX_WITHOUT_ASSERTIONS
#define CYTHON_WITHOUT_ASSERTIONS
#endif


/* inline attribute */
#ifndef CYTHON_INLINE
  #if defined(__GNUC__)
    #define CYTHON_INLINE __inline__
  #elif defined(_MSC_VER)
    #define CYTHON_INLINE __inline
  #elif defined (__STDC_VERSION__) && __STDC_VERSION__ >= 199901L
    #define CYTHON_INLINE inline
  #else
    #define CYTHON_INLINE
  #endif
#endif

/* unused attribute */
#ifndef CYTHON_UNUSED
# if defined(__GNUC__)
#   if !(defined(__cplusplus)) || (__GNUC__ > 3 || (__GNUC__ == 3 && __GNUC_MINOR__ >= 4))
#     define CYTHON_UNUSED __attribute__ ((__unused__))
#   else
#     define CYTHON_UNUSED
#   endif
# elif defined(__ICC) || defined(__INTEL_COMPILER)
#   define CYTHON_UNUSED __attribute__ ((__unused__))
# else
#   define CYTHON_UNUSED
# endif
#endif

typedef struct {PyObject **p; char *s; const long n; const char* encoding; const char is_unicode; const char is_str; const char intern; } __Pyx_StringTabEntry; /*proto*/


/* Type Conversion Predeclarations */

#define __Pyx_PyBytes_FromUString(s) PyBytes_FromString((char*)s)
#define __Pyx_PyBytes_AsUString(s)   ((unsigned char*) PyBytes_AsString(s))

#define __Pyx_Owned_Py_None(b) (Py_INCREF(Py_None), Py_None)
#define __Pyx_PyBool_FromLong(b) ((b) ? (Py_INCREF(Py_True), Py_True) : (Py_INCREF(Py_False), Py_False))
static CYTHON_INLINE int __Pyx_PyObject_IsTrue(PyObject*);
static CYTHON_INLINE PyObject* __Pyx_PyNumber_Int(PyObject* x);

static CYTHON_INLINE Py_ssize_t __Pyx_PyIndex_AsSsize_t(PyObject*);
static CYTHON_INLINE PyObject * __Pyx_PyInt_FromSize_t(size_t);
static CYTHON_INLINE size_t __Pyx_PyInt_AsSize_t(PyObject*);

#define __pyx_PyFloat_AsDouble(x) (PyFloat_CheckExact(x) ? PyFloat_AS_DOUBLE(x) : PyFloat_AsDouble(x))


#ifdef __GNUC__
  /* Test for GCC > 2.95 */
  #if __GNUC__ > 2 || (__GNUC__ == 2 && (__GNUC_MINOR__ > 95))
    #define likely(x)   __builtin_expect(!!(x), 1)
    #define unlikely(x) __builtin_expect(!!(x), 0)
  #else /* __GNUC__ > 2 ... */
    #define likely(x)   (x)
    #define unlikely(x) (x)
  #endif /* __GNUC__ > 2 ... */
#else /* __GNUC__ */
  #define likely(x)   (x)
  #define unlikely(x) (x)
#endif /* __GNUC__ */
    
static PyObject *__pyx_m;
static PyObject *__pyx_b;
static PyObject *__pyx_empty_tuple;
static PyObject *__pyx_empty_bytes;
static int __pyx_lineno;
static int __pyx_clineno = 0;
static const char * __pyx_cfilenm= __FILE__;
static const char *__pyx_filename;


static const char *__pyx_f[] = {
  "py_nRFSN.pyx",
};

/*--- Type declarations ---*/


#ifndef CYTHON_REFNANNY
  #define CYTHON_REFNANNY 0
#endif

#if CYTHON_REFNANNY
  typedef struct {
    void (*INCREF)(void*, PyObject*, int);
    void (*DECREF)(void*, PyObject*, int);
    void (*GOTREF)(void*, PyObject*, int);
    void (*GIVEREF)(void*, PyObject*, int);
    void* (*SetupContext)(const char*, int, const char*);
    void (*FinishContext)(void**);
  } __Pyx_RefNannyAPIStruct;
  static __Pyx_RefNannyAPIStruct *__Pyx_RefNanny = NULL;
  static __Pyx_RefNannyAPIStruct *__Pyx_RefNannyImportAPI(const char *modname); /*proto*/
  #define __Pyx_RefNannyDeclarations void *__pyx_refnanny = NULL;
  #define __Pyx_RefNannySetupContext(name)           __pyx_refnanny = __Pyx_RefNanny->SetupContext((name), __LINE__, __FILE__)
  #define __Pyx_RefNannyFinishContext()           __Pyx_RefNanny->FinishContext(&__pyx_refnanny)
  #define __Pyx_INCREF(r)  __Pyx_RefNanny->INCREF(__pyx_refnanny, (PyObject *)(r), __LINE__)
  #define __Pyx_DECREF(r)  __Pyx_RefNanny->DECREF(__pyx_refnanny, (PyObject *)(r), __LINE__)
  #define __Pyx_GOTREF(r)  __Pyx_RefNanny->GOTREF(__pyx_refnanny, (PyObject *)(r), __LINE__)
  #define __Pyx_GIVEREF(r) __Pyx_RefNanny->GIVEREF(__pyx_refnanny, (PyObject *)(r), __LINE__)
  #define __Pyx_XINCREF(r)  do { if((r) != NULL) {__Pyx_INCREF(r); }} while(0)
  #define __Pyx_XDECREF(r)  do { if((r) != NULL) {__Pyx_DECREF(r); }} while(0)
  #define __Pyx_XGOTREF(r)  do { if((r) != NULL) {__Pyx_GOTREF(r); }} while(0)
  #define __Pyx_XGIVEREF(r) do { if((r) != NULL) {__Pyx_GIVEREF(r);}} while(0)
#else
  #define __Pyx_RefNannyDeclarations
  #define __Pyx_RefNannySetupContext(name)
  #define __Pyx_RefNannyFinishContext()
  #define __Pyx_INCREF(r) Py_INCREF(r)
  #define __Pyx_DECREF(r) Py_DECREF(r)
  #define __Pyx_GOTREF(r)
  #define __Pyx_GIVEREF(r)
  #define __Pyx_XINCREF(r) Py_XINCREF(r)
  #define __Pyx_XDECREF(r) Py_XDECREF(r)
  #define __Pyx_XGOTREF(r)
  #define __Pyx_XGIVEREF(r)
#endif /* CYTHON_REFNANNY */

static PyObject *__Pyx_GetName(PyObject *dict, PyObject *name); /*proto*/

static void __Pyx_RaiseArgtupleInvalid(const char* func_name, int exact,
    Py_ssize_t num_min, Py_ssize_t num_max, Py_ssize_t num_found); /*proto*/

static void __Pyx_RaiseDoubleKeywordsError(
    const char* func_name, PyObject* kw_name); /*proto*/

static int __Pyx_ParseOptionalKeywords(PyObject *kwds, PyObject **argnames[],     PyObject *kwds2, PyObject *values[], Py_ssize_t num_pos_args,     const char* function_name); /*proto*/


static CYTHON_INLINE PyObject *__Pyx_GetItemInt_Generic(PyObject *o, PyObject* j) {
    PyObject *r;
    if (!j) return NULL;
    r = PyObject_GetItem(o, j);
    Py_DECREF(j);
    return r;
}


#define __Pyx_GetItemInt_List(o, i, size, to_py_func) (((size) <= sizeof(Py_ssize_t)) ? \
                                                    __Pyx_GetItemInt_List_Fast(o, i) : \
                                                    __Pyx_GetItemInt_Generic(o, to_py_func(i)))

static CYTHON_INLINE PyObject *__Pyx_GetItemInt_List_Fast(PyObject *o, Py_ssize_t i) {
    if (likely(o != Py_None)) {
        if (likely((0 <= i) & (i < PyList_GET_SIZE(o)))) {
            PyObject *r = PyList_GET_ITEM(o, i);
            Py_INCREF(r);
            return r;
        }
        else if ((-PyList_GET_SIZE(o) <= i) & (i < 0)) {
            PyObject *r = PyList_GET_ITEM(o, PyList_GET_SIZE(o) + i);
            Py_INCREF(r);
            return r;
        }
    }
    return __Pyx_GetItemInt_Generic(o, PyInt_FromSsize_t(i));
}

#define __Pyx_GetItemInt_Tuple(o, i, size, to_py_func) (((size) <= sizeof(Py_ssize_t)) ? \
                                                    __Pyx_GetItemInt_Tuple_Fast(o, i) : \
                                                    __Pyx_GetItemInt_Generic(o, to_py_func(i)))

static CYTHON_INLINE PyObject *__Pyx_GetItemInt_Tuple_Fast(PyObject *o, Py_ssize_t i) {
    if (likely(o != Py_None)) {
        if (likely((0 <= i) & (i < PyTuple_GET_SIZE(o)))) {
            PyObject *r = PyTuple_GET_ITEM(o, i);
            Py_INCREF(r);
            return r;
        }
        else if ((-PyTuple_GET_SIZE(o) <= i) & (i < 0)) {
            PyObject *r = PyTuple_GET_ITEM(o, PyTuple_GET_SIZE(o) + i);
            Py_INCREF(r);
            return r;
        }
    }
    return __Pyx_GetItemInt_Generic(o, PyInt_FromSsize_t(i));
}


#define __Pyx_GetItemInt(o, i, size, to_py_func) (((size) <= sizeof(Py_ssize_t)) ? \
                                                    __Pyx_GetItemInt_Fast(o, i) : \
                                                    __Pyx_GetItemInt_Generic(o, to_py_func(i)))

static CYTHON_INLINE PyObject *__Pyx_GetItemInt_Fast(PyObject *o, Py_ssize_t i) {
    PyObject *r;
    if (PyList_CheckExact(o) && ((0 <= i) & (i < PyList_GET_SIZE(o)))) {
        r = PyList_GET_ITEM(o, i);
        Py_INCREF(r);
    }
    else if (PyTuple_CheckExact(o) && ((0 <= i) & (i < PyTuple_GET_SIZE(o)))) {
        r = PyTuple_GET_ITEM(o, i);
        Py_INCREF(r);
    }
    else if (Py_TYPE(o)->tp_as_sequence && Py_TYPE(o)->tp_as_sequence->sq_item && (likely(i >= 0))) {
        r = PySequence_GetItem(o, i);
    }
    else {
        r = __Pyx_GetItemInt_Generic(o, PyInt_FromSsize_t(i));
    }
    return r;
}

static CYTHON_INLINE unsigned char __Pyx_PyInt_AsUnsignedChar(PyObject *);

static CYTHON_INLINE unsigned short __Pyx_PyInt_AsUnsignedShort(PyObject *);

static CYTHON_INLINE unsigned int __Pyx_PyInt_AsUnsignedInt(PyObject *);

static CYTHON_INLINE char __Pyx_PyInt_AsChar(PyObject *);

static CYTHON_INLINE short __Pyx_PyInt_AsShort(PyObject *);

static CYTHON_INLINE int __Pyx_PyInt_AsInt(PyObject *);

static CYTHON_INLINE signed char __Pyx_PyInt_AsSignedChar(PyObject *);

static CYTHON_INLINE signed short __Pyx_PyInt_AsSignedShort(PyObject *);

static CYTHON_INLINE signed int __Pyx_PyInt_AsSignedInt(PyObject *);

static CYTHON_INLINE int __Pyx_PyInt_AsLongDouble(PyObject *);

static CYTHON_INLINE unsigned long __Pyx_PyInt_AsUnsignedLong(PyObject *);

static CYTHON_INLINE unsigned PY_LONG_LONG __Pyx_PyInt_AsUnsignedLongLong(PyObject *);

static CYTHON_INLINE long __Pyx_PyInt_AsLong(PyObject *);

static CYTHON_INLINE PY_LONG_LONG __Pyx_PyInt_AsLongLong(PyObject *);

static CYTHON_INLINE signed long __Pyx_PyInt_AsSignedLong(PyObject *);

static CYTHON_INLINE signed PY_LONG_LONG __Pyx_PyInt_AsSignedLongLong(PyObject *);

static int __Pyx_check_binary_version(void);

static void __Pyx_AddTraceback(const char *funcname, int __pyx_clineno,
                               int __pyx_lineno, const char *__pyx_filename); /*proto*/

static int __Pyx_InitStrings(__Pyx_StringTabEntry *t); /*proto*/

/* Module declarations from 'defns' */

/* Module declarations from 'cython.cython.view' */

/* Module declarations from 'cython' */

/* Module declarations from 'libc.stdlib' */

/* Module declarations from 'py_nRFSN' */
#define __Pyx_MODULE_NAME "py_nRFSN"
int __pyx_module_is_main_py_nRFSN = 0;

/* Implementation of 'py_nRFSN' */
static PyObject *__pyx_builtin_xrange;
static char __pyx_k_4[] = "py_setSensorValsFast";
static char __pyx_k__CE[] = "CE";
static char __pyx_k__IRQ[] = "IRQ";
static char __pyx_k__LED[] = "LED";
static char __pyx_k__buf[] = "buf";
static char __pyx_k__len[] = "len";
static char __pyx_k__addr[] = "addr";
static char __pyx_k__data[] = "data";
static char __pyx_k__pipe[] = "pipe";
static char __pyx_k__range[] = "range";
static char __pyx_k__SPIDiv[] = "SPIDiv";
static char __pyx_k__xrange[] = "xrange";
static char __pyx_k__command[] = "command";
static char __pyx_k__py_stop[] = "py_stop";
static char __pyx_k____main__[] = "__main__";
static char __pyx_k____test__[] = "__test__";
static char __pyx_k__py_flush[] = "py_flush";
static char __pyx_k__py_nRFSN[] = "py_nRFSN";
static char __pyx_k__py_getMode[] = "py_getMode";
static char __pyx_k__py_bcmDelay[] = "py_bcmDelay";
static char __pyx_k__py_clearInt[] = "py_clearInt";
static char __pyx_k__py_getBufIn[] = "py_getBufIn";
static char __pyx_k__py_getMaxRT[] = "py_getMaxRT";
static char __pyx_k__py_getPower[] = "py_getPower";
static char __pyx_k__py_setMaxRT[] = "py_setMaxRT";
static char __pyx_k__py_setPower[] = "py_setPower";
static char __pyx_k__py_transmit[] = "py_transmit";
static char __pyx_k__py_bcmDelayM[] = "py_bcmDelayM";
static char __pyx_k__py_getRXAddr[] = "py_getRXAddr";
static char __pyx_k__py_getTXAddr[] = "py_getTXAddr";
static char __pyx_k__py_putBufOut[] = "py_putBufOut";
static char __pyx_k__py_setRXAddr[] = "py_setRXAddr";
static char __pyx_k__py_setRXMode[] = "py_setRXMode";
static char __pyx_k__py_setTXAddr[] = "py_setTXAddr";
static char __pyx_k__py_setTXMode[] = "py_setTXMode";
static char __pyx_k__py_getChannel[] = "py_getChannel";
static char __pyx_k__py_getPayload[] = "py_getPayload";
static char __pyx_k__py_nRFSN_init[] = "py_nRFSN_init";
static char __pyx_k__py_setChannel[] = "py_setChannel";
static char __pyx_k__py_updateStatus[] = "py_updateStatus";
static char __pyx_k__py_getMaxRTdelay[] = "py_getMaxRTdelay";
static char __pyx_k__py_getSensorVals[] = "py_getSensorVals";
static char __pyx_k__py_setMaxRTdelay[] = "py_setMaxRTdelay";
static char __pyx_k__py_setSensorVals[] = "py_setSensorVals";
static char __pyx_k__py_getPayloadSize[] = "py_getPayloadSize";
static char __pyx_k__py_putSingleBufOut[] = "py_putSingleBufOut";
static PyObject *__pyx_n_s_4;
static PyObject *__pyx_n_s__CE;
static PyObject *__pyx_n_s__IRQ;
static PyObject *__pyx_n_s__LED;
static PyObject *__pyx_n_s__SPIDiv;
static PyObject *__pyx_n_s____main__;
static PyObject *__pyx_n_s____test__;
static PyObject *__pyx_n_s__addr;
static PyObject *__pyx_n_s__buf;
static PyObject *__pyx_n_s__command;
static PyObject *__pyx_n_s__data;
static PyObject *__pyx_n_s__len;
static PyObject *__pyx_n_s__pipe;
static PyObject *__pyx_n_s__py_bcmDelay;
static PyObject *__pyx_n_s__py_bcmDelayM;
static PyObject *__pyx_n_s__py_clearInt;
static PyObject *__pyx_n_s__py_flush;
static PyObject *__pyx_n_s__py_getBufIn;
static PyObject *__pyx_n_s__py_getChannel;
static PyObject *__pyx_n_s__py_getMaxRT;
static PyObject *__pyx_n_s__py_getMaxRTdelay;
static PyObject *__pyx_n_s__py_getMode;
static PyObject *__pyx_n_s__py_getPayload;
static PyObject *__pyx_n_s__py_getPayloadSize;
static PyObject *__pyx_n_s__py_getPower;
static PyObject *__pyx_n_s__py_getRXAddr;
static PyObject *__pyx_n_s__py_getSensorVals;
static PyObject *__pyx_n_s__py_getTXAddr;
static PyObject *__pyx_n_s__py_nRFSN;
static PyObject *__pyx_n_s__py_nRFSN_init;
static PyObject *__pyx_n_s__py_putBufOut;
static PyObject *__pyx_n_s__py_putSingleBufOut;
static PyObject *__pyx_n_s__py_setChannel;
static PyObject *__pyx_n_s__py_setMaxRT;
static PyObject *__pyx_n_s__py_setMaxRTdelay;
static PyObject *__pyx_n_s__py_setPower;
static PyObject *__pyx_n_s__py_setRXAddr;
static PyObject *__pyx_n_s__py_setRXMode;
static PyObject *__pyx_n_s__py_setSensorVals;
static PyObject *__pyx_n_s__py_setTXAddr;
static PyObject *__pyx_n_s__py_setTXMode;
static PyObject *__pyx_n_s__py_stop;
static PyObject *__pyx_n_s__py_transmit;
static PyObject *__pyx_n_s__py_updateStatus;
static PyObject *__pyx_n_s__range;
static PyObject *__pyx_n_s__xrange;
static PyObject *__pyx_int_1;
static PyObject *__pyx_int_4;
static PyObject *__pyx_k_tuple_1;
static PyObject *__pyx_k_tuple_2;
static PyObject *__pyx_k_tuple_3;

/* "py_nRFSN.pyx":10
 * # C nRFSN Wrapper code
 * #----------------------------------------------------------------------------------
 * def py_nRFSN_init(char SPIDiv, char CE, char IRQ, char LED):             # <<<<<<<<<<<<<<
 *     defns.nRFSN_init(SPIDiv, CE, IRQ, LED)
 * 
 */

static PyObject *__pyx_pf_8py_nRFSN_py_nRFSN_init(PyObject *__pyx_self, PyObject *__pyx_args, PyObject *__pyx_kwds); /*proto*/
static PyMethodDef __pyx_mdef_8py_nRFSN_py_nRFSN_init = {__Pyx_NAMESTR("py_nRFSN_init"), (PyCFunction)__pyx_pf_8py_nRFSN_py_nRFSN_init, METH_VARARGS|METH_KEYWORDS, __Pyx_DOCSTR(0)};
static PyObject *__pyx_pf_8py_nRFSN_py_nRFSN_init(PyObject *__pyx_self, PyObject *__pyx_args, PyObject *__pyx_kwds) {
  char __pyx_v_SPIDiv;
  char __pyx_v_CE;
  char __pyx_v_IRQ;
  char __pyx_v_LED;
  PyObject *__pyx_r = NULL;
  __Pyx_RefNannyDeclarations
  int __pyx_lineno = 0;
  const char *__pyx_filename = NULL;
  int __pyx_clineno = 0;
  static PyObject **__pyx_pyargnames[] = {&__pyx_n_s__SPIDiv,&__pyx_n_s__CE,&__pyx_n_s__IRQ,&__pyx_n_s__LED,0};
  __Pyx_RefNannySetupContext("py_nRFSN_init");
  __pyx_self = __pyx_self;
  {
    PyObject* values[4] = {0,0,0,0};
    if (unlikely(__pyx_kwds)) {
      Py_ssize_t kw_args;
      switch (PyTuple_GET_SIZE(__pyx_args)) {
        case  4: values[3] = PyTuple_GET_ITEM(__pyx_args, 3);
        case  3: values[2] = PyTuple_GET_ITEM(__pyx_args, 2);
        case  2: values[1] = PyTuple_GET_ITEM(__pyx_args, 1);
        case  1: values[0] = PyTuple_GET_ITEM(__pyx_args, 0);
        case  0: break;
        default: goto __pyx_L5_argtuple_error;
      }
      kw_args = PyDict_Size(__pyx_kwds);
      switch (PyTuple_GET_SIZE(__pyx_args)) {
        case  0:
        values[0] = PyDict_GetItem(__pyx_kwds, __pyx_n_s__SPIDiv);
        if (likely(values[0])) kw_args--;
        else goto __pyx_L5_argtuple_error;
        case  1:
        values[1] = PyDict_GetItem(__pyx_kwds, __pyx_n_s__CE);
        if (likely(values[1])) kw_args--;
        else {
          __Pyx_RaiseArgtupleInvalid("py_nRFSN_init", 1, 4, 4, 1); {__pyx_filename = __pyx_f[0]; __pyx_lineno = 10; __pyx_clineno = __LINE__; goto __pyx_L3_error;}
        }
        case  2:
        values[2] = PyDict_GetItem(__pyx_kwds, __pyx_n_s__IRQ);
        if (likely(values[2])) kw_args--;
        else {
          __Pyx_RaiseArgtupleInvalid("py_nRFSN_init", 1, 4, 4, 2); {__pyx_filename = __pyx_f[0]; __pyx_lineno = 10; __pyx_clineno = __LINE__; goto __pyx_L3_error;}
        }
        case  3:
        values[3] = PyDict_GetItem(__pyx_kwds, __pyx_n_s__LED);
        if (likely(values[3])) kw_args--;
        else {
          __Pyx_RaiseArgtupleInvalid("py_nRFSN_init", 1, 4, 4, 3); {__pyx_filename = __pyx_f[0]; __pyx_lineno = 10; __pyx_clineno = __LINE__; goto __pyx_L3_error;}
        }
      }
      if (unlikely(kw_args > 0)) {
        if (unlikely(__Pyx_ParseOptionalKeywords(__pyx_kwds, __pyx_pyargnames, 0, values, PyTuple_GET_SIZE(__pyx_args), "py_nRFSN_init") < 0)) {__pyx_filename = __pyx_f[0]; __pyx_lineno = 10; __pyx_clineno = __LINE__; goto __pyx_L3_error;}
      }
    } else if (PyTuple_GET_SIZE(__pyx_args) != 4) {
      goto __pyx_L5_argtuple_error;
    } else {
      values[0] = PyTuple_GET_ITEM(__pyx_args, 0);
      values[1] = PyTuple_GET_ITEM(__pyx_args, 1);
      values[2] = PyTuple_GET_ITEM(__pyx_args, 2);
      values[3] = PyTuple_GET_ITEM(__pyx_args, 3);
    }
    __pyx_v_SPIDiv = __Pyx_PyInt_AsChar(values[0]); if (unlikely((__pyx_v_SPIDiv == (char)-1) && PyErr_Occurred())) {__pyx_filename = __pyx_f[0]; __pyx_lineno = 10; __pyx_clineno = __LINE__; goto __pyx_L3_error;}
    __pyx_v_CE = __Pyx_PyInt_AsChar(values[1]); if (unlikely((__pyx_v_CE == (char)-1) && PyErr_Occurred())) {__pyx_filename = __pyx_f[0]; __pyx_lineno = 10; __pyx_clineno = __LINE__; goto __pyx_L3_error;}
    __pyx_v_IRQ = __Pyx_PyInt_AsChar(values[2]); if (unlikely((__pyx_v_IRQ == (char)-1) && PyErr_Occurred())) {__pyx_filename = __pyx_f[0]; __pyx_lineno = 10; __pyx_clineno = __LINE__; goto __pyx_L3_error;}
    __pyx_v_LED = __Pyx_PyInt_AsChar(values[3]); if (unlikely((__pyx_v_LED == (char)-1) && PyErr_Occurred())) {__pyx_filename = __pyx_f[0]; __pyx_lineno = 10; __pyx_clineno = __LINE__; goto __pyx_L3_error;}
  }
  goto __pyx_L4_argument_unpacking_done;
  __pyx_L5_argtuple_error:;
  __Pyx_RaiseArgtupleInvalid("py_nRFSN_init", 1, 4, 4, PyTuple_GET_SIZE(__pyx_args)); {__pyx_filename = __pyx_f[0]; __pyx_lineno = 10; __pyx_clineno = __LINE__; goto __pyx_L3_error;}
  __pyx_L3_error:;
  __Pyx_AddTraceback("py_nRFSN.py_nRFSN_init", __pyx_clineno, __pyx_lineno, __pyx_filename);
  __Pyx_RefNannyFinishContext();
  return NULL;
  __pyx_L4_argument_unpacking_done:;

  /* "py_nRFSN.pyx":11
 * #----------------------------------------------------------------------------------
 * def py_nRFSN_init(char SPIDiv, char CE, char IRQ, char LED):
 *     defns.nRFSN_init(SPIDiv, CE, IRQ, LED)             # <<<<<<<<<<<<<<
 * 
 * def py_setTXMode():
 */
  nRFSN_init(__pyx_v_SPIDiv, __pyx_v_CE, __pyx_v_IRQ, __pyx_v_LED);

  __pyx_r = Py_None; __Pyx_INCREF(Py_None);
  __Pyx_XGIVEREF(__pyx_r);
  __Pyx_RefNannyFinishContext();
  return __pyx_r;
}

/* "py_nRFSN.pyx":13
 *     defns.nRFSN_init(SPIDiv, CE, IRQ, LED)
 * 
 * def py_setTXMode():             # <<<<<<<<<<<<<<
 *     defns.setTXMode()
 * 
 */

static PyObject *__pyx_pf_8py_nRFSN_1py_setTXMode(PyObject *__pyx_self, CYTHON_UNUSED PyObject *unused); /*proto*/
static PyMethodDef __pyx_mdef_8py_nRFSN_1py_setTXMode = {__Pyx_NAMESTR("py_setTXMode"), (PyCFunction)__pyx_pf_8py_nRFSN_1py_setTXMode, METH_NOARGS, __Pyx_DOCSTR(0)};
static PyObject *__pyx_pf_8py_nRFSN_1py_setTXMode(PyObject *__pyx_self, CYTHON_UNUSED PyObject *unused) {
  PyObject *__pyx_r = NULL;
  __Pyx_RefNannyDeclarations
  __Pyx_RefNannySetupContext("py_setTXMode");
  __pyx_self = __pyx_self;

  /* "py_nRFSN.pyx":14
 * 
 * def py_setTXMode():
 *     defns.setTXMode()             # <<<<<<<<<<<<<<
 * 
 * def py_setRXMode():
 */
  setTXMode();

  __pyx_r = Py_None; __Pyx_INCREF(Py_None);
  __Pyx_XGIVEREF(__pyx_r);
  __Pyx_RefNannyFinishContext();
  return __pyx_r;
}

/* "py_nRFSN.pyx":16
 *     defns.setTXMode()
 * 
 * def py_setRXMode():             # <<<<<<<<<<<<<<
 *     defns.setTXMode()
 * 
 */

static PyObject *__pyx_pf_8py_nRFSN_2py_setRXMode(PyObject *__pyx_self, CYTHON_UNUSED PyObject *unused); /*proto*/
static PyMethodDef __pyx_mdef_8py_nRFSN_2py_setRXMode = {__Pyx_NAMESTR("py_setRXMode"), (PyCFunction)__pyx_pf_8py_nRFSN_2py_setRXMode, METH_NOARGS, __Pyx_DOCSTR(0)};
static PyObject *__pyx_pf_8py_nRFSN_2py_setRXMode(PyObject *__pyx_self, CYTHON_UNUSED PyObject *unused) {
  PyObject *__pyx_r = NULL;
  __Pyx_RefNannyDeclarations
  __Pyx_RefNannySetupContext("py_setRXMode");
  __pyx_self = __pyx_self;

  /* "py_nRFSN.pyx":17
 * 
 * def py_setRXMode():
 *     defns.setTXMode()             # <<<<<<<<<<<<<<
 * 
 * def py_getMode():
 */
  setTXMode();

  __pyx_r = Py_None; __Pyx_INCREF(Py_None);
  __Pyx_XGIVEREF(__pyx_r);
  __Pyx_RefNannyFinishContext();
  return __pyx_r;
}

/* "py_nRFSN.pyx":19
 *     defns.setTXMode()
 * 
 * def py_getMode():             # <<<<<<<<<<<<<<
 *     return defns.getMode()
 * 
 */

static PyObject *__pyx_pf_8py_nRFSN_3py_getMode(PyObject *__pyx_self, CYTHON_UNUSED PyObject *unused); /*proto*/
static PyMethodDef __pyx_mdef_8py_nRFSN_3py_getMode = {__Pyx_NAMESTR("py_getMode"), (PyCFunction)__pyx_pf_8py_nRFSN_3py_getMode, METH_NOARGS, __Pyx_DOCSTR(0)};
static PyObject *__pyx_pf_8py_nRFSN_3py_getMode(PyObject *__pyx_self, CYTHON_UNUSED PyObject *unused) {
  PyObject *__pyx_r = NULL;
  __Pyx_RefNannyDeclarations
  PyObject *__pyx_t_1 = NULL;
  int __pyx_lineno = 0;
  const char *__pyx_filename = NULL;
  int __pyx_clineno = 0;
  __Pyx_RefNannySetupContext("py_getMode");
  __pyx_self = __pyx_self;

  /* "py_nRFSN.pyx":20
 * 
 * def py_getMode():
 *     return defns.getMode()             # <<<<<<<<<<<<<<
 * 
 * def py_setPower(char pwr):
 */
  __Pyx_XDECREF(__pyx_r);
  __pyx_t_1 = PyInt_FromLong(getMode()); if (unlikely(!__pyx_t_1)) {__pyx_filename = __pyx_f[0]; __pyx_lineno = 20; __pyx_clineno = __LINE__; goto __pyx_L1_error;}
  __Pyx_GOTREF(__pyx_t_1);
  __pyx_r = __pyx_t_1;
  __pyx_t_1 = 0;
  goto __pyx_L0;

  __pyx_r = Py_None; __Pyx_INCREF(Py_None);
  goto __pyx_L0;
  __pyx_L1_error:;
  __Pyx_XDECREF(__pyx_t_1);
  __Pyx_AddTraceback("py_nRFSN.py_getMode", __pyx_clineno, __pyx_lineno, __pyx_filename);
  __pyx_r = NULL;
  __pyx_L0:;
  __Pyx_XGIVEREF(__pyx_r);
  __Pyx_RefNannyFinishContext();
  return __pyx_r;
}

/* "py_nRFSN.pyx":22
 *     return defns.getMode()
 * 
 * def py_setPower(char pwr):             # <<<<<<<<<<<<<<
 *     defns.setPower(pwr)
 * 
 */

static PyObject *__pyx_pf_8py_nRFSN_4py_setPower(PyObject *__pyx_self, PyObject *__pyx_arg_pwr); /*proto*/
static PyMethodDef __pyx_mdef_8py_nRFSN_4py_setPower = {__Pyx_NAMESTR("py_setPower"), (PyCFunction)__pyx_pf_8py_nRFSN_4py_setPower, METH_O, __Pyx_DOCSTR(0)};
static PyObject *__pyx_pf_8py_nRFSN_4py_setPower(PyObject *__pyx_self, PyObject *__pyx_arg_pwr) {
  char __pyx_v_pwr;
  PyObject *__pyx_r = NULL;
  __Pyx_RefNannyDeclarations
  int __pyx_lineno = 0;
  const char *__pyx_filename = NULL;
  int __pyx_clineno = 0;
  __Pyx_RefNannySetupContext("py_setPower");
  __pyx_self = __pyx_self;
  assert(__pyx_arg_pwr); {
    __pyx_v_pwr = __Pyx_PyInt_AsChar(__pyx_arg_pwr); if (unlikely((__pyx_v_pwr == (char)-1) && PyErr_Occurred())) {__pyx_filename = __pyx_f[0]; __pyx_lineno = 22; __pyx_clineno = __LINE__; goto __pyx_L3_error;}
  }
  goto __pyx_L4_argument_unpacking_done;
  __pyx_L3_error:;
  __Pyx_AddTraceback("py_nRFSN.py_setPower", __pyx_clineno, __pyx_lineno, __pyx_filename);
  __Pyx_RefNannyFinishContext();
  return NULL;
  __pyx_L4_argument_unpacking_done:;

  /* "py_nRFSN.pyx":23
 * 
 * def py_setPower(char pwr):
 *     defns.setPower(pwr)             # <<<<<<<<<<<<<<
 * 
 * def py_getPower():
 */
  setPower(__pyx_v_pwr);

  __pyx_r = Py_None; __Pyx_INCREF(Py_None);
  __Pyx_XGIVEREF(__pyx_r);
  __Pyx_RefNannyFinishContext();
  return __pyx_r;
}

/* "py_nRFSN.pyx":25
 *     defns.setPower(pwr)
 * 
 * def py_getPower():             # <<<<<<<<<<<<<<
 *     return defns.getPower()
 * 
 */

static PyObject *__pyx_pf_8py_nRFSN_5py_getPower(PyObject *__pyx_self, CYTHON_UNUSED PyObject *unused); /*proto*/
static PyMethodDef __pyx_mdef_8py_nRFSN_5py_getPower = {__Pyx_NAMESTR("py_getPower"), (PyCFunction)__pyx_pf_8py_nRFSN_5py_getPower, METH_NOARGS, __Pyx_DOCSTR(0)};
static PyObject *__pyx_pf_8py_nRFSN_5py_getPower(PyObject *__pyx_self, CYTHON_UNUSED PyObject *unused) {
  PyObject *__pyx_r = NULL;
  __Pyx_RefNannyDeclarations
  PyObject *__pyx_t_1 = NULL;
  int __pyx_lineno = 0;
  const char *__pyx_filename = NULL;
  int __pyx_clineno = 0;
  __Pyx_RefNannySetupContext("py_getPower");
  __pyx_self = __pyx_self;

  /* "py_nRFSN.pyx":26
 * 
 * def py_getPower():
 *     return defns.getPower()             # <<<<<<<<<<<<<<
 * 
 * def py_setChannel(char ch):
 */
  __Pyx_XDECREF(__pyx_r);
  __pyx_t_1 = PyInt_FromLong(getPower()); if (unlikely(!__pyx_t_1)) {__pyx_filename = __pyx_f[0]; __pyx_lineno = 26; __pyx_clineno = __LINE__; goto __pyx_L1_error;}
  __Pyx_GOTREF(__pyx_t_1);
  __pyx_r = __pyx_t_1;
  __pyx_t_1 = 0;
  goto __pyx_L0;

  __pyx_r = Py_None; __Pyx_INCREF(Py_None);
  goto __pyx_L0;
  __pyx_L1_error:;
  __Pyx_XDECREF(__pyx_t_1);
  __Pyx_AddTraceback("py_nRFSN.py_getPower", __pyx_clineno, __pyx_lineno, __pyx_filename);
  __pyx_r = NULL;
  __pyx_L0:;
  __Pyx_XGIVEREF(__pyx_r);
  __Pyx_RefNannyFinishContext();
  return __pyx_r;
}

/* "py_nRFSN.pyx":28
 *     return defns.getPower()
 * 
 * def py_setChannel(char ch):             # <<<<<<<<<<<<<<
 *     defns.setChannel(ch)
 * 
 */

static PyObject *__pyx_pf_8py_nRFSN_6py_setChannel(PyObject *__pyx_self, PyObject *__pyx_arg_ch); /*proto*/
static PyMethodDef __pyx_mdef_8py_nRFSN_6py_setChannel = {__Pyx_NAMESTR("py_setChannel"), (PyCFunction)__pyx_pf_8py_nRFSN_6py_setChannel, METH_O, __Pyx_DOCSTR(0)};
static PyObject *__pyx_pf_8py_nRFSN_6py_setChannel(PyObject *__pyx_self, PyObject *__pyx_arg_ch) {
  char __pyx_v_ch;
  PyObject *__pyx_r = NULL;
  __Pyx_RefNannyDeclarations
  int __pyx_lineno = 0;
  const char *__pyx_filename = NULL;
  int __pyx_clineno = 0;
  __Pyx_RefNannySetupContext("py_setChannel");
  __pyx_self = __pyx_self;
  assert(__pyx_arg_ch); {
    __pyx_v_ch = __Pyx_PyInt_AsChar(__pyx_arg_ch); if (unlikely((__pyx_v_ch == (char)-1) && PyErr_Occurred())) {__pyx_filename = __pyx_f[0]; __pyx_lineno = 28; __pyx_clineno = __LINE__; goto __pyx_L3_error;}
  }
  goto __pyx_L4_argument_unpacking_done;
  __pyx_L3_error:;
  __Pyx_AddTraceback("py_nRFSN.py_setChannel", __pyx_clineno, __pyx_lineno, __pyx_filename);
  __Pyx_RefNannyFinishContext();
  return NULL;
  __pyx_L4_argument_unpacking_done:;

  /* "py_nRFSN.pyx":29
 * 
 * def py_setChannel(char ch):
 *     defns.setChannel(ch)             # <<<<<<<<<<<<<<
 * 
 * def py_getChannel():
 */
  setChannel(__pyx_v_ch);

  __pyx_r = Py_None; __Pyx_INCREF(Py_None);
  __Pyx_XGIVEREF(__pyx_r);
  __Pyx_RefNannyFinishContext();
  return __pyx_r;
}

/* "py_nRFSN.pyx":31
 *     defns.setChannel(ch)
 * 
 * def py_getChannel():             # <<<<<<<<<<<<<<
 *     return defns.getChannel()
 * 
 */

static PyObject *__pyx_pf_8py_nRFSN_7py_getChannel(PyObject *__pyx_self, CYTHON_UNUSED PyObject *unused); /*proto*/
static PyMethodDef __pyx_mdef_8py_nRFSN_7py_getChannel = {__Pyx_NAMESTR("py_getChannel"), (PyCFunction)__pyx_pf_8py_nRFSN_7py_getChannel, METH_NOARGS, __Pyx_DOCSTR(0)};
static PyObject *__pyx_pf_8py_nRFSN_7py_getChannel(PyObject *__pyx_self, CYTHON_UNUSED PyObject *unused) {
  PyObject *__pyx_r = NULL;
  __Pyx_RefNannyDeclarations
  PyObject *__pyx_t_1 = NULL;
  int __pyx_lineno = 0;
  const char *__pyx_filename = NULL;
  int __pyx_clineno = 0;
  __Pyx_RefNannySetupContext("py_getChannel");
  __pyx_self = __pyx_self;

  /* "py_nRFSN.pyx":32
 * 
 * def py_getChannel():
 *     return defns.getChannel()             # <<<<<<<<<<<<<<
 * 
 * def py_setMaxRT(char max):
 */
  __Pyx_XDECREF(__pyx_r);
  __pyx_t_1 = PyInt_FromLong(getChannel()); if (unlikely(!__pyx_t_1)) {__pyx_filename = __pyx_f[0]; __pyx_lineno = 32; __pyx_clineno = __LINE__; goto __pyx_L1_error;}
  __Pyx_GOTREF(__pyx_t_1);
  __pyx_r = __pyx_t_1;
  __pyx_t_1 = 0;
  goto __pyx_L0;

  __pyx_r = Py_None; __Pyx_INCREF(Py_None);
  goto __pyx_L0;
  __pyx_L1_error:;
  __Pyx_XDECREF(__pyx_t_1);
  __Pyx_AddTraceback("py_nRFSN.py_getChannel", __pyx_clineno, __pyx_lineno, __pyx_filename);
  __pyx_r = NULL;
  __pyx_L0:;
  __Pyx_XGIVEREF(__pyx_r);
  __Pyx_RefNannyFinishContext();
  return __pyx_r;
}

/* "py_nRFSN.pyx":34
 *     return defns.getChannel()
 * 
 * def py_setMaxRT(char max):             # <<<<<<<<<<<<<<
 *     defns.setMaxRT(max)
 * 
 */

static PyObject *__pyx_pf_8py_nRFSN_8py_setMaxRT(PyObject *__pyx_self, PyObject *__pyx_arg_max); /*proto*/
static PyMethodDef __pyx_mdef_8py_nRFSN_8py_setMaxRT = {__Pyx_NAMESTR("py_setMaxRT"), (PyCFunction)__pyx_pf_8py_nRFSN_8py_setMaxRT, METH_O, __Pyx_DOCSTR(0)};
static PyObject *__pyx_pf_8py_nRFSN_8py_setMaxRT(PyObject *__pyx_self, PyObject *__pyx_arg_max) {
  char __pyx_v_max;
  PyObject *__pyx_r = NULL;
  __Pyx_RefNannyDeclarations
  int __pyx_lineno = 0;
  const char *__pyx_filename = NULL;
  int __pyx_clineno = 0;
  __Pyx_RefNannySetupContext("py_setMaxRT");
  __pyx_self = __pyx_self;
  assert(__pyx_arg_max); {
    __pyx_v_max = __Pyx_PyInt_AsChar(__pyx_arg_max); if (unlikely((__pyx_v_max == (char)-1) && PyErr_Occurred())) {__pyx_filename = __pyx_f[0]; __pyx_lineno = 34; __pyx_clineno = __LINE__; goto __pyx_L3_error;}
  }
  goto __pyx_L4_argument_unpacking_done;
  __pyx_L3_error:;
  __Pyx_AddTraceback("py_nRFSN.py_setMaxRT", __pyx_clineno, __pyx_lineno, __pyx_filename);
  __Pyx_RefNannyFinishContext();
  return NULL;
  __pyx_L4_argument_unpacking_done:;

  /* "py_nRFSN.pyx":35
 * 
 * def py_setMaxRT(char max):
 *     defns.setMaxRT(max)             # <<<<<<<<<<<<<<
 * 
 * def py_getMaxRT():
 */
  setMaxRT(__pyx_v_max);

  __pyx_r = Py_None; __Pyx_INCREF(Py_None);
  __Pyx_XGIVEREF(__pyx_r);
  __Pyx_RefNannyFinishContext();
  return __pyx_r;
}

/* "py_nRFSN.pyx":37
 *     defns.setMaxRT(max)
 * 
 * def py_getMaxRT():             # <<<<<<<<<<<<<<
 *     return defns.getMaxRT()
 * 
 */

static PyObject *__pyx_pf_8py_nRFSN_9py_getMaxRT(PyObject *__pyx_self, CYTHON_UNUSED PyObject *unused); /*proto*/
static PyMethodDef __pyx_mdef_8py_nRFSN_9py_getMaxRT = {__Pyx_NAMESTR("py_getMaxRT"), (PyCFunction)__pyx_pf_8py_nRFSN_9py_getMaxRT, METH_NOARGS, __Pyx_DOCSTR(0)};
static PyObject *__pyx_pf_8py_nRFSN_9py_getMaxRT(PyObject *__pyx_self, CYTHON_UNUSED PyObject *unused) {
  PyObject *__pyx_r = NULL;
  __Pyx_RefNannyDeclarations
  PyObject *__pyx_t_1 = NULL;
  int __pyx_lineno = 0;
  const char *__pyx_filename = NULL;
  int __pyx_clineno = 0;
  __Pyx_RefNannySetupContext("py_getMaxRT");
  __pyx_self = __pyx_self;

  /* "py_nRFSN.pyx":38
 * 
 * def py_getMaxRT():
 *     return defns.getMaxRT()             # <<<<<<<<<<<<<<
 * 
 * def py_setMaxRTdelay(char delay):
 */
  __Pyx_XDECREF(__pyx_r);
  __pyx_t_1 = PyInt_FromLong(getMaxRT()); if (unlikely(!__pyx_t_1)) {__pyx_filename = __pyx_f[0]; __pyx_lineno = 38; __pyx_clineno = __LINE__; goto __pyx_L1_error;}
  __Pyx_GOTREF(__pyx_t_1);
  __pyx_r = __pyx_t_1;
  __pyx_t_1 = 0;
  goto __pyx_L0;

  __pyx_r = Py_None; __Pyx_INCREF(Py_None);
  goto __pyx_L0;
  __pyx_L1_error:;
  __Pyx_XDECREF(__pyx_t_1);
  __Pyx_AddTraceback("py_nRFSN.py_getMaxRT", __pyx_clineno, __pyx_lineno, __pyx_filename);
  __pyx_r = NULL;
  __pyx_L0:;
  __Pyx_XGIVEREF(__pyx_r);
  __Pyx_RefNannyFinishContext();
  return __pyx_r;
}

/* "py_nRFSN.pyx":40
 *     return defns.getMaxRT()
 * 
 * def py_setMaxRTdelay(char delay):             # <<<<<<<<<<<<<<
 *     defns.setMaxRTdelay(delay)
 * 
 */

static PyObject *__pyx_pf_8py_nRFSN_10py_setMaxRTdelay(PyObject *__pyx_self, PyObject *__pyx_arg_delay); /*proto*/
static PyMethodDef __pyx_mdef_8py_nRFSN_10py_setMaxRTdelay = {__Pyx_NAMESTR("py_setMaxRTdelay"), (PyCFunction)__pyx_pf_8py_nRFSN_10py_setMaxRTdelay, METH_O, __Pyx_DOCSTR(0)};
static PyObject *__pyx_pf_8py_nRFSN_10py_setMaxRTdelay(PyObject *__pyx_self, PyObject *__pyx_arg_delay) {
  char __pyx_v_delay;
  PyObject *__pyx_r = NULL;
  __Pyx_RefNannyDeclarations
  int __pyx_lineno = 0;
  const char *__pyx_filename = NULL;
  int __pyx_clineno = 0;
  __Pyx_RefNannySetupContext("py_setMaxRTdelay");
  __pyx_self = __pyx_self;
  assert(__pyx_arg_delay); {
    __pyx_v_delay = __Pyx_PyInt_AsChar(__pyx_arg_delay); if (unlikely((__pyx_v_delay == (char)-1) && PyErr_Occurred())) {__pyx_filename = __pyx_f[0]; __pyx_lineno = 40; __pyx_clineno = __LINE__; goto __pyx_L3_error;}
  }
  goto __pyx_L4_argument_unpacking_done;
  __pyx_L3_error:;
  __Pyx_AddTraceback("py_nRFSN.py_setMaxRTdelay", __pyx_clineno, __pyx_lineno, __pyx_filename);
  __Pyx_RefNannyFinishContext();
  return NULL;
  __pyx_L4_argument_unpacking_done:;

  /* "py_nRFSN.pyx":41
 * 
 * def py_setMaxRTdelay(char delay):
 *     defns.setMaxRTdelay(delay)             # <<<<<<<<<<<<<<
 * 
 * def py_getMaxRTdelay():
 */
  setMaxRTdelay(__pyx_v_delay);

  __pyx_r = Py_None; __Pyx_INCREF(Py_None);
  __Pyx_XGIVEREF(__pyx_r);
  __Pyx_RefNannyFinishContext();
  return __pyx_r;
}

/* "py_nRFSN.pyx":43
 *     defns.setMaxRTdelay(delay)
 * 
 * def py_getMaxRTdelay():             # <<<<<<<<<<<<<<
 *     return defns.getMaxRTdelay()
 * 
 */

static PyObject *__pyx_pf_8py_nRFSN_11py_getMaxRTdelay(PyObject *__pyx_self, CYTHON_UNUSED PyObject *unused); /*proto*/
static PyMethodDef __pyx_mdef_8py_nRFSN_11py_getMaxRTdelay = {__Pyx_NAMESTR("py_getMaxRTdelay"), (PyCFunction)__pyx_pf_8py_nRFSN_11py_getMaxRTdelay, METH_NOARGS, __Pyx_DOCSTR(0)};
static PyObject *__pyx_pf_8py_nRFSN_11py_getMaxRTdelay(PyObject *__pyx_self, CYTHON_UNUSED PyObject *unused) {
  PyObject *__pyx_r = NULL;
  __Pyx_RefNannyDeclarations
  PyObject *__pyx_t_1 = NULL;
  int __pyx_lineno = 0;
  const char *__pyx_filename = NULL;
  int __pyx_clineno = 0;
  __Pyx_RefNannySetupContext("py_getMaxRTdelay");
  __pyx_self = __pyx_self;

  /* "py_nRFSN.pyx":44
 * 
 * def py_getMaxRTdelay():
 *     return defns.getMaxRTdelay()             # <<<<<<<<<<<<<<
 * 
 * def py_setTXAddr(addr, char len):
 */
  __Pyx_XDECREF(__pyx_r);
  __pyx_t_1 = PyInt_FromLong(getMaxRTdelay()); if (unlikely(!__pyx_t_1)) {__pyx_filename = __pyx_f[0]; __pyx_lineno = 44; __pyx_clineno = __LINE__; goto __pyx_L1_error;}
  __Pyx_GOTREF(__pyx_t_1);
  __pyx_r = __pyx_t_1;
  __pyx_t_1 = 0;
  goto __pyx_L0;

  __pyx_r = Py_None; __Pyx_INCREF(Py_None);
  goto __pyx_L0;
  __pyx_L1_error:;
  __Pyx_XDECREF(__pyx_t_1);
  __Pyx_AddTraceback("py_nRFSN.py_getMaxRTdelay", __pyx_clineno, __pyx_lineno, __pyx_filename);
  __pyx_r = NULL;
  __pyx_L0:;
  __Pyx_XGIVEREF(__pyx_r);
  __Pyx_RefNannyFinishContext();
  return __pyx_r;
}

/* "py_nRFSN.pyx":46
 *     return defns.getMaxRTdelay()
 * 
 * def py_setTXAddr(addr, char len):             # <<<<<<<<<<<<<<
 *     cdef char *addrptr
 *     addrptr = <char *>malloc(len)
 */

static PyObject *__pyx_pf_8py_nRFSN_12py_setTXAddr(PyObject *__pyx_self, PyObject *__pyx_args, PyObject *__pyx_kwds); /*proto*/
static PyMethodDef __pyx_mdef_8py_nRFSN_12py_setTXAddr = {__Pyx_NAMESTR("py_setTXAddr"), (PyCFunction)__pyx_pf_8py_nRFSN_12py_setTXAddr, METH_VARARGS|METH_KEYWORDS, __Pyx_DOCSTR(0)};
static PyObject *__pyx_pf_8py_nRFSN_12py_setTXAddr(PyObject *__pyx_self, PyObject *__pyx_args, PyObject *__pyx_kwds) {
  PyObject *__pyx_v_addr = 0;
  char __pyx_v_len;
  char *__pyx_v_addrptr;
  char __pyx_v_i;
  PyObject *__pyx_r = NULL;
  __Pyx_RefNannyDeclarations
  char __pyx_t_1;
  char __pyx_t_2;
  PyObject *__pyx_t_3 = NULL;
  char __pyx_t_4;
  int __pyx_lineno = 0;
  const char *__pyx_filename = NULL;
  int __pyx_clineno = 0;
  static PyObject **__pyx_pyargnames[] = {&__pyx_n_s__addr,&__pyx_n_s__len,0};
  __Pyx_RefNannySetupContext("py_setTXAddr");
  __pyx_self = __pyx_self;
  {
    PyObject* values[2] = {0,0};
    if (unlikely(__pyx_kwds)) {
      Py_ssize_t kw_args;
      switch (PyTuple_GET_SIZE(__pyx_args)) {
        case  2: values[1] = PyTuple_GET_ITEM(__pyx_args, 1);
        case  1: values[0] = PyTuple_GET_ITEM(__pyx_args, 0);
        case  0: break;
        default: goto __pyx_L5_argtuple_error;
      }
      kw_args = PyDict_Size(__pyx_kwds);
      switch (PyTuple_GET_SIZE(__pyx_args)) {
        case  0:
        values[0] = PyDict_GetItem(__pyx_kwds, __pyx_n_s__addr);
        if (likely(values[0])) kw_args--;
        else goto __pyx_L5_argtuple_error;
        case  1:
        values[1] = PyDict_GetItem(__pyx_kwds, __pyx_n_s__len);
        if (likely(values[1])) kw_args--;
        else {
          __Pyx_RaiseArgtupleInvalid("py_setTXAddr", 1, 2, 2, 1); {__pyx_filename = __pyx_f[0]; __pyx_lineno = 46; __pyx_clineno = __LINE__; goto __pyx_L3_error;}
        }
      }
      if (unlikely(kw_args > 0)) {
        if (unlikely(__Pyx_ParseOptionalKeywords(__pyx_kwds, __pyx_pyargnames, 0, values, PyTuple_GET_SIZE(__pyx_args), "py_setTXAddr") < 0)) {__pyx_filename = __pyx_f[0]; __pyx_lineno = 46; __pyx_clineno = __LINE__; goto __pyx_L3_error;}
      }
    } else if (PyTuple_GET_SIZE(__pyx_args) != 2) {
      goto __pyx_L5_argtuple_error;
    } else {
      values[0] = PyTuple_GET_ITEM(__pyx_args, 0);
      values[1] = PyTuple_GET_ITEM(__pyx_args, 1);
    }
    __pyx_v_addr = values[0];
    __pyx_v_len = __Pyx_PyInt_AsChar(values[1]); if (unlikely((__pyx_v_len == (char)-1) && PyErr_Occurred())) {__pyx_filename = __pyx_f[0]; __pyx_lineno = 46; __pyx_clineno = __LINE__; goto __pyx_L3_error;}
  }
  goto __pyx_L4_argument_unpacking_done;
  __pyx_L5_argtuple_error:;
  __Pyx_RaiseArgtupleInvalid("py_setTXAddr", 1, 2, 2, PyTuple_GET_SIZE(__pyx_args)); {__pyx_filename = __pyx_f[0]; __pyx_lineno = 46; __pyx_clineno = __LINE__; goto __pyx_L3_error;}
  __pyx_L3_error:;
  __Pyx_AddTraceback("py_nRFSN.py_setTXAddr", __pyx_clineno, __pyx_lineno, __pyx_filename);
  __Pyx_RefNannyFinishContext();
  return NULL;
  __pyx_L4_argument_unpacking_done:;

  /* "py_nRFSN.pyx":48
 * def py_setTXAddr(addr, char len):
 *     cdef char *addrptr
 *     addrptr = <char *>malloc(len)             # <<<<<<<<<<<<<<
 *     for i in xrange(len):
 *         addrptr[i] = addr[i]
 */
  __pyx_v_addrptr = ((char *)malloc(__pyx_v_len));

  /* "py_nRFSN.pyx":49
 *     cdef char *addrptr
 *     addrptr = <char *>malloc(len)
 *     for i in xrange(len):             # <<<<<<<<<<<<<<
 *         addrptr[i] = addr[i]
 *     defns.setTXAddr(addrptr, len)
 */
  __pyx_t_1 = __pyx_v_len;
  for (__pyx_t_2 = 0; __pyx_t_2 < __pyx_t_1; __pyx_t_2+=1) {
    __pyx_v_i = __pyx_t_2;

    /* "py_nRFSN.pyx":50
 *     addrptr = <char *>malloc(len)
 *     for i in xrange(len):
 *         addrptr[i] = addr[i]             # <<<<<<<<<<<<<<
 *     defns.setTXAddr(addrptr, len)
 *     free(addrptr) # free memory after function is complete
 */
    __pyx_t_3 = __Pyx_GetItemInt(__pyx_v_addr, __pyx_v_i, sizeof(char), PyInt_FromLong); if (!__pyx_t_3) {__pyx_filename = __pyx_f[0]; __pyx_lineno = 50; __pyx_clineno = __LINE__; goto __pyx_L1_error;}
    __Pyx_GOTREF(__pyx_t_3);
    __pyx_t_4 = __Pyx_PyInt_AsChar(__pyx_t_3); if (unlikely((__pyx_t_4 == (char)-1) && PyErr_Occurred())) {__pyx_filename = __pyx_f[0]; __pyx_lineno = 50; __pyx_clineno = __LINE__; goto __pyx_L1_error;}
    __Pyx_DECREF(__pyx_t_3); __pyx_t_3 = 0;
    (__pyx_v_addrptr[__pyx_v_i]) = __pyx_t_4;
  }

  /* "py_nRFSN.pyx":51
 *     for i in xrange(len):
 *         addrptr[i] = addr[i]
 *     defns.setTXAddr(addrptr, len)             # <<<<<<<<<<<<<<
 *     free(addrptr) # free memory after function is complete
 * 
 */
  setTXAddr(__pyx_v_addrptr, __pyx_v_len);

  /* "py_nRFSN.pyx":52
 *         addrptr[i] = addr[i]
 *     defns.setTXAddr(addrptr, len)
 *     free(addrptr) # free memory after function is complete             # <<<<<<<<<<<<<<
 * 
 * def py_setRXAddr(char pipe, addr, char len):
 */
  free(__pyx_v_addrptr);

  __pyx_r = Py_None; __Pyx_INCREF(Py_None);
  goto __pyx_L0;
  __pyx_L1_error:;
  __Pyx_XDECREF(__pyx_t_3);
  __Pyx_AddTraceback("py_nRFSN.py_setTXAddr", __pyx_clineno, __pyx_lineno, __pyx_filename);
  __pyx_r = NULL;
  __pyx_L0:;
  __Pyx_XGIVEREF(__pyx_r);
  __Pyx_RefNannyFinishContext();
  return __pyx_r;
}

/* "py_nRFSN.pyx":54
 *     free(addrptr) # free memory after function is complete
 * 
 * def py_setRXAddr(char pipe, addr, char len):             # <<<<<<<<<<<<<<
 *     cdef char *addrptr
 *     addrptr = <char *>malloc(len)
 */

static PyObject *__pyx_pf_8py_nRFSN_13py_setRXAddr(PyObject *__pyx_self, PyObject *__pyx_args, PyObject *__pyx_kwds); /*proto*/
static PyMethodDef __pyx_mdef_8py_nRFSN_13py_setRXAddr = {__Pyx_NAMESTR("py_setRXAddr"), (PyCFunction)__pyx_pf_8py_nRFSN_13py_setRXAddr, METH_VARARGS|METH_KEYWORDS, __Pyx_DOCSTR(0)};
static PyObject *__pyx_pf_8py_nRFSN_13py_setRXAddr(PyObject *__pyx_self, PyObject *__pyx_args, PyObject *__pyx_kwds) {
  char __pyx_v_pipe;
  PyObject *__pyx_v_addr = 0;
  char __pyx_v_len;
  char *__pyx_v_addrptr;
  char __pyx_v_i;
  PyObject *__pyx_r = NULL;
  __Pyx_RefNannyDeclarations
  char __pyx_t_1;
  char __pyx_t_2;
  PyObject *__pyx_t_3 = NULL;
  char __pyx_t_4;
  int __pyx_lineno = 0;
  const char *__pyx_filename = NULL;
  int __pyx_clineno = 0;
  static PyObject **__pyx_pyargnames[] = {&__pyx_n_s__pipe,&__pyx_n_s__addr,&__pyx_n_s__len,0};
  __Pyx_RefNannySetupContext("py_setRXAddr");
  __pyx_self = __pyx_self;
  {
    PyObject* values[3] = {0,0,0};
    if (unlikely(__pyx_kwds)) {
      Py_ssize_t kw_args;
      switch (PyTuple_GET_SIZE(__pyx_args)) {
        case  3: values[2] = PyTuple_GET_ITEM(__pyx_args, 2);
        case  2: values[1] = PyTuple_GET_ITEM(__pyx_args, 1);
        case  1: values[0] = PyTuple_GET_ITEM(__pyx_args, 0);
        case  0: break;
        default: goto __pyx_L5_argtuple_error;
      }
      kw_args = PyDict_Size(__pyx_kwds);
      switch (PyTuple_GET_SIZE(__pyx_args)) {
        case  0:
        values[0] = PyDict_GetItem(__pyx_kwds, __pyx_n_s__pipe);
        if (likely(values[0])) kw_args--;
        else goto __pyx_L5_argtuple_error;
        case  1:
        values[1] = PyDict_GetItem(__pyx_kwds, __pyx_n_s__addr);
        if (likely(values[1])) kw_args--;
        else {
          __Pyx_RaiseArgtupleInvalid("py_setRXAddr", 1, 3, 3, 1); {__pyx_filename = __pyx_f[0]; __pyx_lineno = 54; __pyx_clineno = __LINE__; goto __pyx_L3_error;}
        }
        case  2:
        values[2] = PyDict_GetItem(__pyx_kwds, __pyx_n_s__len);
        if (likely(values[2])) kw_args--;
        else {
          __Pyx_RaiseArgtupleInvalid("py_setRXAddr", 1, 3, 3, 2); {__pyx_filename = __pyx_f[0]; __pyx_lineno = 54; __pyx_clineno = __LINE__; goto __pyx_L3_error;}
        }
      }
      if (unlikely(kw_args > 0)) {
        if (unlikely(__Pyx_ParseOptionalKeywords(__pyx_kwds, __pyx_pyargnames, 0, values, PyTuple_GET_SIZE(__pyx_args), "py_setRXAddr") < 0)) {__pyx_filename = __pyx_f[0]; __pyx_lineno = 54; __pyx_clineno = __LINE__; goto __pyx_L3_error;}
      }
    } else if (PyTuple_GET_SIZE(__pyx_args) != 3) {
      goto __pyx_L5_argtuple_error;
    } else {
      values[0] = PyTuple_GET_ITEM(__pyx_args, 0);
      values[1] = PyTuple_GET_ITEM(__pyx_args, 1);
      values[2] = PyTuple_GET_ITEM(__pyx_args, 2);
    }
    __pyx_v_pipe = __Pyx_PyInt_AsChar(values[0]); if (unlikely((__pyx_v_pipe == (char)-1) && PyErr_Occurred())) {__pyx_filename = __pyx_f[0]; __pyx_lineno = 54; __pyx_clineno = __LINE__; goto __pyx_L3_error;}
    __pyx_v_addr = values[1];
    __pyx_v_len = __Pyx_PyInt_AsChar(values[2]); if (unlikely((__pyx_v_len == (char)-1) && PyErr_Occurred())) {__pyx_filename = __pyx_f[0]; __pyx_lineno = 54; __pyx_clineno = __LINE__; goto __pyx_L3_error;}
  }
  goto __pyx_L4_argument_unpacking_done;
  __pyx_L5_argtuple_error:;
  __Pyx_RaiseArgtupleInvalid("py_setRXAddr", 1, 3, 3, PyTuple_GET_SIZE(__pyx_args)); {__pyx_filename = __pyx_f[0]; __pyx_lineno = 54; __pyx_clineno = __LINE__; goto __pyx_L3_error;}
  __pyx_L3_error:;
  __Pyx_AddTraceback("py_nRFSN.py_setRXAddr", __pyx_clineno, __pyx_lineno, __pyx_filename);
  __Pyx_RefNannyFinishContext();
  return NULL;
  __pyx_L4_argument_unpacking_done:;

  /* "py_nRFSN.pyx":56
 * def py_setRXAddr(char pipe, addr, char len):
 *     cdef char *addrptr
 *     addrptr = <char *>malloc(len)             # <<<<<<<<<<<<<<
 *     for i in xrange(len):
 *         addrptr[i] = addr[i]
 */
  __pyx_v_addrptr = ((char *)malloc(__pyx_v_len));

  /* "py_nRFSN.pyx":57
 *     cdef char *addrptr
 *     addrptr = <char *>malloc(len)
 *     for i in xrange(len):             # <<<<<<<<<<<<<<
 *         addrptr[i] = addr[i]
 *     defns.setRXAddr(pipe, addrptr, len)
 */
  __pyx_t_1 = __pyx_v_len;
  for (__pyx_t_2 = 0; __pyx_t_2 < __pyx_t_1; __pyx_t_2+=1) {
    __pyx_v_i = __pyx_t_2;

    /* "py_nRFSN.pyx":58
 *     addrptr = <char *>malloc(len)
 *     for i in xrange(len):
 *         addrptr[i] = addr[i]             # <<<<<<<<<<<<<<
 *     defns.setRXAddr(pipe, addrptr, len)
 *     free(addrptr) # free memory after function is complete
 */
    __pyx_t_3 = __Pyx_GetItemInt(__pyx_v_addr, __pyx_v_i, sizeof(char), PyInt_FromLong); if (!__pyx_t_3) {__pyx_filename = __pyx_f[0]; __pyx_lineno = 58; __pyx_clineno = __LINE__; goto __pyx_L1_error;}
    __Pyx_GOTREF(__pyx_t_3);
    __pyx_t_4 = __Pyx_PyInt_AsChar(__pyx_t_3); if (unlikely((__pyx_t_4 == (char)-1) && PyErr_Occurred())) {__pyx_filename = __pyx_f[0]; __pyx_lineno = 58; __pyx_clineno = __LINE__; goto __pyx_L1_error;}
    __Pyx_DECREF(__pyx_t_3); __pyx_t_3 = 0;
    (__pyx_v_addrptr[__pyx_v_i]) = __pyx_t_4;
  }

  /* "py_nRFSN.pyx":59
 *     for i in xrange(len):
 *         addrptr[i] = addr[i]
 *     defns.setRXAddr(pipe, addrptr, len)             # <<<<<<<<<<<<<<
 *     free(addrptr) # free memory after function is complete
 * 
 */
  setRXAddr(__pyx_v_pipe, __pyx_v_addrptr, __pyx_v_len);

  /* "py_nRFSN.pyx":60
 *         addrptr[i] = addr[i]
 *     defns.setRXAddr(pipe, addrptr, len)
 *     free(addrptr) # free memory after function is complete             # <<<<<<<<<<<<<<
 * 
 * def py_getTXAddr():
 */
  free(__pyx_v_addrptr);

  __pyx_r = Py_None; __Pyx_INCREF(Py_None);
  goto __pyx_L0;
  __pyx_L1_error:;
  __Pyx_XDECREF(__pyx_t_3);
  __Pyx_AddTraceback("py_nRFSN.py_setRXAddr", __pyx_clineno, __pyx_lineno, __pyx_filename);
  __pyx_r = NULL;
  __pyx_L0:;
  __Pyx_XGIVEREF(__pyx_r);
  __Pyx_RefNannyFinishContext();
  return __pyx_r;
}

/* "py_nRFSN.pyx":62
 *     free(addrptr) # free memory after function is complete
 * 
 * def py_getTXAddr():             # <<<<<<<<<<<<<<
 *     cdef char* addr = defns.getTXAddr()
 *     return addr
 */

static PyObject *__pyx_pf_8py_nRFSN_14py_getTXAddr(PyObject *__pyx_self, CYTHON_UNUSED PyObject *unused); /*proto*/
static PyMethodDef __pyx_mdef_8py_nRFSN_14py_getTXAddr = {__Pyx_NAMESTR("py_getTXAddr"), (PyCFunction)__pyx_pf_8py_nRFSN_14py_getTXAddr, METH_NOARGS, __Pyx_DOCSTR(0)};
static PyObject *__pyx_pf_8py_nRFSN_14py_getTXAddr(PyObject *__pyx_self, CYTHON_UNUSED PyObject *unused) {
  char *__pyx_v_addr;
  PyObject *__pyx_r = NULL;
  __Pyx_RefNannyDeclarations
  PyObject *__pyx_t_1 = NULL;
  int __pyx_lineno = 0;
  const char *__pyx_filename = NULL;
  int __pyx_clineno = 0;
  __Pyx_RefNannySetupContext("py_getTXAddr");
  __pyx_self = __pyx_self;

  /* "py_nRFSN.pyx":63
 * 
 * def py_getTXAddr():
 *     cdef char* addr = defns.getTXAddr()             # <<<<<<<<<<<<<<
 *     return addr
 * 
 */
  __pyx_v_addr = getTXAddr();

  /* "py_nRFSN.pyx":64
 * def py_getTXAddr():
 *     cdef char* addr = defns.getTXAddr()
 *     return addr             # <<<<<<<<<<<<<<
 * 
 * def py_getRXAddr(char pipe):
 */
  __Pyx_XDECREF(__pyx_r);
  __pyx_t_1 = PyBytes_FromString(__pyx_v_addr); if (unlikely(!__pyx_t_1)) {__pyx_filename = __pyx_f[0]; __pyx_lineno = 64; __pyx_clineno = __LINE__; goto __pyx_L1_error;}
  __Pyx_GOTREF(((PyObject *)__pyx_t_1));
  __pyx_r = ((PyObject *)__pyx_t_1);
  __pyx_t_1 = 0;
  goto __pyx_L0;

  __pyx_r = Py_None; __Pyx_INCREF(Py_None);
  goto __pyx_L0;
  __pyx_L1_error:;
  __Pyx_XDECREF(__pyx_t_1);
  __Pyx_AddTraceback("py_nRFSN.py_getTXAddr", __pyx_clineno, __pyx_lineno, __pyx_filename);
  __pyx_r = NULL;
  __pyx_L0:;
  __Pyx_XGIVEREF(__pyx_r);
  __Pyx_RefNannyFinishContext();
  return __pyx_r;
}

/* "py_nRFSN.pyx":66
 *     return addr
 * 
 * def py_getRXAddr(char pipe):             # <<<<<<<<<<<<<<
 *     cdef char* addr = defns.getRXAddr(pipe)
 *     return addr
 */

static PyObject *__pyx_pf_8py_nRFSN_15py_getRXAddr(PyObject *__pyx_self, PyObject *__pyx_arg_pipe); /*proto*/
static PyMethodDef __pyx_mdef_8py_nRFSN_15py_getRXAddr = {__Pyx_NAMESTR("py_getRXAddr"), (PyCFunction)__pyx_pf_8py_nRFSN_15py_getRXAddr, METH_O, __Pyx_DOCSTR(0)};
static PyObject *__pyx_pf_8py_nRFSN_15py_getRXAddr(PyObject *__pyx_self, PyObject *__pyx_arg_pipe) {
  char __pyx_v_pipe;
  char *__pyx_v_addr;
  PyObject *__pyx_r = NULL;
  __Pyx_RefNannyDeclarations
  PyObject *__pyx_t_1 = NULL;
  int __pyx_lineno = 0;
  const char *__pyx_filename = NULL;
  int __pyx_clineno = 0;
  __Pyx_RefNannySetupContext("py_getRXAddr");
  __pyx_self = __pyx_self;
  assert(__pyx_arg_pipe); {
    __pyx_v_pipe = __Pyx_PyInt_AsChar(__pyx_arg_pipe); if (unlikely((__pyx_v_pipe == (char)-1) && PyErr_Occurred())) {__pyx_filename = __pyx_f[0]; __pyx_lineno = 66; __pyx_clineno = __LINE__; goto __pyx_L3_error;}
  }
  goto __pyx_L4_argument_unpacking_done;
  __pyx_L3_error:;
  __Pyx_AddTraceback("py_nRFSN.py_getRXAddr", __pyx_clineno, __pyx_lineno, __pyx_filename);
  __Pyx_RefNannyFinishContext();
  return NULL;
  __pyx_L4_argument_unpacking_done:;

  /* "py_nRFSN.pyx":67
 * 
 * def py_getRXAddr(char pipe):
 *     cdef char* addr = defns.getRXAddr(pipe)             # <<<<<<<<<<<<<<
 *     return addr
 * 
 */
  __pyx_v_addr = getRXAddr(__pyx_v_pipe);

  /* "py_nRFSN.pyx":68
 * def py_getRXAddr(char pipe):
 *     cdef char* addr = defns.getRXAddr(pipe)
 *     return addr             # <<<<<<<<<<<<<<
 * 
 * def py_clearInt(char intr):
 */
  __Pyx_XDECREF(__pyx_r);
  __pyx_t_1 = PyBytes_FromString(__pyx_v_addr); if (unlikely(!__pyx_t_1)) {__pyx_filename = __pyx_f[0]; __pyx_lineno = 68; __pyx_clineno = __LINE__; goto __pyx_L1_error;}
  __Pyx_GOTREF(((PyObject *)__pyx_t_1));
  __pyx_r = ((PyObject *)__pyx_t_1);
  __pyx_t_1 = 0;
  goto __pyx_L0;

  __pyx_r = Py_None; __Pyx_INCREF(Py_None);
  goto __pyx_L0;
  __pyx_L1_error:;
  __Pyx_XDECREF(__pyx_t_1);
  __Pyx_AddTraceback("py_nRFSN.py_getRXAddr", __pyx_clineno, __pyx_lineno, __pyx_filename);
  __pyx_r = NULL;
  __pyx_L0:;
  __Pyx_XGIVEREF(__pyx_r);
  __Pyx_RefNannyFinishContext();
  return __pyx_r;
}

/* "py_nRFSN.pyx":70
 *     return addr
 * 
 * def py_clearInt(char intr):             # <<<<<<<<<<<<<<
 *     defns.clearInt(intr)
 * 
 */

static PyObject *__pyx_pf_8py_nRFSN_16py_clearInt(PyObject *__pyx_self, PyObject *__pyx_arg_intr); /*proto*/
static PyMethodDef __pyx_mdef_8py_nRFSN_16py_clearInt = {__Pyx_NAMESTR("py_clearInt"), (PyCFunction)__pyx_pf_8py_nRFSN_16py_clearInt, METH_O, __Pyx_DOCSTR(0)};
static PyObject *__pyx_pf_8py_nRFSN_16py_clearInt(PyObject *__pyx_self, PyObject *__pyx_arg_intr) {
  char __pyx_v_intr;
  PyObject *__pyx_r = NULL;
  __Pyx_RefNannyDeclarations
  int __pyx_lineno = 0;
  const char *__pyx_filename = NULL;
  int __pyx_clineno = 0;
  __Pyx_RefNannySetupContext("py_clearInt");
  __pyx_self = __pyx_self;
  assert(__pyx_arg_intr); {
    __pyx_v_intr = __Pyx_PyInt_AsChar(__pyx_arg_intr); if (unlikely((__pyx_v_intr == (char)-1) && PyErr_Occurred())) {__pyx_filename = __pyx_f[0]; __pyx_lineno = 70; __pyx_clineno = __LINE__; goto __pyx_L3_error;}
  }
  goto __pyx_L4_argument_unpacking_done;
  __pyx_L3_error:;
  __Pyx_AddTraceback("py_nRFSN.py_clearInt", __pyx_clineno, __pyx_lineno, __pyx_filename);
  __Pyx_RefNannyFinishContext();
  return NULL;
  __pyx_L4_argument_unpacking_done:;

  /* "py_nRFSN.pyx":71
 * 
 * def py_clearInt(char intr):
 *     defns.clearInt(intr)             # <<<<<<<<<<<<<<
 * 
 * def py_updateStatus():
 */
  clearInt(__pyx_v_intr);

  __pyx_r = Py_None; __Pyx_INCREF(Py_None);
  __Pyx_XGIVEREF(__pyx_r);
  __Pyx_RefNannyFinishContext();
  return __pyx_r;
}

/* "py_nRFSN.pyx":73
 *     defns.clearInt(intr)
 * 
 * def py_updateStatus():             # <<<<<<<<<<<<<<
 *     return defns.updateStatus()
 * 
 */

static PyObject *__pyx_pf_8py_nRFSN_17py_updateStatus(PyObject *__pyx_self, CYTHON_UNUSED PyObject *unused); /*proto*/
static PyMethodDef __pyx_mdef_8py_nRFSN_17py_updateStatus = {__Pyx_NAMESTR("py_updateStatus"), (PyCFunction)__pyx_pf_8py_nRFSN_17py_updateStatus, METH_NOARGS, __Pyx_DOCSTR(0)};
static PyObject *__pyx_pf_8py_nRFSN_17py_updateStatus(PyObject *__pyx_self, CYTHON_UNUSED PyObject *unused) {
  PyObject *__pyx_r = NULL;
  __Pyx_RefNannyDeclarations
  PyObject *__pyx_t_1 = NULL;
  int __pyx_lineno = 0;
  const char *__pyx_filename = NULL;
  int __pyx_clineno = 0;
  __Pyx_RefNannySetupContext("py_updateStatus");
  __pyx_self = __pyx_self;

  /* "py_nRFSN.pyx":74
 * 
 * def py_updateStatus():
 *     return defns.updateStatus()             # <<<<<<<<<<<<<<
 * 
 * def py_transmit(char len):
 */
  __Pyx_XDECREF(__pyx_r);
  __pyx_t_1 = PyInt_FromLong(updateStatus()); if (unlikely(!__pyx_t_1)) {__pyx_filename = __pyx_f[0]; __pyx_lineno = 74; __pyx_clineno = __LINE__; goto __pyx_L1_error;}
  __Pyx_GOTREF(__pyx_t_1);
  __pyx_r = __pyx_t_1;
  __pyx_t_1 = 0;
  goto __pyx_L0;

  __pyx_r = Py_None; __Pyx_INCREF(Py_None);
  goto __pyx_L0;
  __pyx_L1_error:;
  __Pyx_XDECREF(__pyx_t_1);
  __Pyx_AddTraceback("py_nRFSN.py_updateStatus", __pyx_clineno, __pyx_lineno, __pyx_filename);
  __pyx_r = NULL;
  __pyx_L0:;
  __Pyx_XGIVEREF(__pyx_r);
  __Pyx_RefNannyFinishContext();
  return __pyx_r;
}

/* "py_nRFSN.pyx":76
 *     return defns.updateStatus()
 * 
 * def py_transmit(char len):             # <<<<<<<<<<<<<<
 *     defns.transmit(len)
 * 
 */

static PyObject *__pyx_pf_8py_nRFSN_18py_transmit(PyObject *__pyx_self, PyObject *__pyx_arg_len); /*proto*/
static PyMethodDef __pyx_mdef_8py_nRFSN_18py_transmit = {__Pyx_NAMESTR("py_transmit"), (PyCFunction)__pyx_pf_8py_nRFSN_18py_transmit, METH_O, __Pyx_DOCSTR(0)};
static PyObject *__pyx_pf_8py_nRFSN_18py_transmit(PyObject *__pyx_self, PyObject *__pyx_arg_len) {
  char __pyx_v_len;
  PyObject *__pyx_r = NULL;
  __Pyx_RefNannyDeclarations
  int __pyx_lineno = 0;
  const char *__pyx_filename = NULL;
  int __pyx_clineno = 0;
  __Pyx_RefNannySetupContext("py_transmit");
  __pyx_self = __pyx_self;
  assert(__pyx_arg_len); {
    __pyx_v_len = __Pyx_PyInt_AsChar(__pyx_arg_len); if (unlikely((__pyx_v_len == (char)-1) && PyErr_Occurred())) {__pyx_filename = __pyx_f[0]; __pyx_lineno = 76; __pyx_clineno = __LINE__; goto __pyx_L3_error;}
  }
  goto __pyx_L4_argument_unpacking_done;
  __pyx_L3_error:;
  __Pyx_AddTraceback("py_nRFSN.py_transmit", __pyx_clineno, __pyx_lineno, __pyx_filename);
  __Pyx_RefNannyFinishContext();
  return NULL;
  __pyx_L4_argument_unpacking_done:;

  /* "py_nRFSN.pyx":77
 * 
 * def py_transmit(char len):
 *     defns.transmit(len)             # <<<<<<<<<<<<<<
 * 
 * def py_getPayloadSize():
 */
  transmit(__pyx_v_len);

  __pyx_r = Py_None; __Pyx_INCREF(Py_None);
  __Pyx_XGIVEREF(__pyx_r);
  __Pyx_RefNannyFinishContext();
  return __pyx_r;
}

/* "py_nRFSN.pyx":79
 *     defns.transmit(len)
 * 
 * def py_getPayloadSize():             # <<<<<<<<<<<<<<
 *     return defns.getPayloadSize()
 * 
 */

static PyObject *__pyx_pf_8py_nRFSN_19py_getPayloadSize(PyObject *__pyx_self, CYTHON_UNUSED PyObject *unused); /*proto*/
static PyMethodDef __pyx_mdef_8py_nRFSN_19py_getPayloadSize = {__Pyx_NAMESTR("py_getPayloadSize"), (PyCFunction)__pyx_pf_8py_nRFSN_19py_getPayloadSize, METH_NOARGS, __Pyx_DOCSTR(0)};
static PyObject *__pyx_pf_8py_nRFSN_19py_getPayloadSize(PyObject *__pyx_self, CYTHON_UNUSED PyObject *unused) {
  PyObject *__pyx_r = NULL;
  __Pyx_RefNannyDeclarations
  PyObject *__pyx_t_1 = NULL;
  int __pyx_lineno = 0;
  const char *__pyx_filename = NULL;
  int __pyx_clineno = 0;
  __Pyx_RefNannySetupContext("py_getPayloadSize");
  __pyx_self = __pyx_self;

  /* "py_nRFSN.pyx":80
 * 
 * def py_getPayloadSize():
 *     return defns.getPayloadSize()             # <<<<<<<<<<<<<<
 * 
 * def py_getPayload(char len):
 */
  __Pyx_XDECREF(__pyx_r);
  __pyx_t_1 = PyInt_FromLong(getPayloadSize()); if (unlikely(!__pyx_t_1)) {__pyx_filename = __pyx_f[0]; __pyx_lineno = 80; __pyx_clineno = __LINE__; goto __pyx_L1_error;}
  __Pyx_GOTREF(__pyx_t_1);
  __pyx_r = __pyx_t_1;
  __pyx_t_1 = 0;
  goto __pyx_L0;

  __pyx_r = Py_None; __Pyx_INCREF(Py_None);
  goto __pyx_L0;
  __pyx_L1_error:;
  __Pyx_XDECREF(__pyx_t_1);
  __Pyx_AddTraceback("py_nRFSN.py_getPayloadSize", __pyx_clineno, __pyx_lineno, __pyx_filename);
  __pyx_r = NULL;
  __pyx_L0:;
  __Pyx_XGIVEREF(__pyx_r);
  __Pyx_RefNannyFinishContext();
  return __pyx_r;
}

/* "py_nRFSN.pyx":82
 *     return defns.getPayloadSize()
 * 
 * def py_getPayload(char len):             # <<<<<<<<<<<<<<
 *     defns.getPayload(len)
 * 
 */

static PyObject *__pyx_pf_8py_nRFSN_20py_getPayload(PyObject *__pyx_self, PyObject *__pyx_arg_len); /*proto*/
static PyMethodDef __pyx_mdef_8py_nRFSN_20py_getPayload = {__Pyx_NAMESTR("py_getPayload"), (PyCFunction)__pyx_pf_8py_nRFSN_20py_getPayload, METH_O, __Pyx_DOCSTR(0)};
static PyObject *__pyx_pf_8py_nRFSN_20py_getPayload(PyObject *__pyx_self, PyObject *__pyx_arg_len) {
  char __pyx_v_len;
  PyObject *__pyx_r = NULL;
  __Pyx_RefNannyDeclarations
  int __pyx_lineno = 0;
  const char *__pyx_filename = NULL;
  int __pyx_clineno = 0;
  __Pyx_RefNannySetupContext("py_getPayload");
  __pyx_self = __pyx_self;
  assert(__pyx_arg_len); {
    __pyx_v_len = __Pyx_PyInt_AsChar(__pyx_arg_len); if (unlikely((__pyx_v_len == (char)-1) && PyErr_Occurred())) {__pyx_filename = __pyx_f[0]; __pyx_lineno = 82; __pyx_clineno = __LINE__; goto __pyx_L3_error;}
  }
  goto __pyx_L4_argument_unpacking_done;
  __pyx_L3_error:;
  __Pyx_AddTraceback("py_nRFSN.py_getPayload", __pyx_clineno, __pyx_lineno, __pyx_filename);
  __Pyx_RefNannyFinishContext();
  return NULL;
  __pyx_L4_argument_unpacking_done:;

  /* "py_nRFSN.pyx":83
 * 
 * def py_getPayload(char len):
 *     defns.getPayload(len)             # <<<<<<<<<<<<<<
 * 
 * def py_putBufOut(buf, char len):
 */
  getPayload(__pyx_v_len);

  __pyx_r = Py_None; __Pyx_INCREF(Py_None);
  __Pyx_XGIVEREF(__pyx_r);
  __Pyx_RefNannyFinishContext();
  return __pyx_r;
}

/* "py_nRFSN.pyx":85
 *     defns.getPayload(len)
 * 
 * def py_putBufOut(buf, char len):             # <<<<<<<<<<<<<<
 *     cdef char *bufptr
 *     bufptr = <char *>malloc(len)
 */

static PyObject *__pyx_pf_8py_nRFSN_21py_putBufOut(PyObject *__pyx_self, PyObject *__pyx_args, PyObject *__pyx_kwds); /*proto*/
static PyMethodDef __pyx_mdef_8py_nRFSN_21py_putBufOut = {__Pyx_NAMESTR("py_putBufOut"), (PyCFunction)__pyx_pf_8py_nRFSN_21py_putBufOut, METH_VARARGS|METH_KEYWORDS, __Pyx_DOCSTR(0)};
static PyObject *__pyx_pf_8py_nRFSN_21py_putBufOut(PyObject *__pyx_self, PyObject *__pyx_args, PyObject *__pyx_kwds) {
  PyObject *__pyx_v_buf = 0;
  char __pyx_v_len;
  char *__pyx_v_bufptr;
  char __pyx_v_i;
  PyObject *__pyx_r = NULL;
  __Pyx_RefNannyDeclarations
  char __pyx_t_1;
  char __pyx_t_2;
  PyObject *__pyx_t_3 = NULL;
  char __pyx_t_4;
  int __pyx_lineno = 0;
  const char *__pyx_filename = NULL;
  int __pyx_clineno = 0;
  static PyObject **__pyx_pyargnames[] = {&__pyx_n_s__buf,&__pyx_n_s__len,0};
  __Pyx_RefNannySetupContext("py_putBufOut");
  __pyx_self = __pyx_self;
  {
    PyObject* values[2] = {0,0};
    if (unlikely(__pyx_kwds)) {
      Py_ssize_t kw_args;
      switch (PyTuple_GET_SIZE(__pyx_args)) {
        case  2: values[1] = PyTuple_GET_ITEM(__pyx_args, 1);
        case  1: values[0] = PyTuple_GET_ITEM(__pyx_args, 0);
        case  0: break;
        default: goto __pyx_L5_argtuple_error;
      }
      kw_args = PyDict_Size(__pyx_kwds);
      switch (PyTuple_GET_SIZE(__pyx_args)) {
        case  0:
        values[0] = PyDict_GetItem(__pyx_kwds, __pyx_n_s__buf);
        if (likely(values[0])) kw_args--;
        else goto __pyx_L5_argtuple_error;
        case  1:
        values[1] = PyDict_GetItem(__pyx_kwds, __pyx_n_s__len);
        if (likely(values[1])) kw_args--;
        else {
          __Pyx_RaiseArgtupleInvalid("py_putBufOut", 1, 2, 2, 1); {__pyx_filename = __pyx_f[0]; __pyx_lineno = 85; __pyx_clineno = __LINE__; goto __pyx_L3_error;}
        }
      }
      if (unlikely(kw_args > 0)) {
        if (unlikely(__Pyx_ParseOptionalKeywords(__pyx_kwds, __pyx_pyargnames, 0, values, PyTuple_GET_SIZE(__pyx_args), "py_putBufOut") < 0)) {__pyx_filename = __pyx_f[0]; __pyx_lineno = 85; __pyx_clineno = __LINE__; goto __pyx_L3_error;}
      }
    } else if (PyTuple_GET_SIZE(__pyx_args) != 2) {
      goto __pyx_L5_argtuple_error;
    } else {
      values[0] = PyTuple_GET_ITEM(__pyx_args, 0);
      values[1] = PyTuple_GET_ITEM(__pyx_args, 1);
    }
    __pyx_v_buf = values[0];
    __pyx_v_len = __Pyx_PyInt_AsChar(values[1]); if (unlikely((__pyx_v_len == (char)-1) && PyErr_Occurred())) {__pyx_filename = __pyx_f[0]; __pyx_lineno = 85; __pyx_clineno = __LINE__; goto __pyx_L3_error;}
  }
  goto __pyx_L4_argument_unpacking_done;
  __pyx_L5_argtuple_error:;
  __Pyx_RaiseArgtupleInvalid("py_putBufOut", 1, 2, 2, PyTuple_GET_SIZE(__pyx_args)); {__pyx_filename = __pyx_f[0]; __pyx_lineno = 85; __pyx_clineno = __LINE__; goto __pyx_L3_error;}
  __pyx_L3_error:;
  __Pyx_AddTraceback("py_nRFSN.py_putBufOut", __pyx_clineno, __pyx_lineno, __pyx_filename);
  __Pyx_RefNannyFinishContext();
  return NULL;
  __pyx_L4_argument_unpacking_done:;

  /* "py_nRFSN.pyx":87
 * def py_putBufOut(buf, char len):
 *     cdef char *bufptr
 *     bufptr = <char *>malloc(len)             # <<<<<<<<<<<<<<
 *     for i in xrange(len):
 *         bufptr[i] = buf[i]
 */
  __pyx_v_bufptr = ((char *)malloc(__pyx_v_len));

  /* "py_nRFSN.pyx":88
 *     cdef char *bufptr
 *     bufptr = <char *>malloc(len)
 *     for i in xrange(len):             # <<<<<<<<<<<<<<
 *         bufptr[i] = buf[i]
 *     defns.putBufOut(bufptr, len)
 */
  __pyx_t_1 = __pyx_v_len;
  for (__pyx_t_2 = 0; __pyx_t_2 < __pyx_t_1; __pyx_t_2+=1) {
    __pyx_v_i = __pyx_t_2;

    /* "py_nRFSN.pyx":89
 *     bufptr = <char *>malloc(len)
 *     for i in xrange(len):
 *         bufptr[i] = buf[i]             # <<<<<<<<<<<<<<
 *     defns.putBufOut(bufptr, len)
 *     free(bufptr) # free memory after function is complete
 */
    __pyx_t_3 = __Pyx_GetItemInt(__pyx_v_buf, __pyx_v_i, sizeof(char), PyInt_FromLong); if (!__pyx_t_3) {__pyx_filename = __pyx_f[0]; __pyx_lineno = 89; __pyx_clineno = __LINE__; goto __pyx_L1_error;}
    __Pyx_GOTREF(__pyx_t_3);
    __pyx_t_4 = __Pyx_PyInt_AsChar(__pyx_t_3); if (unlikely((__pyx_t_4 == (char)-1) && PyErr_Occurred())) {__pyx_filename = __pyx_f[0]; __pyx_lineno = 89; __pyx_clineno = __LINE__; goto __pyx_L1_error;}
    __Pyx_DECREF(__pyx_t_3); __pyx_t_3 = 0;
    (__pyx_v_bufptr[__pyx_v_i]) = __pyx_t_4;
  }

  /* "py_nRFSN.pyx":90
 *     for i in xrange(len):
 *         bufptr[i] = buf[i]
 *     defns.putBufOut(bufptr, len)             # <<<<<<<<<<<<<<
 *     free(bufptr) # free memory after function is complete
 * 
 */
  putBufOut(__pyx_v_bufptr, __pyx_v_len);

  /* "py_nRFSN.pyx":91
 *         bufptr[i] = buf[i]
 *     defns.putBufOut(bufptr, len)
 *     free(bufptr) # free memory after function is complete             # <<<<<<<<<<<<<<
 * 
 * def py_putSingleBufOut(char data):
 */
  free(__pyx_v_bufptr);

  __pyx_r = Py_None; __Pyx_INCREF(Py_None);
  goto __pyx_L0;
  __pyx_L1_error:;
  __Pyx_XDECREF(__pyx_t_3);
  __Pyx_AddTraceback("py_nRFSN.py_putBufOut", __pyx_clineno, __pyx_lineno, __pyx_filename);
  __pyx_r = NULL;
  __pyx_L0:;
  __Pyx_XGIVEREF(__pyx_r);
  __Pyx_RefNannyFinishContext();
  return __pyx_r;
}

/* "py_nRFSN.pyx":93
 *     free(bufptr) # free memory after function is complete
 * 
 * def py_putSingleBufOut(char data):             # <<<<<<<<<<<<<<
 *     defns.putSingleBufOut(data)
 * 
 */

static PyObject *__pyx_pf_8py_nRFSN_22py_putSingleBufOut(PyObject *__pyx_self, PyObject *__pyx_arg_data); /*proto*/
static PyMethodDef __pyx_mdef_8py_nRFSN_22py_putSingleBufOut = {__Pyx_NAMESTR("py_putSingleBufOut"), (PyCFunction)__pyx_pf_8py_nRFSN_22py_putSingleBufOut, METH_O, __Pyx_DOCSTR(0)};
static PyObject *__pyx_pf_8py_nRFSN_22py_putSingleBufOut(PyObject *__pyx_self, PyObject *__pyx_arg_data) {
  char __pyx_v_data;
  PyObject *__pyx_r = NULL;
  __Pyx_RefNannyDeclarations
  int __pyx_lineno = 0;
  const char *__pyx_filename = NULL;
  int __pyx_clineno = 0;
  __Pyx_RefNannySetupContext("py_putSingleBufOut");
  __pyx_self = __pyx_self;
  assert(__pyx_arg_data); {
    __pyx_v_data = __Pyx_PyInt_AsChar(__pyx_arg_data); if (unlikely((__pyx_v_data == (char)-1) && PyErr_Occurred())) {__pyx_filename = __pyx_f[0]; __pyx_lineno = 93; __pyx_clineno = __LINE__; goto __pyx_L3_error;}
  }
  goto __pyx_L4_argument_unpacking_done;
  __pyx_L3_error:;
  __Pyx_AddTraceback("py_nRFSN.py_putSingleBufOut", __pyx_clineno, __pyx_lineno, __pyx_filename);
  __Pyx_RefNannyFinishContext();
  return NULL;
  __pyx_L4_argument_unpacking_done:;

  /* "py_nRFSN.pyx":94
 * 
 * def py_putSingleBufOut(char data):
 *     defns.putSingleBufOut(data)             # <<<<<<<<<<<<<<
 * 
 * def py_getBufIn(char len):
 */
  putSingleBufOut(__pyx_v_data);

  __pyx_r = Py_None; __Pyx_INCREF(Py_None);
  __Pyx_XGIVEREF(__pyx_r);
  __Pyx_RefNannyFinishContext();
  return __pyx_r;
}

/* "py_nRFSN.pyx":96
 *     defns.putSingleBufOut(data)
 * 
 * def py_getBufIn(char len):             # <<<<<<<<<<<<<<
 *     cdef char* data = defns.getBufIn(len)
 *     return data
 */

static PyObject *__pyx_pf_8py_nRFSN_23py_getBufIn(PyObject *__pyx_self, PyObject *__pyx_arg_len); /*proto*/
static PyMethodDef __pyx_mdef_8py_nRFSN_23py_getBufIn = {__Pyx_NAMESTR("py_getBufIn"), (PyCFunction)__pyx_pf_8py_nRFSN_23py_getBufIn, METH_O, __Pyx_DOCSTR(0)};
static PyObject *__pyx_pf_8py_nRFSN_23py_getBufIn(PyObject *__pyx_self, PyObject *__pyx_arg_len) {
  char __pyx_v_len;
  char *__pyx_v_data;
  PyObject *__pyx_r = NULL;
  __Pyx_RefNannyDeclarations
  PyObject *__pyx_t_1 = NULL;
  int __pyx_lineno = 0;
  const char *__pyx_filename = NULL;
  int __pyx_clineno = 0;
  __Pyx_RefNannySetupContext("py_getBufIn");
  __pyx_self = __pyx_self;
  assert(__pyx_arg_len); {
    __pyx_v_len = __Pyx_PyInt_AsChar(__pyx_arg_len); if (unlikely((__pyx_v_len == (char)-1) && PyErr_Occurred())) {__pyx_filename = __pyx_f[0]; __pyx_lineno = 96; __pyx_clineno = __LINE__; goto __pyx_L3_error;}
  }
  goto __pyx_L4_argument_unpacking_done;
  __pyx_L3_error:;
  __Pyx_AddTraceback("py_nRFSN.py_getBufIn", __pyx_clineno, __pyx_lineno, __pyx_filename);
  __Pyx_RefNannyFinishContext();
  return NULL;
  __pyx_L4_argument_unpacking_done:;

  /* "py_nRFSN.pyx":97
 * 
 * def py_getBufIn(char len):
 *     cdef char* data = defns.getBufIn(len)             # <<<<<<<<<<<<<<
 *     return data
 * 
 */
  __pyx_v_data = getBufIn(__pyx_v_len);

  /* "py_nRFSN.pyx":98
 * def py_getBufIn(char len):
 *     cdef char* data = defns.getBufIn(len)
 *     return data             # <<<<<<<<<<<<<<
 * 
 * def py_flush(int buf):  # (0) RX (1) TX
 */
  __Pyx_XDECREF(__pyx_r);
  __pyx_t_1 = PyBytes_FromString(__pyx_v_data); if (unlikely(!__pyx_t_1)) {__pyx_filename = __pyx_f[0]; __pyx_lineno = 98; __pyx_clineno = __LINE__; goto __pyx_L1_error;}
  __Pyx_GOTREF(((PyObject *)__pyx_t_1));
  __pyx_r = ((PyObject *)__pyx_t_1);
  __pyx_t_1 = 0;
  goto __pyx_L0;

  __pyx_r = Py_None; __Pyx_INCREF(Py_None);
  goto __pyx_L0;
  __pyx_L1_error:;
  __Pyx_XDECREF(__pyx_t_1);
  __Pyx_AddTraceback("py_nRFSN.py_getBufIn", __pyx_clineno, __pyx_lineno, __pyx_filename);
  __pyx_r = NULL;
  __pyx_L0:;
  __Pyx_XGIVEREF(__pyx_r);
  __Pyx_RefNannyFinishContext();
  return __pyx_r;
}

/* "py_nRFSN.pyx":100
 *     return data
 * 
 * def py_flush(int buf):  # (0) RX (1) TX             # <<<<<<<<<<<<<<
 *     defns.flush(buf)
 * 
 */

static PyObject *__pyx_pf_8py_nRFSN_24py_flush(PyObject *__pyx_self, PyObject *__pyx_arg_buf); /*proto*/
static PyMethodDef __pyx_mdef_8py_nRFSN_24py_flush = {__Pyx_NAMESTR("py_flush"), (PyCFunction)__pyx_pf_8py_nRFSN_24py_flush, METH_O, __Pyx_DOCSTR(0)};
static PyObject *__pyx_pf_8py_nRFSN_24py_flush(PyObject *__pyx_self, PyObject *__pyx_arg_buf) {
  int __pyx_v_buf;
  PyObject *__pyx_r = NULL;
  __Pyx_RefNannyDeclarations
  int __pyx_lineno = 0;
  const char *__pyx_filename = NULL;
  int __pyx_clineno = 0;
  __Pyx_RefNannySetupContext("py_flush");
  __pyx_self = __pyx_self;
  assert(__pyx_arg_buf); {
    __pyx_v_buf = __Pyx_PyInt_AsInt(__pyx_arg_buf); if (unlikely((__pyx_v_buf == (int)-1) && PyErr_Occurred())) {__pyx_filename = __pyx_f[0]; __pyx_lineno = 100; __pyx_clineno = __LINE__; goto __pyx_L3_error;}
  }
  goto __pyx_L4_argument_unpacking_done;
  __pyx_L3_error:;
  __Pyx_AddTraceback("py_nRFSN.py_flush", __pyx_clineno, __pyx_lineno, __pyx_filename);
  __Pyx_RefNannyFinishContext();
  return NULL;
  __pyx_L4_argument_unpacking_done:;

  /* "py_nRFSN.pyx":101
 * 
 * def py_flush(int buf):  # (0) RX (1) TX
 *     defns.flush(buf)             # <<<<<<<<<<<<<<
 * 
 * def py_bcmDelay(int ms):
 */
  flush(__pyx_v_buf);

  __pyx_r = Py_None; __Pyx_INCREF(Py_None);
  __Pyx_XGIVEREF(__pyx_r);
  __Pyx_RefNannyFinishContext();
  return __pyx_r;
}

/* "py_nRFSN.pyx":103
 *     defns.flush(buf)
 * 
 * def py_bcmDelay(int ms):             # <<<<<<<<<<<<<<
 *     defns.bcmDelay(ms)
 * 
 */

static PyObject *__pyx_pf_8py_nRFSN_25py_bcmDelay(PyObject *__pyx_self, PyObject *__pyx_arg_ms); /*proto*/
static PyMethodDef __pyx_mdef_8py_nRFSN_25py_bcmDelay = {__Pyx_NAMESTR("py_bcmDelay"), (PyCFunction)__pyx_pf_8py_nRFSN_25py_bcmDelay, METH_O, __Pyx_DOCSTR(0)};
static PyObject *__pyx_pf_8py_nRFSN_25py_bcmDelay(PyObject *__pyx_self, PyObject *__pyx_arg_ms) {
  int __pyx_v_ms;
  PyObject *__pyx_r = NULL;
  __Pyx_RefNannyDeclarations
  int __pyx_lineno = 0;
  const char *__pyx_filename = NULL;
  int __pyx_clineno = 0;
  __Pyx_RefNannySetupContext("py_bcmDelay");
  __pyx_self = __pyx_self;
  assert(__pyx_arg_ms); {
    __pyx_v_ms = __Pyx_PyInt_AsInt(__pyx_arg_ms); if (unlikely((__pyx_v_ms == (int)-1) && PyErr_Occurred())) {__pyx_filename = __pyx_f[0]; __pyx_lineno = 103; __pyx_clineno = __LINE__; goto __pyx_L3_error;}
  }
  goto __pyx_L4_argument_unpacking_done;
  __pyx_L3_error:;
  __Pyx_AddTraceback("py_nRFSN.py_bcmDelay", __pyx_clineno, __pyx_lineno, __pyx_filename);
  __Pyx_RefNannyFinishContext();
  return NULL;
  __pyx_L4_argument_unpacking_done:;

  /* "py_nRFSN.pyx":104
 * 
 * def py_bcmDelay(int ms):
 *     defns.bcmDelay(ms)             # <<<<<<<<<<<<<<
 * 
 * def py_bcmDelayM(int us):
 */
  bcmDelay(__pyx_v_ms);

  __pyx_r = Py_None; __Pyx_INCREF(Py_None);
  __Pyx_XGIVEREF(__pyx_r);
  __Pyx_RefNannyFinishContext();
  return __pyx_r;
}

/* "py_nRFSN.pyx":106
 *     defns.bcmDelay(ms)
 * 
 * def py_bcmDelayM(int us):             # <<<<<<<<<<<<<<
 *     defns.bcmDelay(us)
 * 
 */

static PyObject *__pyx_pf_8py_nRFSN_26py_bcmDelayM(PyObject *__pyx_self, PyObject *__pyx_arg_us); /*proto*/
static PyMethodDef __pyx_mdef_8py_nRFSN_26py_bcmDelayM = {__Pyx_NAMESTR("py_bcmDelayM"), (PyCFunction)__pyx_pf_8py_nRFSN_26py_bcmDelayM, METH_O, __Pyx_DOCSTR(0)};
static PyObject *__pyx_pf_8py_nRFSN_26py_bcmDelayM(PyObject *__pyx_self, PyObject *__pyx_arg_us) {
  int __pyx_v_us;
  PyObject *__pyx_r = NULL;
  __Pyx_RefNannyDeclarations
  int __pyx_lineno = 0;
  const char *__pyx_filename = NULL;
  int __pyx_clineno = 0;
  __Pyx_RefNannySetupContext("py_bcmDelayM");
  __pyx_self = __pyx_self;
  assert(__pyx_arg_us); {
    __pyx_v_us = __Pyx_PyInt_AsInt(__pyx_arg_us); if (unlikely((__pyx_v_us == (int)-1) && PyErr_Occurred())) {__pyx_filename = __pyx_f[0]; __pyx_lineno = 106; __pyx_clineno = __LINE__; goto __pyx_L3_error;}
  }
  goto __pyx_L4_argument_unpacking_done;
  __pyx_L3_error:;
  __Pyx_AddTraceback("py_nRFSN.py_bcmDelayM", __pyx_clineno, __pyx_lineno, __pyx_filename);
  __Pyx_RefNannyFinishContext();
  return NULL;
  __pyx_L4_argument_unpacking_done:;

  /* "py_nRFSN.pyx":107
 * 
 * def py_bcmDelayM(int us):
 *     defns.bcmDelay(us)             # <<<<<<<<<<<<<<
 * 
 * def py_stop():
 */
  bcmDelay(__pyx_v_us);

  __pyx_r = Py_None; __Pyx_INCREF(Py_None);
  __Pyx_XGIVEREF(__pyx_r);
  __Pyx_RefNannyFinishContext();
  return __pyx_r;
}

/* "py_nRFSN.pyx":109
 *     defns.bcmDelay(us)
 * 
 * def py_stop():             # <<<<<<<<<<<<<<
 *     defns.stop()
 * 
 */

static PyObject *__pyx_pf_8py_nRFSN_27py_stop(PyObject *__pyx_self, CYTHON_UNUSED PyObject *unused); /*proto*/
static PyMethodDef __pyx_mdef_8py_nRFSN_27py_stop = {__Pyx_NAMESTR("py_stop"), (PyCFunction)__pyx_pf_8py_nRFSN_27py_stop, METH_NOARGS, __Pyx_DOCSTR(0)};
static PyObject *__pyx_pf_8py_nRFSN_27py_stop(PyObject *__pyx_self, CYTHON_UNUSED PyObject *unused) {
  PyObject *__pyx_r = NULL;
  __Pyx_RefNannyDeclarations
  __Pyx_RefNannySetupContext("py_stop");
  __pyx_self = __pyx_self;

  /* "py_nRFSN.pyx":110
 * 
 * def py_stop():
 *     defns.stop()             # <<<<<<<<<<<<<<
 * 
 * def py_getSensorVals(addr, command, len):
 */
  stop();

  __pyx_r = Py_None; __Pyx_INCREF(Py_None);
  __Pyx_XGIVEREF(__pyx_r);
  __Pyx_RefNannyFinishContext();
  return __pyx_r;
}

/* "py_nRFSN.pyx":112
 *     defns.stop()
 * 
 * def py_getSensorVals(addr, command, len):             # <<<<<<<<<<<<<<
 *     # addr list to array
 *     cdef char *addrptr
 */

static PyObject *__pyx_pf_8py_nRFSN_28py_getSensorVals(PyObject *__pyx_self, PyObject *__pyx_args, PyObject *__pyx_kwds); /*proto*/
static PyMethodDef __pyx_mdef_8py_nRFSN_28py_getSensorVals = {__Pyx_NAMESTR("py_getSensorVals"), (PyCFunction)__pyx_pf_8py_nRFSN_28py_getSensorVals, METH_VARARGS|METH_KEYWORDS, __Pyx_DOCSTR(0)};
static PyObject *__pyx_pf_8py_nRFSN_28py_getSensorVals(PyObject *__pyx_self, PyObject *__pyx_args, PyObject *__pyx_kwds) {
  PyObject *__pyx_v_addr = 0;
  PyObject *__pyx_v_command = 0;
  PyObject *__pyx_v_len = 0;
  char *__pyx_v_addrptr;
  PyObject *__pyx_v_i = NULL;
  char *__pyx_v_returnedData;
  PyObject *__pyx_v_py_data = NULL;
  PyObject *__pyx_r = NULL;
  __Pyx_RefNannyDeclarations
  PyObject *__pyx_t_1 = NULL;
  PyObject *__pyx_t_2 = NULL;
  Py_ssize_t __pyx_t_3;
  PyObject *(*__pyx_t_4)(PyObject *);
  char __pyx_t_5;
  Py_ssize_t __pyx_t_6;
  char __pyx_t_7;
  int __pyx_t_8;
  int __pyx_lineno = 0;
  const char *__pyx_filename = NULL;
  int __pyx_clineno = 0;
  static PyObject **__pyx_pyargnames[] = {&__pyx_n_s__addr,&__pyx_n_s__command,&__pyx_n_s__len,0};
  __Pyx_RefNannySetupContext("py_getSensorVals");
  __pyx_self = __pyx_self;
  {
    PyObject* values[3] = {0,0,0};
    if (unlikely(__pyx_kwds)) {
      Py_ssize_t kw_args;
      switch (PyTuple_GET_SIZE(__pyx_args)) {
        case  3: values[2] = PyTuple_GET_ITEM(__pyx_args, 2);
        case  2: values[1] = PyTuple_GET_ITEM(__pyx_args, 1);
        case  1: values[0] = PyTuple_GET_ITEM(__pyx_args, 0);
        case  0: break;
        default: goto __pyx_L5_argtuple_error;
      }
      kw_args = PyDict_Size(__pyx_kwds);
      switch (PyTuple_GET_SIZE(__pyx_args)) {
        case  0:
        values[0] = PyDict_GetItem(__pyx_kwds, __pyx_n_s__addr);
        if (likely(values[0])) kw_args--;
        else goto __pyx_L5_argtuple_error;
        case  1:
        values[1] = PyDict_GetItem(__pyx_kwds, __pyx_n_s__command);
        if (likely(values[1])) kw_args--;
        else {
          __Pyx_RaiseArgtupleInvalid("py_getSensorVals", 1, 3, 3, 1); {__pyx_filename = __pyx_f[0]; __pyx_lineno = 112; __pyx_clineno = __LINE__; goto __pyx_L3_error;}
        }
        case  2:
        values[2] = PyDict_GetItem(__pyx_kwds, __pyx_n_s__len);
        if (likely(values[2])) kw_args--;
        else {
          __Pyx_RaiseArgtupleInvalid("py_getSensorVals", 1, 3, 3, 2); {__pyx_filename = __pyx_f[0]; __pyx_lineno = 112; __pyx_clineno = __LINE__; goto __pyx_L3_error;}
        }
      }
      if (unlikely(kw_args > 0)) {
        if (unlikely(__Pyx_ParseOptionalKeywords(__pyx_kwds, __pyx_pyargnames, 0, values, PyTuple_GET_SIZE(__pyx_args), "py_getSensorVals") < 0)) {__pyx_filename = __pyx_f[0]; __pyx_lineno = 112; __pyx_clineno = __LINE__; goto __pyx_L3_error;}
      }
    } else if (PyTuple_GET_SIZE(__pyx_args) != 3) {
      goto __pyx_L5_argtuple_error;
    } else {
      values[0] = PyTuple_GET_ITEM(__pyx_args, 0);
      values[1] = PyTuple_GET_ITEM(__pyx_args, 1);
      values[2] = PyTuple_GET_ITEM(__pyx_args, 2);
    }
    __pyx_v_addr = values[0];
    __pyx_v_command = values[1];
    __pyx_v_len = values[2];
  }
  goto __pyx_L4_argument_unpacking_done;
  __pyx_L5_argtuple_error:;
  __Pyx_RaiseArgtupleInvalid("py_getSensorVals", 1, 3, 3, PyTuple_GET_SIZE(__pyx_args)); {__pyx_filename = __pyx_f[0]; __pyx_lineno = 112; __pyx_clineno = __LINE__; goto __pyx_L3_error;}
  __pyx_L3_error:;
  __Pyx_AddTraceback("py_nRFSN.py_getSensorVals", __pyx_clineno, __pyx_lineno, __pyx_filename);
  __Pyx_RefNannyFinishContext();
  return NULL;
  __pyx_L4_argument_unpacking_done:;

  /* "py_nRFSN.pyx":115
 *     # addr list to array
 *     cdef char *addrptr
 *     addrptr = <char *>malloc(4)             # <<<<<<<<<<<<<<
 *     for i in xrange(4):
 *         addrptr[i] = addr[i]
 */
  __pyx_v_addrptr = ((char *)malloc(4));

  /* "py_nRFSN.pyx":116
 *     cdef char *addrptr
 *     addrptr = <char *>malloc(4)
 *     for i in xrange(4):             # <<<<<<<<<<<<<<
 *         addrptr[i] = addr[i]
 * 
 */
  __pyx_t_1 = PyObject_Call(__pyx_builtin_xrange, ((PyObject *)__pyx_k_tuple_1), NULL); if (unlikely(!__pyx_t_1)) {__pyx_filename = __pyx_f[0]; __pyx_lineno = 116; __pyx_clineno = __LINE__; goto __pyx_L1_error;}
  __Pyx_GOTREF(__pyx_t_1);
  if (PyList_CheckExact(__pyx_t_1) || PyTuple_CheckExact(__pyx_t_1)) {
    __pyx_t_2 = __pyx_t_1; __Pyx_INCREF(__pyx_t_2); __pyx_t_3 = 0;
    __pyx_t_4 = NULL;
  } else {
    __pyx_t_3 = -1; __pyx_t_2 = PyObject_GetIter(__pyx_t_1); if (unlikely(!__pyx_t_2)) {__pyx_filename = __pyx_f[0]; __pyx_lineno = 116; __pyx_clineno = __LINE__; goto __pyx_L1_error;}
    __Pyx_GOTREF(__pyx_t_2);
    __pyx_t_4 = Py_TYPE(__pyx_t_2)->tp_iternext;
  }
  __Pyx_DECREF(__pyx_t_1); __pyx_t_1 = 0;
  for (;;) {
    if (PyList_CheckExact(__pyx_t_2)) {
      if (__pyx_t_3 >= PyList_GET_SIZE(__pyx_t_2)) break;
      __pyx_t_1 = PyList_GET_ITEM(__pyx_t_2, __pyx_t_3); __Pyx_INCREF(__pyx_t_1); __pyx_t_3++;
    } else if (PyTuple_CheckExact(__pyx_t_2)) {
      if (__pyx_t_3 >= PyTuple_GET_SIZE(__pyx_t_2)) break;
      __pyx_t_1 = PyTuple_GET_ITEM(__pyx_t_2, __pyx_t_3); __Pyx_INCREF(__pyx_t_1); __pyx_t_3++;
    } else {
      __pyx_t_1 = __pyx_t_4(__pyx_t_2);
      if (unlikely(!__pyx_t_1)) {
        if (PyErr_Occurred()) {
          if (likely(PyErr_ExceptionMatches(PyExc_StopIteration))) PyErr_Clear();
          else {__pyx_filename = __pyx_f[0]; __pyx_lineno = 116; __pyx_clineno = __LINE__; goto __pyx_L1_error;}
        }
        break;
      }
      __Pyx_GOTREF(__pyx_t_1);
    }
    __Pyx_XDECREF(__pyx_v_i);
    __pyx_v_i = __pyx_t_1;
    __pyx_t_1 = 0;

    /* "py_nRFSN.pyx":117
 *     addrptr = <char *>malloc(4)
 *     for i in xrange(4):
 *         addrptr[i] = addr[i]             # <<<<<<<<<<<<<<
 * 
 *     # execute function
 */
    __pyx_t_1 = PyObject_GetItem(__pyx_v_addr, __pyx_v_i); if (!__pyx_t_1) {__pyx_filename = __pyx_f[0]; __pyx_lineno = 117; __pyx_clineno = __LINE__; goto __pyx_L1_error;}
    __Pyx_GOTREF(__pyx_t_1);
    __pyx_t_5 = __Pyx_PyInt_AsChar(__pyx_t_1); if (unlikely((__pyx_t_5 == (char)-1) && PyErr_Occurred())) {__pyx_filename = __pyx_f[0]; __pyx_lineno = 117; __pyx_clineno = __LINE__; goto __pyx_L1_error;}
    __Pyx_DECREF(__pyx_t_1); __pyx_t_1 = 0;
    __pyx_t_6 = __Pyx_PyIndex_AsSsize_t(__pyx_v_i); if (unlikely((__pyx_t_6 == (Py_ssize_t)-1) && PyErr_Occurred())) {__pyx_filename = __pyx_f[0]; __pyx_lineno = 117; __pyx_clineno = __LINE__; goto __pyx_L1_error;}
    (__pyx_v_addrptr[__pyx_t_6]) = __pyx_t_5;
  }
  __Pyx_DECREF(__pyx_t_2); __pyx_t_2 = 0;

  /* "py_nRFSN.pyx":120
 * 
 *     # execute function
 *     cdef char *returnedData = defns.getSensorVals(addrptr, command, len)             # <<<<<<<<<<<<<<
 * 
 *     py_data = []
 */
  __pyx_t_5 = __Pyx_PyInt_AsChar(__pyx_v_command); if (unlikely((__pyx_t_5 == (char)-1) && PyErr_Occurred())) {__pyx_filename = __pyx_f[0]; __pyx_lineno = 120; __pyx_clineno = __LINE__; goto __pyx_L1_error;}
  __pyx_t_7 = __Pyx_PyInt_AsChar(__pyx_v_len); if (unlikely((__pyx_t_7 == (char)-1) && PyErr_Occurred())) {__pyx_filename = __pyx_f[0]; __pyx_lineno = 120; __pyx_clineno = __LINE__; goto __pyx_L1_error;}
  __pyx_v_returnedData = getSensorVals(__pyx_v_addrptr, __pyx_t_5, __pyx_t_7);

  /* "py_nRFSN.pyx":122
 *     cdef char *returnedData = defns.getSensorVals(addrptr, command, len)
 * 
 *     py_data = []             # <<<<<<<<<<<<<<
 *     for i in xrange(len):
 *         py_data.append(returnedData[i])
 */
  __pyx_t_2 = PyList_New(0); if (unlikely(!__pyx_t_2)) {__pyx_filename = __pyx_f[0]; __pyx_lineno = 122; __pyx_clineno = __LINE__; goto __pyx_L1_error;}
  __Pyx_GOTREF(((PyObject *)__pyx_t_2));
  __pyx_v_py_data = __pyx_t_2;
  __pyx_t_2 = 0;

  /* "py_nRFSN.pyx":123
 * 
 *     py_data = []
 *     for i in xrange(len):             # <<<<<<<<<<<<<<
 *         py_data.append(returnedData[i])
 * 
 */
  __pyx_t_2 = PyTuple_New(1); if (unlikely(!__pyx_t_2)) {__pyx_filename = __pyx_f[0]; __pyx_lineno = 123; __pyx_clineno = __LINE__; goto __pyx_L1_error;}
  __Pyx_GOTREF(((PyObject *)__pyx_t_2));
  __Pyx_INCREF(__pyx_v_len);
  PyTuple_SET_ITEM(__pyx_t_2, 0, __pyx_v_len);
  __Pyx_GIVEREF(__pyx_v_len);
  __pyx_t_1 = PyObject_Call(__pyx_builtin_xrange, ((PyObject *)__pyx_t_2), NULL); if (unlikely(!__pyx_t_1)) {__pyx_filename = __pyx_f[0]; __pyx_lineno = 123; __pyx_clineno = __LINE__; goto __pyx_L1_error;}
  __Pyx_GOTREF(__pyx_t_1);
  __Pyx_DECREF(((PyObject *)__pyx_t_2)); __pyx_t_2 = 0;
  if (PyList_CheckExact(__pyx_t_1) || PyTuple_CheckExact(__pyx_t_1)) {
    __pyx_t_2 = __pyx_t_1; __Pyx_INCREF(__pyx_t_2); __pyx_t_3 = 0;
    __pyx_t_4 = NULL;
  } else {
    __pyx_t_3 = -1; __pyx_t_2 = PyObject_GetIter(__pyx_t_1); if (unlikely(!__pyx_t_2)) {__pyx_filename = __pyx_f[0]; __pyx_lineno = 123; __pyx_clineno = __LINE__; goto __pyx_L1_error;}
    __Pyx_GOTREF(__pyx_t_2);
    __pyx_t_4 = Py_TYPE(__pyx_t_2)->tp_iternext;
  }
  __Pyx_DECREF(__pyx_t_1); __pyx_t_1 = 0;
  for (;;) {
    if (PyList_CheckExact(__pyx_t_2)) {
      if (__pyx_t_3 >= PyList_GET_SIZE(__pyx_t_2)) break;
      __pyx_t_1 = PyList_GET_ITEM(__pyx_t_2, __pyx_t_3); __Pyx_INCREF(__pyx_t_1); __pyx_t_3++;
    } else if (PyTuple_CheckExact(__pyx_t_2)) {
      if (__pyx_t_3 >= PyTuple_GET_SIZE(__pyx_t_2)) break;
      __pyx_t_1 = PyTuple_GET_ITEM(__pyx_t_2, __pyx_t_3); __Pyx_INCREF(__pyx_t_1); __pyx_t_3++;
    } else {
      __pyx_t_1 = __pyx_t_4(__pyx_t_2);
      if (unlikely(!__pyx_t_1)) {
        if (PyErr_Occurred()) {
          if (likely(PyErr_ExceptionMatches(PyExc_StopIteration))) PyErr_Clear();
          else {__pyx_filename = __pyx_f[0]; __pyx_lineno = 123; __pyx_clineno = __LINE__; goto __pyx_L1_error;}
        }
        break;
      }
      __Pyx_GOTREF(__pyx_t_1);
    }
    __Pyx_XDECREF(__pyx_v_i);
    __pyx_v_i = __pyx_t_1;
    __pyx_t_1 = 0;

    /* "py_nRFSN.pyx":124
 *     py_data = []
 *     for i in xrange(len):
 *         py_data.append(returnedData[i])             # <<<<<<<<<<<<<<
 * 
 *     return py_data
 */
    if (unlikely(((PyObject *)__pyx_v_py_data) == Py_None)) {
      PyErr_Format(PyExc_AttributeError, "'NoneType' object has no attribute '%s'", "append"); {__pyx_filename = __pyx_f[0]; __pyx_lineno = 124; __pyx_clineno = __LINE__; goto __pyx_L1_error;} 
    }
    __pyx_t_6 = __Pyx_PyIndex_AsSsize_t(__pyx_v_i); if (unlikely((__pyx_t_6 == (Py_ssize_t)-1) && PyErr_Occurred())) {__pyx_filename = __pyx_f[0]; __pyx_lineno = 124; __pyx_clineno = __LINE__; goto __pyx_L1_error;}
    __pyx_t_1 = PyInt_FromLong((__pyx_v_returnedData[__pyx_t_6])); if (unlikely(!__pyx_t_1)) {__pyx_filename = __pyx_f[0]; __pyx_lineno = 124; __pyx_clineno = __LINE__; goto __pyx_L1_error;}
    __Pyx_GOTREF(__pyx_t_1);
    __pyx_t_8 = PyList_Append(__pyx_v_py_data, __pyx_t_1); if (unlikely(__pyx_t_8 == -1)) {__pyx_filename = __pyx_f[0]; __pyx_lineno = 124; __pyx_clineno = __LINE__; goto __pyx_L1_error;}
    __Pyx_DECREF(__pyx_t_1); __pyx_t_1 = 0;
  }
  __Pyx_DECREF(__pyx_t_2); __pyx_t_2 = 0;

  /* "py_nRFSN.pyx":126
 *         py_data.append(returnedData[i])
 * 
 *     return py_data             # <<<<<<<<<<<<<<
 * 
 * def py_setSensorVals(addr, command, data, len):
 */
  __Pyx_XDECREF(__pyx_r);
  __Pyx_INCREF(((PyObject *)__pyx_v_py_data));
  __pyx_r = ((PyObject *)__pyx_v_py_data);
  goto __pyx_L0;

  __pyx_r = Py_None; __Pyx_INCREF(Py_None);
  goto __pyx_L0;
  __pyx_L1_error:;
  __Pyx_XDECREF(__pyx_t_1);
  __Pyx_XDECREF(__pyx_t_2);
  __Pyx_AddTraceback("py_nRFSN.py_getSensorVals", __pyx_clineno, __pyx_lineno, __pyx_filename);
  __pyx_r = NULL;
  __pyx_L0:;
  __Pyx_XDECREF(__pyx_v_i);
  __Pyx_XDECREF(__pyx_v_py_data);
  __Pyx_XGIVEREF(__pyx_r);
  __Pyx_RefNannyFinishContext();
  return __pyx_r;
}

/* "py_nRFSN.pyx":128
 *     return py_data
 * 
 * def py_setSensorVals(addr, command, data, len):             # <<<<<<<<<<<<<<
 *     # addr list to array
 *     cdef char *addrptr
 */

static PyObject *__pyx_pf_8py_nRFSN_29py_setSensorVals(PyObject *__pyx_self, PyObject *__pyx_args, PyObject *__pyx_kwds); /*proto*/
static PyMethodDef __pyx_mdef_8py_nRFSN_29py_setSensorVals = {__Pyx_NAMESTR("py_setSensorVals"), (PyCFunction)__pyx_pf_8py_nRFSN_29py_setSensorVals, METH_VARARGS|METH_KEYWORDS, __Pyx_DOCSTR(0)};
static PyObject *__pyx_pf_8py_nRFSN_29py_setSensorVals(PyObject *__pyx_self, PyObject *__pyx_args, PyObject *__pyx_kwds) {
  PyObject *__pyx_v_addr = 0;
  PyObject *__pyx_v_command = 0;
  PyObject *__pyx_v_data = 0;
  PyObject *__pyx_v_len = 0;
  char *__pyx_v_addrptr;
  PyObject *__pyx_v_i = NULL;
  char *__pyx_v_dataptr;
  PyObject *__pyx_r = NULL;
  __Pyx_RefNannyDeclarations
  PyObject *__pyx_t_1 = NULL;
  PyObject *__pyx_t_2 = NULL;
  Py_ssize_t __pyx_t_3;
  PyObject *(*__pyx_t_4)(PyObject *);
  char __pyx_t_5;
  Py_ssize_t __pyx_t_6;
  size_t __pyx_t_7;
  int __pyx_lineno = 0;
  const char *__pyx_filename = NULL;
  int __pyx_clineno = 0;
  static PyObject **__pyx_pyargnames[] = {&__pyx_n_s__addr,&__pyx_n_s__command,&__pyx_n_s__data,&__pyx_n_s__len,0};
  __Pyx_RefNannySetupContext("py_setSensorVals");
  __pyx_self = __pyx_self;
  {
    PyObject* values[4] = {0,0,0,0};
    if (unlikely(__pyx_kwds)) {
      Py_ssize_t kw_args;
      switch (PyTuple_GET_SIZE(__pyx_args)) {
        case  4: values[3] = PyTuple_GET_ITEM(__pyx_args, 3);
        case  3: values[2] = PyTuple_GET_ITEM(__pyx_args, 2);
        case  2: values[1] = PyTuple_GET_ITEM(__pyx_args, 1);
        case  1: values[0] = PyTuple_GET_ITEM(__pyx_args, 0);
        case  0: break;
        default: goto __pyx_L5_argtuple_error;
      }
      kw_args = PyDict_Size(__pyx_kwds);
      switch (PyTuple_GET_SIZE(__pyx_args)) {
        case  0:
        values[0] = PyDict_GetItem(__pyx_kwds, __pyx_n_s__addr);
        if (likely(values[0])) kw_args--;
        else goto __pyx_L5_argtuple_error;
        case  1:
        values[1] = PyDict_GetItem(__pyx_kwds, __pyx_n_s__command);
        if (likely(values[1])) kw_args--;
        else {
          __Pyx_RaiseArgtupleInvalid("py_setSensorVals", 1, 4, 4, 1); {__pyx_filename = __pyx_f[0]; __pyx_lineno = 128; __pyx_clineno = __LINE__; goto __pyx_L3_error;}
        }
        case  2:
        values[2] = PyDict_GetItem(__pyx_kwds, __pyx_n_s__data);
        if (likely(values[2])) kw_args--;
        else {
          __Pyx_RaiseArgtupleInvalid("py_setSensorVals", 1, 4, 4, 2); {__pyx_filename = __pyx_f[0]; __pyx_lineno = 128; __pyx_clineno = __LINE__; goto __pyx_L3_error;}
        }
        case  3:
        values[3] = PyDict_GetItem(__pyx_kwds, __pyx_n_s__len);
        if (likely(values[3])) kw_args--;
        else {
          __Pyx_RaiseArgtupleInvalid("py_setSensorVals", 1, 4, 4, 3); {__pyx_filename = __pyx_f[0]; __pyx_lineno = 128; __pyx_clineno = __LINE__; goto __pyx_L3_error;}
        }
      }
      if (unlikely(kw_args > 0)) {
        if (unlikely(__Pyx_ParseOptionalKeywords(__pyx_kwds, __pyx_pyargnames, 0, values, PyTuple_GET_SIZE(__pyx_args), "py_setSensorVals") < 0)) {__pyx_filename = __pyx_f[0]; __pyx_lineno = 128; __pyx_clineno = __LINE__; goto __pyx_L3_error;}
      }
    } else if (PyTuple_GET_SIZE(__pyx_args) != 4) {
      goto __pyx_L5_argtuple_error;
    } else {
      values[0] = PyTuple_GET_ITEM(__pyx_args, 0);
      values[1] = PyTuple_GET_ITEM(__pyx_args, 1);
      values[2] = PyTuple_GET_ITEM(__pyx_args, 2);
      values[3] = PyTuple_GET_ITEM(__pyx_args, 3);
    }
    __pyx_v_addr = values[0];
    __pyx_v_command = values[1];
    __pyx_v_data = values[2];
    __pyx_v_len = values[3];
  }
  goto __pyx_L4_argument_unpacking_done;
  __pyx_L5_argtuple_error:;
  __Pyx_RaiseArgtupleInvalid("py_setSensorVals", 1, 4, 4, PyTuple_GET_SIZE(__pyx_args)); {__pyx_filename = __pyx_f[0]; __pyx_lineno = 128; __pyx_clineno = __LINE__; goto __pyx_L3_error;}
  __pyx_L3_error:;
  __Pyx_AddTraceback("py_nRFSN.py_setSensorVals", __pyx_clineno, __pyx_lineno, __pyx_filename);
  __Pyx_RefNannyFinishContext();
  return NULL;
  __pyx_L4_argument_unpacking_done:;

  /* "py_nRFSN.pyx":131
 *     # addr list to array
 *     cdef char *addrptr
 *     addrptr = <char *>malloc(4)             # <<<<<<<<<<<<<<
 *     for i in xrange(4):
 *         addrptr[i] = addr[i]
 */
  __pyx_v_addrptr = ((char *)malloc(4));

  /* "py_nRFSN.pyx":132
 *     cdef char *addrptr
 *     addrptr = <char *>malloc(4)
 *     for i in xrange(4):             # <<<<<<<<<<<<<<
 *         addrptr[i] = addr[i]
 * 
 */
  __pyx_t_1 = PyObject_Call(__pyx_builtin_xrange, ((PyObject *)__pyx_k_tuple_2), NULL); if (unlikely(!__pyx_t_1)) {__pyx_filename = __pyx_f[0]; __pyx_lineno = 132; __pyx_clineno = __LINE__; goto __pyx_L1_error;}
  __Pyx_GOTREF(__pyx_t_1);
  if (PyList_CheckExact(__pyx_t_1) || PyTuple_CheckExact(__pyx_t_1)) {
    __pyx_t_2 = __pyx_t_1; __Pyx_INCREF(__pyx_t_2); __pyx_t_3 = 0;
    __pyx_t_4 = NULL;
  } else {
    __pyx_t_3 = -1; __pyx_t_2 = PyObject_GetIter(__pyx_t_1); if (unlikely(!__pyx_t_2)) {__pyx_filename = __pyx_f[0]; __pyx_lineno = 132; __pyx_clineno = __LINE__; goto __pyx_L1_error;}
    __Pyx_GOTREF(__pyx_t_2);
    __pyx_t_4 = Py_TYPE(__pyx_t_2)->tp_iternext;
  }
  __Pyx_DECREF(__pyx_t_1); __pyx_t_1 = 0;
  for (;;) {
    if (PyList_CheckExact(__pyx_t_2)) {
      if (__pyx_t_3 >= PyList_GET_SIZE(__pyx_t_2)) break;
      __pyx_t_1 = PyList_GET_ITEM(__pyx_t_2, __pyx_t_3); __Pyx_INCREF(__pyx_t_1); __pyx_t_3++;
    } else if (PyTuple_CheckExact(__pyx_t_2)) {
      if (__pyx_t_3 >= PyTuple_GET_SIZE(__pyx_t_2)) break;
      __pyx_t_1 = PyTuple_GET_ITEM(__pyx_t_2, __pyx_t_3); __Pyx_INCREF(__pyx_t_1); __pyx_t_3++;
    } else {
      __pyx_t_1 = __pyx_t_4(__pyx_t_2);
      if (unlikely(!__pyx_t_1)) {
        if (PyErr_Occurred()) {
          if (likely(PyErr_ExceptionMatches(PyExc_StopIteration))) PyErr_Clear();
          else {__pyx_filename = __pyx_f[0]; __pyx_lineno = 132; __pyx_clineno = __LINE__; goto __pyx_L1_error;}
        }
        break;
      }
      __Pyx_GOTREF(__pyx_t_1);
    }
    __Pyx_XDECREF(__pyx_v_i);
    __pyx_v_i = __pyx_t_1;
    __pyx_t_1 = 0;

    /* "py_nRFSN.pyx":133
 *     addrptr = <char *>malloc(4)
 *     for i in xrange(4):
 *         addrptr[i] = addr[i]             # <<<<<<<<<<<<<<
 * 
 *     # command and data list to array
 */
    __pyx_t_1 = PyObject_GetItem(__pyx_v_addr, __pyx_v_i); if (!__pyx_t_1) {__pyx_filename = __pyx_f[0]; __pyx_lineno = 133; __pyx_clineno = __LINE__; goto __pyx_L1_error;}
    __Pyx_GOTREF(__pyx_t_1);
    __pyx_t_5 = __Pyx_PyInt_AsChar(__pyx_t_1); if (unlikely((__pyx_t_5 == (char)-1) && PyErr_Occurred())) {__pyx_filename = __pyx_f[0]; __pyx_lineno = 133; __pyx_clineno = __LINE__; goto __pyx_L1_error;}
    __Pyx_DECREF(__pyx_t_1); __pyx_t_1 = 0;
    __pyx_t_6 = __Pyx_PyIndex_AsSsize_t(__pyx_v_i); if (unlikely((__pyx_t_6 == (Py_ssize_t)-1) && PyErr_Occurred())) {__pyx_filename = __pyx_f[0]; __pyx_lineno = 133; __pyx_clineno = __LINE__; goto __pyx_L1_error;}
    (__pyx_v_addrptr[__pyx_t_6]) = __pyx_t_5;
  }
  __Pyx_DECREF(__pyx_t_2); __pyx_t_2 = 0;

  /* "py_nRFSN.pyx":137
 *     # command and data list to array
 *     cdef char *dataptr
 *     dataptr = <char *>malloc(len+1)             # <<<<<<<<<<<<<<
 *     dataptr[0] = command
 *     for i in xrange(len):
 */
  __pyx_t_2 = PyNumber_Add(__pyx_v_len, __pyx_int_1); if (unlikely(!__pyx_t_2)) {__pyx_filename = __pyx_f[0]; __pyx_lineno = 137; __pyx_clineno = __LINE__; goto __pyx_L1_error;}
  __Pyx_GOTREF(__pyx_t_2);
  __pyx_t_7 = __Pyx_PyInt_AsSize_t(__pyx_t_2); if (unlikely((__pyx_t_7 == (size_t)-1) && PyErr_Occurred())) {__pyx_filename = __pyx_f[0]; __pyx_lineno = 137; __pyx_clineno = __LINE__; goto __pyx_L1_error;}
  __Pyx_DECREF(__pyx_t_2); __pyx_t_2 = 0;
  __pyx_v_dataptr = ((char *)malloc(__pyx_t_7));

  /* "py_nRFSN.pyx":138
 *     cdef char *dataptr
 *     dataptr = <char *>malloc(len+1)
 *     dataptr[0] = command             # <<<<<<<<<<<<<<
 *     for i in xrange(len):
 *         dataptr[i+1] = data[i]
 */
  __pyx_t_5 = __Pyx_PyInt_AsChar(__pyx_v_command); if (unlikely((__pyx_t_5 == (char)-1) && PyErr_Occurred())) {__pyx_filename = __pyx_f[0]; __pyx_lineno = 138; __pyx_clineno = __LINE__; goto __pyx_L1_error;}
  (__pyx_v_dataptr[0]) = __pyx_t_5;

  /* "py_nRFSN.pyx":139
 *     dataptr = <char *>malloc(len+1)
 *     dataptr[0] = command
 *     for i in xrange(len):             # <<<<<<<<<<<<<<
 *         dataptr[i+1] = data[i]
 * 
 */
  __pyx_t_2 = PyTuple_New(1); if (unlikely(!__pyx_t_2)) {__pyx_filename = __pyx_f[0]; __pyx_lineno = 139; __pyx_clineno = __LINE__; goto __pyx_L1_error;}
  __Pyx_GOTREF(((PyObject *)__pyx_t_2));
  __Pyx_INCREF(__pyx_v_len);
  PyTuple_SET_ITEM(__pyx_t_2, 0, __pyx_v_len);
  __Pyx_GIVEREF(__pyx_v_len);
  __pyx_t_1 = PyObject_Call(__pyx_builtin_xrange, ((PyObject *)__pyx_t_2), NULL); if (unlikely(!__pyx_t_1)) {__pyx_filename = __pyx_f[0]; __pyx_lineno = 139; __pyx_clineno = __LINE__; goto __pyx_L1_error;}
  __Pyx_GOTREF(__pyx_t_1);
  __Pyx_DECREF(((PyObject *)__pyx_t_2)); __pyx_t_2 = 0;
  if (PyList_CheckExact(__pyx_t_1) || PyTuple_CheckExact(__pyx_t_1)) {
    __pyx_t_2 = __pyx_t_1; __Pyx_INCREF(__pyx_t_2); __pyx_t_3 = 0;
    __pyx_t_4 = NULL;
  } else {
    __pyx_t_3 = -1; __pyx_t_2 = PyObject_GetIter(__pyx_t_1); if (unlikely(!__pyx_t_2)) {__pyx_filename = __pyx_f[0]; __pyx_lineno = 139; __pyx_clineno = __LINE__; goto __pyx_L1_error;}
    __Pyx_GOTREF(__pyx_t_2);
    __pyx_t_4 = Py_TYPE(__pyx_t_2)->tp_iternext;
  }
  __Pyx_DECREF(__pyx_t_1); __pyx_t_1 = 0;
  for (;;) {
    if (PyList_CheckExact(__pyx_t_2)) {
      if (__pyx_t_3 >= PyList_GET_SIZE(__pyx_t_2)) break;
      __pyx_t_1 = PyList_GET_ITEM(__pyx_t_2, __pyx_t_3); __Pyx_INCREF(__pyx_t_1); __pyx_t_3++;
    } else if (PyTuple_CheckExact(__pyx_t_2)) {
      if (__pyx_t_3 >= PyTuple_GET_SIZE(__pyx_t_2)) break;
      __pyx_t_1 = PyTuple_GET_ITEM(__pyx_t_2, __pyx_t_3); __Pyx_INCREF(__pyx_t_1); __pyx_t_3++;
    } else {
      __pyx_t_1 = __pyx_t_4(__pyx_t_2);
      if (unlikely(!__pyx_t_1)) {
        if (PyErr_Occurred()) {
          if (likely(PyErr_ExceptionMatches(PyExc_StopIteration))) PyErr_Clear();
          else {__pyx_filename = __pyx_f[0]; __pyx_lineno = 139; __pyx_clineno = __LINE__; goto __pyx_L1_error;}
        }
        break;
      }
      __Pyx_GOTREF(__pyx_t_1);
    }
    __Pyx_XDECREF(__pyx_v_i);
    __pyx_v_i = __pyx_t_1;
    __pyx_t_1 = 0;

    /* "py_nRFSN.pyx":140
 *     dataptr[0] = command
 *     for i in xrange(len):
 *         dataptr[i+1] = data[i]             # <<<<<<<<<<<<<<
 * 
 *     # execute function
 */
    __pyx_t_1 = PyObject_GetItem(__pyx_v_data, __pyx_v_i); if (!__pyx_t_1) {__pyx_filename = __pyx_f[0]; __pyx_lineno = 140; __pyx_clineno = __LINE__; goto __pyx_L1_error;}
    __Pyx_GOTREF(__pyx_t_1);
    __pyx_t_5 = __Pyx_PyInt_AsChar(__pyx_t_1); if (unlikely((__pyx_t_5 == (char)-1) && PyErr_Occurred())) {__pyx_filename = __pyx_f[0]; __pyx_lineno = 140; __pyx_clineno = __LINE__; goto __pyx_L1_error;}
    __Pyx_DECREF(__pyx_t_1); __pyx_t_1 = 0;
    __pyx_t_1 = PyNumber_Add(__pyx_v_i, __pyx_int_1); if (unlikely(!__pyx_t_1)) {__pyx_filename = __pyx_f[0]; __pyx_lineno = 140; __pyx_clineno = __LINE__; goto __pyx_L1_error;}
    __Pyx_GOTREF(__pyx_t_1);
    __pyx_t_6 = __Pyx_PyIndex_AsSsize_t(__pyx_t_1); if (unlikely((__pyx_t_6 == (Py_ssize_t)-1) && PyErr_Occurred())) {__pyx_filename = __pyx_f[0]; __pyx_lineno = 140; __pyx_clineno = __LINE__; goto __pyx_L1_error;}
    __Pyx_DECREF(__pyx_t_1); __pyx_t_1 = 0;
    (__pyx_v_dataptr[__pyx_t_6]) = __pyx_t_5;
  }
  __Pyx_DECREF(__pyx_t_2); __pyx_t_2 = 0;

  /* "py_nRFSN.pyx":143
 * 
 *     # execute function
 *     defns.setSensorVals(addrptr, dataptr, len)             # <<<<<<<<<<<<<<
 * 
 * def py_setSensorValsFast(addr, command, data, len):
 */
  __pyx_t_5 = __Pyx_PyInt_AsChar(__pyx_v_len); if (unlikely((__pyx_t_5 == (char)-1) && PyErr_Occurred())) {__pyx_filename = __pyx_f[0]; __pyx_lineno = 143; __pyx_clineno = __LINE__; goto __pyx_L1_error;}
  setSensorVals(__pyx_v_addrptr, __pyx_v_dataptr, __pyx_t_5);

  __pyx_r = Py_None; __Pyx_INCREF(Py_None);
  goto __pyx_L0;
  __pyx_L1_error:;
  __Pyx_XDECREF(__pyx_t_1);
  __Pyx_XDECREF(__pyx_t_2);
  __Pyx_AddTraceback("py_nRFSN.py_setSensorVals", __pyx_clineno, __pyx_lineno, __pyx_filename);
  __pyx_r = NULL;
  __pyx_L0:;
  __Pyx_XDECREF(__pyx_v_i);
  __Pyx_XGIVEREF(__pyx_r);
  __Pyx_RefNannyFinishContext();
  return __pyx_r;
}

/* "py_nRFSN.pyx":145
 *     defns.setSensorVals(addrptr, dataptr, len)
 * 
 * def py_setSensorValsFast(addr, command, data, len):             # <<<<<<<<<<<<<<
 *     # addr list to array
 *     cdef char *addrptr
 */

static PyObject *__pyx_pf_8py_nRFSN_30py_setSensorValsFast(PyObject *__pyx_self, PyObject *__pyx_args, PyObject *__pyx_kwds); /*proto*/
static PyMethodDef __pyx_mdef_8py_nRFSN_30py_setSensorValsFast = {__Pyx_NAMESTR("py_setSensorValsFast"), (PyCFunction)__pyx_pf_8py_nRFSN_30py_setSensorValsFast, METH_VARARGS|METH_KEYWORDS, __Pyx_DOCSTR(0)};
static PyObject *__pyx_pf_8py_nRFSN_30py_setSensorValsFast(PyObject *__pyx_self, PyObject *__pyx_args, PyObject *__pyx_kwds) {
  PyObject *__pyx_v_addr = 0;
  PyObject *__pyx_v_command = 0;
  PyObject *__pyx_v_data = 0;
  PyObject *__pyx_v_len = 0;
  char *__pyx_v_addrptr;
  PyObject *__pyx_v_i = NULL;
  char *__pyx_v_dataptr;
  PyObject *__pyx_r = NULL;
  __Pyx_RefNannyDeclarations
  PyObject *__pyx_t_1 = NULL;
  PyObject *__pyx_t_2 = NULL;
  Py_ssize_t __pyx_t_3;
  PyObject *(*__pyx_t_4)(PyObject *);
  char __pyx_t_5;
  Py_ssize_t __pyx_t_6;
  size_t __pyx_t_7;
  int __pyx_lineno = 0;
  const char *__pyx_filename = NULL;
  int __pyx_clineno = 0;
  static PyObject **__pyx_pyargnames[] = {&__pyx_n_s__addr,&__pyx_n_s__command,&__pyx_n_s__data,&__pyx_n_s__len,0};
  __Pyx_RefNannySetupContext("py_setSensorValsFast");
  __pyx_self = __pyx_self;
  {
    PyObject* values[4] = {0,0,0,0};
    if (unlikely(__pyx_kwds)) {
      Py_ssize_t kw_args;
      switch (PyTuple_GET_SIZE(__pyx_args)) {
        case  4: values[3] = PyTuple_GET_ITEM(__pyx_args, 3);
        case  3: values[2] = PyTuple_GET_ITEM(__pyx_args, 2);
        case  2: values[1] = PyTuple_GET_ITEM(__pyx_args, 1);
        case  1: values[0] = PyTuple_GET_ITEM(__pyx_args, 0);
        case  0: break;
        default: goto __pyx_L5_argtuple_error;
      }
      kw_args = PyDict_Size(__pyx_kwds);
      switch (PyTuple_GET_SIZE(__pyx_args)) {
        case  0:
        values[0] = PyDict_GetItem(__pyx_kwds, __pyx_n_s__addr);
        if (likely(values[0])) kw_args--;
        else goto __pyx_L5_argtuple_error;
        case  1:
        values[1] = PyDict_GetItem(__pyx_kwds, __pyx_n_s__command);
        if (likely(values[1])) kw_args--;
        else {
          __Pyx_RaiseArgtupleInvalid("py_setSensorValsFast", 1, 4, 4, 1); {__pyx_filename = __pyx_f[0]; __pyx_lineno = 145; __pyx_clineno = __LINE__; goto __pyx_L3_error;}
        }
        case  2:
        values[2] = PyDict_GetItem(__pyx_kwds, __pyx_n_s__data);
        if (likely(values[2])) kw_args--;
        else {
          __Pyx_RaiseArgtupleInvalid("py_setSensorValsFast", 1, 4, 4, 2); {__pyx_filename = __pyx_f[0]; __pyx_lineno = 145; __pyx_clineno = __LINE__; goto __pyx_L3_error;}
        }
        case  3:
        values[3] = PyDict_GetItem(__pyx_kwds, __pyx_n_s__len);
        if (likely(values[3])) kw_args--;
        else {
          __Pyx_RaiseArgtupleInvalid("py_setSensorValsFast", 1, 4, 4, 3); {__pyx_filename = __pyx_f[0]; __pyx_lineno = 145; __pyx_clineno = __LINE__; goto __pyx_L3_error;}
        }
      }
      if (unlikely(kw_args > 0)) {
        if (unlikely(__Pyx_ParseOptionalKeywords(__pyx_kwds, __pyx_pyargnames, 0, values, PyTuple_GET_SIZE(__pyx_args), "py_setSensorValsFast") < 0)) {__pyx_filename = __pyx_f[0]; __pyx_lineno = 145; __pyx_clineno = __LINE__; goto __pyx_L3_error;}
      }
    } else if (PyTuple_GET_SIZE(__pyx_args) != 4) {
      goto __pyx_L5_argtuple_error;
    } else {
      values[0] = PyTuple_GET_ITEM(__pyx_args, 0);
      values[1] = PyTuple_GET_ITEM(__pyx_args, 1);
      values[2] = PyTuple_GET_ITEM(__pyx_args, 2);
      values[3] = PyTuple_GET_ITEM(__pyx_args, 3);
    }
    __pyx_v_addr = values[0];
    __pyx_v_command = values[1];
    __pyx_v_data = values[2];
    __pyx_v_len = values[3];
  }
  goto __pyx_L4_argument_unpacking_done;
  __pyx_L5_argtuple_error:;
  __Pyx_RaiseArgtupleInvalid("py_setSensorValsFast", 1, 4, 4, PyTuple_GET_SIZE(__pyx_args)); {__pyx_filename = __pyx_f[0]; __pyx_lineno = 145; __pyx_clineno = __LINE__; goto __pyx_L3_error;}
  __pyx_L3_error:;
  __Pyx_AddTraceback("py_nRFSN.py_setSensorValsFast", __pyx_clineno, __pyx_lineno, __pyx_filename);
  __Pyx_RefNannyFinishContext();
  return NULL;
  __pyx_L4_argument_unpacking_done:;

  /* "py_nRFSN.pyx":148
 *     # addr list to array
 *     cdef char *addrptr
 *     addrptr = <char *>malloc(4)             # <<<<<<<<<<<<<<
 *     for i in xrange(4):
 *         addrptr[i] = addr[i]
 */
  __pyx_v_addrptr = ((char *)malloc(4));

  /* "py_nRFSN.pyx":149
 *     cdef char *addrptr
 *     addrptr = <char *>malloc(4)
 *     for i in xrange(4):             # <<<<<<<<<<<<<<
 *         addrptr[i] = addr[i]
 * 
 */
  __pyx_t_1 = PyObject_Call(__pyx_builtin_xrange, ((PyObject *)__pyx_k_tuple_3), NULL); if (unlikely(!__pyx_t_1)) {__pyx_filename = __pyx_f[0]; __pyx_lineno = 149; __pyx_clineno = __LINE__; goto __pyx_L1_error;}
  __Pyx_GOTREF(__pyx_t_1);
  if (PyList_CheckExact(__pyx_t_1) || PyTuple_CheckExact(__pyx_t_1)) {
    __pyx_t_2 = __pyx_t_1; __Pyx_INCREF(__pyx_t_2); __pyx_t_3 = 0;
    __pyx_t_4 = NULL;
  } else {
    __pyx_t_3 = -1; __pyx_t_2 = PyObject_GetIter(__pyx_t_1); if (unlikely(!__pyx_t_2)) {__pyx_filename = __pyx_f[0]; __pyx_lineno = 149; __pyx_clineno = __LINE__; goto __pyx_L1_error;}
    __Pyx_GOTREF(__pyx_t_2);
    __pyx_t_4 = Py_TYPE(__pyx_t_2)->tp_iternext;
  }
  __Pyx_DECREF(__pyx_t_1); __pyx_t_1 = 0;
  for (;;) {
    if (PyList_CheckExact(__pyx_t_2)) {
      if (__pyx_t_3 >= PyList_GET_SIZE(__pyx_t_2)) break;
      __pyx_t_1 = PyList_GET_ITEM(__pyx_t_2, __pyx_t_3); __Pyx_INCREF(__pyx_t_1); __pyx_t_3++;
    } else if (PyTuple_CheckExact(__pyx_t_2)) {
      if (__pyx_t_3 >= PyTuple_GET_SIZE(__pyx_t_2)) break;
      __pyx_t_1 = PyTuple_GET_ITEM(__pyx_t_2, __pyx_t_3); __Pyx_INCREF(__pyx_t_1); __pyx_t_3++;
    } else {
      __pyx_t_1 = __pyx_t_4(__pyx_t_2);
      if (unlikely(!__pyx_t_1)) {
        if (PyErr_Occurred()) {
          if (likely(PyErr_ExceptionMatches(PyExc_StopIteration))) PyErr_Clear();
          else {__pyx_filename = __pyx_f[0]; __pyx_lineno = 149; __pyx_clineno = __LINE__; goto __pyx_L1_error;}
        }
        break;
      }
      __Pyx_GOTREF(__pyx_t_1);
    }
    __Pyx_XDECREF(__pyx_v_i);
    __pyx_v_i = __pyx_t_1;
    __pyx_t_1 = 0;

    /* "py_nRFSN.pyx":150
 *     addrptr = <char *>malloc(4)
 *     for i in xrange(4):
 *         addrptr[i] = addr[i]             # <<<<<<<<<<<<<<
 * 
 *     # command and data list to array
 */
    __pyx_t_1 = PyObject_GetItem(__pyx_v_addr, __pyx_v_i); if (!__pyx_t_1) {__pyx_filename = __pyx_f[0]; __pyx_lineno = 150; __pyx_clineno = __LINE__; goto __pyx_L1_error;}
    __Pyx_GOTREF(__pyx_t_1);
    __pyx_t_5 = __Pyx_PyInt_AsChar(__pyx_t_1); if (unlikely((__pyx_t_5 == (char)-1) && PyErr_Occurred())) {__pyx_filename = __pyx_f[0]; __pyx_lineno = 150; __pyx_clineno = __LINE__; goto __pyx_L1_error;}
    __Pyx_DECREF(__pyx_t_1); __pyx_t_1 = 0;
    __pyx_t_6 = __Pyx_PyIndex_AsSsize_t(__pyx_v_i); if (unlikely((__pyx_t_6 == (Py_ssize_t)-1) && PyErr_Occurred())) {__pyx_filename = __pyx_f[0]; __pyx_lineno = 150; __pyx_clineno = __LINE__; goto __pyx_L1_error;}
    (__pyx_v_addrptr[__pyx_t_6]) = __pyx_t_5;
  }
  __Pyx_DECREF(__pyx_t_2); __pyx_t_2 = 0;

  /* "py_nRFSN.pyx":154
 *     # command and data list to array
 *     cdef char *dataptr
 *     dataptr = <char *>malloc(len+1)             # <<<<<<<<<<<<<<
 *     dataptr[0] = command
 *     for i in xrange(len):
 */
  __pyx_t_2 = PyNumber_Add(__pyx_v_len, __pyx_int_1); if (unlikely(!__pyx_t_2)) {__pyx_filename = __pyx_f[0]; __pyx_lineno = 154; __pyx_clineno = __LINE__; goto __pyx_L1_error;}
  __Pyx_GOTREF(__pyx_t_2);
  __pyx_t_7 = __Pyx_PyInt_AsSize_t(__pyx_t_2); if (unlikely((__pyx_t_7 == (size_t)-1) && PyErr_Occurred())) {__pyx_filename = __pyx_f[0]; __pyx_lineno = 154; __pyx_clineno = __LINE__; goto __pyx_L1_error;}
  __Pyx_DECREF(__pyx_t_2); __pyx_t_2 = 0;
  __pyx_v_dataptr = ((char *)malloc(__pyx_t_7));

  /* "py_nRFSN.pyx":155
 *     cdef char *dataptr
 *     dataptr = <char *>malloc(len+1)
 *     dataptr[0] = command             # <<<<<<<<<<<<<<
 *     for i in xrange(len):
 *         dataptr[i+1] = data[i]
 */
  __pyx_t_5 = __Pyx_PyInt_AsChar(__pyx_v_command); if (unlikely((__pyx_t_5 == (char)-1) && PyErr_Occurred())) {__pyx_filename = __pyx_f[0]; __pyx_lineno = 155; __pyx_clineno = __LINE__; goto __pyx_L1_error;}
  (__pyx_v_dataptr[0]) = __pyx_t_5;

  /* "py_nRFSN.pyx":156
 *     dataptr = <char *>malloc(len+1)
 *     dataptr[0] = command
 *     for i in xrange(len):             # <<<<<<<<<<<<<<
 *         dataptr[i+1] = data[i]
 * 
 */
  __pyx_t_2 = PyTuple_New(1); if (unlikely(!__pyx_t_2)) {__pyx_filename = __pyx_f[0]; __pyx_lineno = 156; __pyx_clineno = __LINE__; goto __pyx_L1_error;}
  __Pyx_GOTREF(((PyObject *)__pyx_t_2));
  __Pyx_INCREF(__pyx_v_len);
  PyTuple_SET_ITEM(__pyx_t_2, 0, __pyx_v_len);
  __Pyx_GIVEREF(__pyx_v_len);
  __pyx_t_1 = PyObject_Call(__pyx_builtin_xrange, ((PyObject *)__pyx_t_2), NULL); if (unlikely(!__pyx_t_1)) {__pyx_filename = __pyx_f[0]; __pyx_lineno = 156; __pyx_clineno = __LINE__; goto __pyx_L1_error;}
  __Pyx_GOTREF(__pyx_t_1);
  __Pyx_DECREF(((PyObject *)__pyx_t_2)); __pyx_t_2 = 0;
  if (PyList_CheckExact(__pyx_t_1) || PyTuple_CheckExact(__pyx_t_1)) {
    __pyx_t_2 = __pyx_t_1; __Pyx_INCREF(__pyx_t_2); __pyx_t_3 = 0;
    __pyx_t_4 = NULL;
  } else {
    __pyx_t_3 = -1; __pyx_t_2 = PyObject_GetIter(__pyx_t_1); if (unlikely(!__pyx_t_2)) {__pyx_filename = __pyx_f[0]; __pyx_lineno = 156; __pyx_clineno = __LINE__; goto __pyx_L1_error;}
    __Pyx_GOTREF(__pyx_t_2);
    __pyx_t_4 = Py_TYPE(__pyx_t_2)->tp_iternext;
  }
  __Pyx_DECREF(__pyx_t_1); __pyx_t_1 = 0;
  for (;;) {
    if (PyList_CheckExact(__pyx_t_2)) {
      if (__pyx_t_3 >= PyList_GET_SIZE(__pyx_t_2)) break;
      __pyx_t_1 = PyList_GET_ITEM(__pyx_t_2, __pyx_t_3); __Pyx_INCREF(__pyx_t_1); __pyx_t_3++;
    } else if (PyTuple_CheckExact(__pyx_t_2)) {
      if (__pyx_t_3 >= PyTuple_GET_SIZE(__pyx_t_2)) break;
      __pyx_t_1 = PyTuple_GET_ITEM(__pyx_t_2, __pyx_t_3); __Pyx_INCREF(__pyx_t_1); __pyx_t_3++;
    } else {
      __pyx_t_1 = __pyx_t_4(__pyx_t_2);
      if (unlikely(!__pyx_t_1)) {
        if (PyErr_Occurred()) {
          if (likely(PyErr_ExceptionMatches(PyExc_StopIteration))) PyErr_Clear();
          else {__pyx_filename = __pyx_f[0]; __pyx_lineno = 156; __pyx_clineno = __LINE__; goto __pyx_L1_error;}
        }
        break;
      }
      __Pyx_GOTREF(__pyx_t_1);
    }
    __Pyx_XDECREF(__pyx_v_i);
    __pyx_v_i = __pyx_t_1;
    __pyx_t_1 = 0;

    /* "py_nRFSN.pyx":157
 *     dataptr[0] = command
 *     for i in xrange(len):
 *         dataptr[i+1] = data[i]             # <<<<<<<<<<<<<<
 * 
 *     # execute function
 */
    __pyx_t_1 = PyObject_GetItem(__pyx_v_data, __pyx_v_i); if (!__pyx_t_1) {__pyx_filename = __pyx_f[0]; __pyx_lineno = 157; __pyx_clineno = __LINE__; goto __pyx_L1_error;}
    __Pyx_GOTREF(__pyx_t_1);
    __pyx_t_5 = __Pyx_PyInt_AsChar(__pyx_t_1); if (unlikely((__pyx_t_5 == (char)-1) && PyErr_Occurred())) {__pyx_filename = __pyx_f[0]; __pyx_lineno = 157; __pyx_clineno = __LINE__; goto __pyx_L1_error;}
    __Pyx_DECREF(__pyx_t_1); __pyx_t_1 = 0;
    __pyx_t_1 = PyNumber_Add(__pyx_v_i, __pyx_int_1); if (unlikely(!__pyx_t_1)) {__pyx_filename = __pyx_f[0]; __pyx_lineno = 157; __pyx_clineno = __LINE__; goto __pyx_L1_error;}
    __Pyx_GOTREF(__pyx_t_1);
    __pyx_t_6 = __Pyx_PyIndex_AsSsize_t(__pyx_t_1); if (unlikely((__pyx_t_6 == (Py_ssize_t)-1) && PyErr_Occurred())) {__pyx_filename = __pyx_f[0]; __pyx_lineno = 157; __pyx_clineno = __LINE__; goto __pyx_L1_error;}
    __Pyx_DECREF(__pyx_t_1); __pyx_t_1 = 0;
    (__pyx_v_dataptr[__pyx_t_6]) = __pyx_t_5;
  }
  __Pyx_DECREF(__pyx_t_2); __pyx_t_2 = 0;

  /* "py_nRFSN.pyx":160
 * 
 *     # execute function
 *     defns.setSensorValsFast(addrptr, dataptr, len)             # <<<<<<<<<<<<<<
 */
  __pyx_t_5 = __Pyx_PyInt_AsChar(__pyx_v_len); if (unlikely((__pyx_t_5 == (char)-1) && PyErr_Occurred())) {__pyx_filename = __pyx_f[0]; __pyx_lineno = 160; __pyx_clineno = __LINE__; goto __pyx_L1_error;}
  setSensorValsFast(__pyx_v_addrptr, __pyx_v_dataptr, __pyx_t_5);

  __pyx_r = Py_None; __Pyx_INCREF(Py_None);
  goto __pyx_L0;
  __pyx_L1_error:;
  __Pyx_XDECREF(__pyx_t_1);
  __Pyx_XDECREF(__pyx_t_2);
  __Pyx_AddTraceback("py_nRFSN.py_setSensorValsFast", __pyx_clineno, __pyx_lineno, __pyx_filename);
  __pyx_r = NULL;
  __pyx_L0:;
  __Pyx_XDECREF(__pyx_v_i);
  __Pyx_XGIVEREF(__pyx_r);
  __Pyx_RefNannyFinishContext();
  return __pyx_r;
}

static PyMethodDef __pyx_methods[] = {
  {0, 0, 0, 0}
};

#if PY_MAJOR_VERSION >= 3
static struct PyModuleDef __pyx_moduledef = {
    PyModuleDef_HEAD_INIT,
    __Pyx_NAMESTR("py_nRFSN"),
    0, /* m_doc */
    -1, /* m_size */
    __pyx_methods /* m_methods */,
    NULL, /* m_reload */
    NULL, /* m_traverse */
    NULL, /* m_clear */
    NULL /* m_free */
};
#endif

static __Pyx_StringTabEntry __pyx_string_tab[] = {
  {&__pyx_n_s_4, __pyx_k_4, sizeof(__pyx_k_4), 0, 0, 1, 1},
  {&__pyx_n_s__CE, __pyx_k__CE, sizeof(__pyx_k__CE), 0, 0, 1, 1},
  {&__pyx_n_s__IRQ, __pyx_k__IRQ, sizeof(__pyx_k__IRQ), 0, 0, 1, 1},
  {&__pyx_n_s__LED, __pyx_k__LED, sizeof(__pyx_k__LED), 0, 0, 1, 1},
  {&__pyx_n_s__SPIDiv, __pyx_k__SPIDiv, sizeof(__pyx_k__SPIDiv), 0, 0, 1, 1},
  {&__pyx_n_s____main__, __pyx_k____main__, sizeof(__pyx_k____main__), 0, 0, 1, 1},
  {&__pyx_n_s____test__, __pyx_k____test__, sizeof(__pyx_k____test__), 0, 0, 1, 1},
  {&__pyx_n_s__addr, __pyx_k__addr, sizeof(__pyx_k__addr), 0, 0, 1, 1},
  {&__pyx_n_s__buf, __pyx_k__buf, sizeof(__pyx_k__buf), 0, 0, 1, 1},
  {&__pyx_n_s__command, __pyx_k__command, sizeof(__pyx_k__command), 0, 0, 1, 1},
  {&__pyx_n_s__data, __pyx_k__data, sizeof(__pyx_k__data), 0, 0, 1, 1},
  {&__pyx_n_s__len, __pyx_k__len, sizeof(__pyx_k__len), 0, 0, 1, 1},
  {&__pyx_n_s__pipe, __pyx_k__pipe, sizeof(__pyx_k__pipe), 0, 0, 1, 1},
  {&__pyx_n_s__py_bcmDelay, __pyx_k__py_bcmDelay, sizeof(__pyx_k__py_bcmDelay), 0, 0, 1, 1},
  {&__pyx_n_s__py_bcmDelayM, __pyx_k__py_bcmDelayM, sizeof(__pyx_k__py_bcmDelayM), 0, 0, 1, 1},
  {&__pyx_n_s__py_clearInt, __pyx_k__py_clearInt, sizeof(__pyx_k__py_clearInt), 0, 0, 1, 1},
  {&__pyx_n_s__py_flush, __pyx_k__py_flush, sizeof(__pyx_k__py_flush), 0, 0, 1, 1},
  {&__pyx_n_s__py_getBufIn, __pyx_k__py_getBufIn, sizeof(__pyx_k__py_getBufIn), 0, 0, 1, 1},
  {&__pyx_n_s__py_getChannel, __pyx_k__py_getChannel, sizeof(__pyx_k__py_getChannel), 0, 0, 1, 1},
  {&__pyx_n_s__py_getMaxRT, __pyx_k__py_getMaxRT, sizeof(__pyx_k__py_getMaxRT), 0, 0, 1, 1},
  {&__pyx_n_s__py_getMaxRTdelay, __pyx_k__py_getMaxRTdelay, sizeof(__pyx_k__py_getMaxRTdelay), 0, 0, 1, 1},
  {&__pyx_n_s__py_getMode, __pyx_k__py_getMode, sizeof(__pyx_k__py_getMode), 0, 0, 1, 1},
  {&__pyx_n_s__py_getPayload, __pyx_k__py_getPayload, sizeof(__pyx_k__py_getPayload), 0, 0, 1, 1},
  {&__pyx_n_s__py_getPayloadSize, __pyx_k__py_getPayloadSize, sizeof(__pyx_k__py_getPayloadSize), 0, 0, 1, 1},
  {&__pyx_n_s__py_getPower, __pyx_k__py_getPower, sizeof(__pyx_k__py_getPower), 0, 0, 1, 1},
  {&__pyx_n_s__py_getRXAddr, __pyx_k__py_getRXAddr, sizeof(__pyx_k__py_getRXAddr), 0, 0, 1, 1},
  {&__pyx_n_s__py_getSensorVals, __pyx_k__py_getSensorVals, sizeof(__pyx_k__py_getSensorVals), 0, 0, 1, 1},
  {&__pyx_n_s__py_getTXAddr, __pyx_k__py_getTXAddr, sizeof(__pyx_k__py_getTXAddr), 0, 0, 1, 1},
  {&__pyx_n_s__py_nRFSN, __pyx_k__py_nRFSN, sizeof(__pyx_k__py_nRFSN), 0, 0, 1, 1},
  {&__pyx_n_s__py_nRFSN_init, __pyx_k__py_nRFSN_init, sizeof(__pyx_k__py_nRFSN_init), 0, 0, 1, 1},
  {&__pyx_n_s__py_putBufOut, __pyx_k__py_putBufOut, sizeof(__pyx_k__py_putBufOut), 0, 0, 1, 1},
  {&__pyx_n_s__py_putSingleBufOut, __pyx_k__py_putSingleBufOut, sizeof(__pyx_k__py_putSingleBufOut), 0, 0, 1, 1},
  {&__pyx_n_s__py_setChannel, __pyx_k__py_setChannel, sizeof(__pyx_k__py_setChannel), 0, 0, 1, 1},
  {&__pyx_n_s__py_setMaxRT, __pyx_k__py_setMaxRT, sizeof(__pyx_k__py_setMaxRT), 0, 0, 1, 1},
  {&__pyx_n_s__py_setMaxRTdelay, __pyx_k__py_setMaxRTdelay, sizeof(__pyx_k__py_setMaxRTdelay), 0, 0, 1, 1},
  {&__pyx_n_s__py_setPower, __pyx_k__py_setPower, sizeof(__pyx_k__py_setPower), 0, 0, 1, 1},
  {&__pyx_n_s__py_setRXAddr, __pyx_k__py_setRXAddr, sizeof(__pyx_k__py_setRXAddr), 0, 0, 1, 1},
  {&__pyx_n_s__py_setRXMode, __pyx_k__py_setRXMode, sizeof(__pyx_k__py_setRXMode), 0, 0, 1, 1},
  {&__pyx_n_s__py_setSensorVals, __pyx_k__py_setSensorVals, sizeof(__pyx_k__py_setSensorVals), 0, 0, 1, 1},
  {&__pyx_n_s__py_setTXAddr, __pyx_k__py_setTXAddr, sizeof(__pyx_k__py_setTXAddr), 0, 0, 1, 1},
  {&__pyx_n_s__py_setTXMode, __pyx_k__py_setTXMode, sizeof(__pyx_k__py_setTXMode), 0, 0, 1, 1},
  {&__pyx_n_s__py_stop, __pyx_k__py_stop, sizeof(__pyx_k__py_stop), 0, 0, 1, 1},
  {&__pyx_n_s__py_transmit, __pyx_k__py_transmit, sizeof(__pyx_k__py_transmit), 0, 0, 1, 1},
  {&__pyx_n_s__py_updateStatus, __pyx_k__py_updateStatus, sizeof(__pyx_k__py_updateStatus), 0, 0, 1, 1},
  {&__pyx_n_s__range, __pyx_k__range, sizeof(__pyx_k__range), 0, 0, 1, 1},
  {&__pyx_n_s__xrange, __pyx_k__xrange, sizeof(__pyx_k__xrange), 0, 0, 1, 1},
  {0, 0, 0, 0, 0, 0, 0}
};
static int __Pyx_InitCachedBuiltins(void) {
  #if PY_MAJOR_VERSION >= 3
  __pyx_builtin_xrange = __Pyx_GetName(__pyx_b, __pyx_n_s__range); if (!__pyx_builtin_xrange) {__pyx_filename = __pyx_f[0]; __pyx_lineno = 49; __pyx_clineno = __LINE__; goto __pyx_L1_error;}
  #else
  __pyx_builtin_xrange = __Pyx_GetName(__pyx_b, __pyx_n_s__xrange); if (!__pyx_builtin_xrange) {__pyx_filename = __pyx_f[0]; __pyx_lineno = 49; __pyx_clineno = __LINE__; goto __pyx_L1_error;}
  #endif
  return 0;
  __pyx_L1_error:;
  return -1;
}

static int __Pyx_InitCachedConstants(void) {
  __Pyx_RefNannyDeclarations
  __Pyx_RefNannySetupContext("__Pyx_InitCachedConstants");

  /* "py_nRFSN.pyx":116
 *     cdef char *addrptr
 *     addrptr = <char *>malloc(4)
 *     for i in xrange(4):             # <<<<<<<<<<<<<<
 *         addrptr[i] = addr[i]
 * 
 */
  __pyx_k_tuple_1 = PyTuple_New(1); if (unlikely(!__pyx_k_tuple_1)) {__pyx_filename = __pyx_f[0]; __pyx_lineno = 116; __pyx_clineno = __LINE__; goto __pyx_L1_error;}
  __Pyx_GOTREF(((PyObject *)__pyx_k_tuple_1));
  __Pyx_INCREF(__pyx_int_4);
  PyTuple_SET_ITEM(__pyx_k_tuple_1, 0, __pyx_int_4);
  __Pyx_GIVEREF(__pyx_int_4);
  __Pyx_GIVEREF(((PyObject *)__pyx_k_tuple_1));

  /* "py_nRFSN.pyx":132
 *     cdef char *addrptr
 *     addrptr = <char *>malloc(4)
 *     for i in xrange(4):             # <<<<<<<<<<<<<<
 *         addrptr[i] = addr[i]
 * 
 */
  __pyx_k_tuple_2 = PyTuple_New(1); if (unlikely(!__pyx_k_tuple_2)) {__pyx_filename = __pyx_f[0]; __pyx_lineno = 132; __pyx_clineno = __LINE__; goto __pyx_L1_error;}
  __Pyx_GOTREF(((PyObject *)__pyx_k_tuple_2));
  __Pyx_INCREF(__pyx_int_4);
  PyTuple_SET_ITEM(__pyx_k_tuple_2, 0, __pyx_int_4);
  __Pyx_GIVEREF(__pyx_int_4);
  __Pyx_GIVEREF(((PyObject *)__pyx_k_tuple_2));

  /* "py_nRFSN.pyx":149
 *     cdef char *addrptr
 *     addrptr = <char *>malloc(4)
 *     for i in xrange(4):             # <<<<<<<<<<<<<<
 *         addrptr[i] = addr[i]
 * 
 */
  __pyx_k_tuple_3 = PyTuple_New(1); if (unlikely(!__pyx_k_tuple_3)) {__pyx_filename = __pyx_f[0]; __pyx_lineno = 149; __pyx_clineno = __LINE__; goto __pyx_L1_error;}
  __Pyx_GOTREF(((PyObject *)__pyx_k_tuple_3));
  __Pyx_INCREF(__pyx_int_4);
  PyTuple_SET_ITEM(__pyx_k_tuple_3, 0, __pyx_int_4);
  __Pyx_GIVEREF(__pyx_int_4);
  __Pyx_GIVEREF(((PyObject *)__pyx_k_tuple_3));
  __Pyx_RefNannyFinishContext();
  return 0;
  __pyx_L1_error:;
  __Pyx_RefNannyFinishContext();
  return -1;
}

static int __Pyx_InitGlobals(void) {
  if (__Pyx_InitStrings(__pyx_string_tab) < 0) {__pyx_filename = __pyx_f[0]; __pyx_lineno = 1; __pyx_clineno = __LINE__; goto __pyx_L1_error;};
  __pyx_int_1 = PyInt_FromLong(1); if (unlikely(!__pyx_int_1)) {__pyx_filename = __pyx_f[0]; __pyx_lineno = 1; __pyx_clineno = __LINE__; goto __pyx_L1_error;};
  __pyx_int_4 = PyInt_FromLong(4); if (unlikely(!__pyx_int_4)) {__pyx_filename = __pyx_f[0]; __pyx_lineno = 1; __pyx_clineno = __LINE__; goto __pyx_L1_error;};
  return 0;
  __pyx_L1_error:;
  return -1;
}

#if PY_MAJOR_VERSION < 3
PyMODINIT_FUNC initpy_nRFSN(void); /*proto*/
PyMODINIT_FUNC initpy_nRFSN(void)
#else
PyMODINIT_FUNC PyInit_py_nRFSN(void); /*proto*/
PyMODINIT_FUNC PyInit_py_nRFSN(void)
#endif
{
  PyObject *__pyx_t_1 = NULL;
  __Pyx_RefNannyDeclarations
  #if CYTHON_REFNANNY
  __Pyx_RefNanny = __Pyx_RefNannyImportAPI("refnanny");
  if (!__Pyx_RefNanny) {
      PyErr_Clear();
      __Pyx_RefNanny = __Pyx_RefNannyImportAPI("Cython.Runtime.refnanny");
      if (!__Pyx_RefNanny)
          Py_FatalError("failed to import 'refnanny' module");
  }
  #endif
  __Pyx_RefNannySetupContext("PyMODINIT_FUNC PyInit_py_nRFSN(void)");
  if ( __Pyx_check_binary_version() < 0) {__pyx_filename = __pyx_f[0]; __pyx_lineno = 1; __pyx_clineno = __LINE__; goto __pyx_L1_error;}
  __pyx_empty_tuple = PyTuple_New(0); if (unlikely(!__pyx_empty_tuple)) {__pyx_filename = __pyx_f[0]; __pyx_lineno = 1; __pyx_clineno = __LINE__; goto __pyx_L1_error;}
  __pyx_empty_bytes = PyBytes_FromStringAndSize("", 0); if (unlikely(!__pyx_empty_bytes)) {__pyx_filename = __pyx_f[0]; __pyx_lineno = 1; __pyx_clineno = __LINE__; goto __pyx_L1_error;}
  #ifdef __pyx_binding_PyCFunctionType_USED
  if (__pyx_binding_PyCFunctionType_init() < 0) {__pyx_filename = __pyx_f[0]; __pyx_lineno = 1; __pyx_clineno = __LINE__; goto __pyx_L1_error;}
  #endif
  /*--- Library function declarations ---*/
  /*--- Threads initialization code ---*/
  #if defined(__PYX_FORCE_INIT_THREADS) && __PYX_FORCE_INIT_THREADS
  #ifdef WITH_THREAD /* Python build with threading support? */
  PyEval_InitThreads();
  #endif
  #endif
  /*--- Module creation code ---*/
  #if PY_MAJOR_VERSION < 3
  __pyx_m = Py_InitModule4(__Pyx_NAMESTR("py_nRFSN"), __pyx_methods, 0, 0, PYTHON_API_VERSION);
  #else
  __pyx_m = PyModule_Create(&__pyx_moduledef);
  #endif
  if (!__pyx_m) {__pyx_filename = __pyx_f[0]; __pyx_lineno = 1; __pyx_clineno = __LINE__; goto __pyx_L1_error;};
  #if PY_MAJOR_VERSION < 3
  Py_INCREF(__pyx_m);
  #endif
  __pyx_b = PyImport_AddModule(__Pyx_NAMESTR(__Pyx_BUILTIN_MODULE_NAME));
  if (!__pyx_b) {__pyx_filename = __pyx_f[0]; __pyx_lineno = 1; __pyx_clineno = __LINE__; goto __pyx_L1_error;};
  if (__Pyx_SetAttrString(__pyx_m, "__builtins__", __pyx_b) < 0) {__pyx_filename = __pyx_f[0]; __pyx_lineno = 1; __pyx_clineno = __LINE__; goto __pyx_L1_error;};
  /*--- Initialize various global constants etc. ---*/
  if (unlikely(__Pyx_InitGlobals() < 0)) {__pyx_filename = __pyx_f[0]; __pyx_lineno = 1; __pyx_clineno = __LINE__; goto __pyx_L1_error;}
  if (__pyx_module_is_main_py_nRFSN) {
    if (__Pyx_SetAttrString(__pyx_m, "__name__", __pyx_n_s____main__) < 0) {__pyx_filename = __pyx_f[0]; __pyx_lineno = 1; __pyx_clineno = __LINE__; goto __pyx_L1_error;};
  }
  /*--- Builtin init code ---*/
  if (unlikely(__Pyx_InitCachedBuiltins() < 0)) {__pyx_filename = __pyx_f[0]; __pyx_lineno = 1; __pyx_clineno = __LINE__; goto __pyx_L1_error;}
  /*--- Constants init code ---*/
  if (unlikely(__Pyx_InitCachedConstants() < 0)) {__pyx_filename = __pyx_f[0]; __pyx_lineno = 1; __pyx_clineno = __LINE__; goto __pyx_L1_error;}
  /*--- Global init code ---*/
  /*--- Variable export code ---*/
  /*--- Function export code ---*/
  /*--- Type init code ---*/
  /*--- Type import code ---*/
  /*--- Variable import code ---*/
  /*--- Function import code ---*/
  /*--- Execution code ---*/

  /* "py_nRFSN.pyx":10
 * # C nRFSN Wrapper code
 * #----------------------------------------------------------------------------------
 * def py_nRFSN_init(char SPIDiv, char CE, char IRQ, char LED):             # <<<<<<<<<<<<<<
 *     defns.nRFSN_init(SPIDiv, CE, IRQ, LED)
 * 
 */
  __pyx_t_1 = PyCFunction_NewEx(&__pyx_mdef_8py_nRFSN_py_nRFSN_init, NULL, __pyx_n_s__py_nRFSN); if (unlikely(!__pyx_t_1)) {__pyx_filename = __pyx_f[0]; __pyx_lineno = 10; __pyx_clineno = __LINE__; goto __pyx_L1_error;}
  __Pyx_GOTREF(__pyx_t_1);
  if (PyObject_SetAttr(__pyx_m, __pyx_n_s__py_nRFSN_init, __pyx_t_1) < 0) {__pyx_filename = __pyx_f[0]; __pyx_lineno = 10; __pyx_clineno = __LINE__; goto __pyx_L1_error;}
  __Pyx_DECREF(__pyx_t_1); __pyx_t_1 = 0;

  /* "py_nRFSN.pyx":13
 *     defns.nRFSN_init(SPIDiv, CE, IRQ, LED)
 * 
 * def py_setTXMode():             # <<<<<<<<<<<<<<
 *     defns.setTXMode()
 * 
 */
  __pyx_t_1 = PyCFunction_NewEx(&__pyx_mdef_8py_nRFSN_1py_setTXMode, NULL, __pyx_n_s__py_nRFSN); if (unlikely(!__pyx_t_1)) {__pyx_filename = __pyx_f[0]; __pyx_lineno = 13; __pyx_clineno = __LINE__; goto __pyx_L1_error;}
  __Pyx_GOTREF(__pyx_t_1);
  if (PyObject_SetAttr(__pyx_m, __pyx_n_s__py_setTXMode, __pyx_t_1) < 0) {__pyx_filename = __pyx_f[0]; __pyx_lineno = 13; __pyx_clineno = __LINE__; goto __pyx_L1_error;}
  __Pyx_DECREF(__pyx_t_1); __pyx_t_1 = 0;

  /* "py_nRFSN.pyx":16
 *     defns.setTXMode()
 * 
 * def py_setRXMode():             # <<<<<<<<<<<<<<
 *     defns.setTXMode()
 * 
 */
  __pyx_t_1 = PyCFunction_NewEx(&__pyx_mdef_8py_nRFSN_2py_setRXMode, NULL, __pyx_n_s__py_nRFSN); if (unlikely(!__pyx_t_1)) {__pyx_filename = __pyx_f[0]; __pyx_lineno = 16; __pyx_clineno = __LINE__; goto __pyx_L1_error;}
  __Pyx_GOTREF(__pyx_t_1);
  if (PyObject_SetAttr(__pyx_m, __pyx_n_s__py_setRXMode, __pyx_t_1) < 0) {__pyx_filename = __pyx_f[0]; __pyx_lineno = 16; __pyx_clineno = __LINE__; goto __pyx_L1_error;}
  __Pyx_DECREF(__pyx_t_1); __pyx_t_1 = 0;

  /* "py_nRFSN.pyx":19
 *     defns.setTXMode()
 * 
 * def py_getMode():             # <<<<<<<<<<<<<<
 *     return defns.getMode()
 * 
 */
  __pyx_t_1 = PyCFunction_NewEx(&__pyx_mdef_8py_nRFSN_3py_getMode, NULL, __pyx_n_s__py_nRFSN); if (unlikely(!__pyx_t_1)) {__pyx_filename = __pyx_f[0]; __pyx_lineno = 19; __pyx_clineno = __LINE__; goto __pyx_L1_error;}
  __Pyx_GOTREF(__pyx_t_1);
  if (PyObject_SetAttr(__pyx_m, __pyx_n_s__py_getMode, __pyx_t_1) < 0) {__pyx_filename = __pyx_f[0]; __pyx_lineno = 19; __pyx_clineno = __LINE__; goto __pyx_L1_error;}
  __Pyx_DECREF(__pyx_t_1); __pyx_t_1 = 0;

  /* "py_nRFSN.pyx":22
 *     return defns.getMode()
 * 
 * def py_setPower(char pwr):             # <<<<<<<<<<<<<<
 *     defns.setPower(pwr)
 * 
 */
  __pyx_t_1 = PyCFunction_NewEx(&__pyx_mdef_8py_nRFSN_4py_setPower, NULL, __pyx_n_s__py_nRFSN); if (unlikely(!__pyx_t_1)) {__pyx_filename = __pyx_f[0]; __pyx_lineno = 22; __pyx_clineno = __LINE__; goto __pyx_L1_error;}
  __Pyx_GOTREF(__pyx_t_1);
  if (PyObject_SetAttr(__pyx_m, __pyx_n_s__py_setPower, __pyx_t_1) < 0) {__pyx_filename = __pyx_f[0]; __pyx_lineno = 22; __pyx_clineno = __LINE__; goto __pyx_L1_error;}
  __Pyx_DECREF(__pyx_t_1); __pyx_t_1 = 0;

  /* "py_nRFSN.pyx":25
 *     defns.setPower(pwr)
 * 
 * def py_getPower():             # <<<<<<<<<<<<<<
 *     return defns.getPower()
 * 
 */
  __pyx_t_1 = PyCFunction_NewEx(&__pyx_mdef_8py_nRFSN_5py_getPower, NULL, __pyx_n_s__py_nRFSN); if (unlikely(!__pyx_t_1)) {__pyx_filename = __pyx_f[0]; __pyx_lineno = 25; __pyx_clineno = __LINE__; goto __pyx_L1_error;}
  __Pyx_GOTREF(__pyx_t_1);
  if (PyObject_SetAttr(__pyx_m, __pyx_n_s__py_getPower, __pyx_t_1) < 0) {__pyx_filename = __pyx_f[0]; __pyx_lineno = 25; __pyx_clineno = __LINE__; goto __pyx_L1_error;}
  __Pyx_DECREF(__pyx_t_1); __pyx_t_1 = 0;

  /* "py_nRFSN.pyx":28
 *     return defns.getPower()
 * 
 * def py_setChannel(char ch):             # <<<<<<<<<<<<<<
 *     defns.setChannel(ch)
 * 
 */
  __pyx_t_1 = PyCFunction_NewEx(&__pyx_mdef_8py_nRFSN_6py_setChannel, NULL, __pyx_n_s__py_nRFSN); if (unlikely(!__pyx_t_1)) {__pyx_filename = __pyx_f[0]; __pyx_lineno = 28; __pyx_clineno = __LINE__; goto __pyx_L1_error;}
  __Pyx_GOTREF(__pyx_t_1);
  if (PyObject_SetAttr(__pyx_m, __pyx_n_s__py_setChannel, __pyx_t_1) < 0) {__pyx_filename = __pyx_f[0]; __pyx_lineno = 28; __pyx_clineno = __LINE__; goto __pyx_L1_error;}
  __Pyx_DECREF(__pyx_t_1); __pyx_t_1 = 0;

  /* "py_nRFSN.pyx":31
 *     defns.setChannel(ch)
 * 
 * def py_getChannel():             # <<<<<<<<<<<<<<
 *     return defns.getChannel()
 * 
 */
  __pyx_t_1 = PyCFunction_NewEx(&__pyx_mdef_8py_nRFSN_7py_getChannel, NULL, __pyx_n_s__py_nRFSN); if (unlikely(!__pyx_t_1)) {__pyx_filename = __pyx_f[0]; __pyx_lineno = 31; __pyx_clineno = __LINE__; goto __pyx_L1_error;}
  __Pyx_GOTREF(__pyx_t_1);
  if (PyObject_SetAttr(__pyx_m, __pyx_n_s__py_getChannel, __pyx_t_1) < 0) {__pyx_filename = __pyx_f[0]; __pyx_lineno = 31; __pyx_clineno = __LINE__; goto __pyx_L1_error;}
  __Pyx_DECREF(__pyx_t_1); __pyx_t_1 = 0;

  /* "py_nRFSN.pyx":34
 *     return defns.getChannel()
 * 
 * def py_setMaxRT(char max):             # <<<<<<<<<<<<<<
 *     defns.setMaxRT(max)
 * 
 */
  __pyx_t_1 = PyCFunction_NewEx(&__pyx_mdef_8py_nRFSN_8py_setMaxRT, NULL, __pyx_n_s__py_nRFSN); if (unlikely(!__pyx_t_1)) {__pyx_filename = __pyx_f[0]; __pyx_lineno = 34; __pyx_clineno = __LINE__; goto __pyx_L1_error;}
  __Pyx_GOTREF(__pyx_t_1);
  if (PyObject_SetAttr(__pyx_m, __pyx_n_s__py_setMaxRT, __pyx_t_1) < 0) {__pyx_filename = __pyx_f[0]; __pyx_lineno = 34; __pyx_clineno = __LINE__; goto __pyx_L1_error;}
  __Pyx_DECREF(__pyx_t_1); __pyx_t_1 = 0;

  /* "py_nRFSN.pyx":37
 *     defns.setMaxRT(max)
 * 
 * def py_getMaxRT():             # <<<<<<<<<<<<<<
 *     return defns.getMaxRT()
 * 
 */
  __pyx_t_1 = PyCFunction_NewEx(&__pyx_mdef_8py_nRFSN_9py_getMaxRT, NULL, __pyx_n_s__py_nRFSN); if (unlikely(!__pyx_t_1)) {__pyx_filename = __pyx_f[0]; __pyx_lineno = 37; __pyx_clineno = __LINE__; goto __pyx_L1_error;}
  __Pyx_GOTREF(__pyx_t_1);
  if (PyObject_SetAttr(__pyx_m, __pyx_n_s__py_getMaxRT, __pyx_t_1) < 0) {__pyx_filename = __pyx_f[0]; __pyx_lineno = 37; __pyx_clineno = __LINE__; goto __pyx_L1_error;}
  __Pyx_DECREF(__pyx_t_1); __pyx_t_1 = 0;

  /* "py_nRFSN.pyx":40
 *     return defns.getMaxRT()
 * 
 * def py_setMaxRTdelay(char delay):             # <<<<<<<<<<<<<<
 *     defns.setMaxRTdelay(delay)
 * 
 */
  __pyx_t_1 = PyCFunction_NewEx(&__pyx_mdef_8py_nRFSN_10py_setMaxRTdelay, NULL, __pyx_n_s__py_nRFSN); if (unlikely(!__pyx_t_1)) {__pyx_filename = __pyx_f[0]; __pyx_lineno = 40; __pyx_clineno = __LINE__; goto __pyx_L1_error;}
  __Pyx_GOTREF(__pyx_t_1);
  if (PyObject_SetAttr(__pyx_m, __pyx_n_s__py_setMaxRTdelay, __pyx_t_1) < 0) {__pyx_filename = __pyx_f[0]; __pyx_lineno = 40; __pyx_clineno = __LINE__; goto __pyx_L1_error;}
  __Pyx_DECREF(__pyx_t_1); __pyx_t_1 = 0;

  /* "py_nRFSN.pyx":43
 *     defns.setMaxRTdelay(delay)
 * 
 * def py_getMaxRTdelay():             # <<<<<<<<<<<<<<
 *     return defns.getMaxRTdelay()
 * 
 */
  __pyx_t_1 = PyCFunction_NewEx(&__pyx_mdef_8py_nRFSN_11py_getMaxRTdelay, NULL, __pyx_n_s__py_nRFSN); if (unlikely(!__pyx_t_1)) {__pyx_filename = __pyx_f[0]; __pyx_lineno = 43; __pyx_clineno = __LINE__; goto __pyx_L1_error;}
  __Pyx_GOTREF(__pyx_t_1);
  if (PyObject_SetAttr(__pyx_m, __pyx_n_s__py_getMaxRTdelay, __pyx_t_1) < 0) {__pyx_filename = __pyx_f[0]; __pyx_lineno = 43; __pyx_clineno = __LINE__; goto __pyx_L1_error;}
  __Pyx_DECREF(__pyx_t_1); __pyx_t_1 = 0;

  /* "py_nRFSN.pyx":46
 *     return defns.getMaxRTdelay()
 * 
 * def py_setTXAddr(addr, char len):             # <<<<<<<<<<<<<<
 *     cdef char *addrptr
 *     addrptr = <char *>malloc(len)
 */
  __pyx_t_1 = PyCFunction_NewEx(&__pyx_mdef_8py_nRFSN_12py_setTXAddr, NULL, __pyx_n_s__py_nRFSN); if (unlikely(!__pyx_t_1)) {__pyx_filename = __pyx_f[0]; __pyx_lineno = 46; __pyx_clineno = __LINE__; goto __pyx_L1_error;}
  __Pyx_GOTREF(__pyx_t_1);
  if (PyObject_SetAttr(__pyx_m, __pyx_n_s__py_setTXAddr, __pyx_t_1) < 0) {__pyx_filename = __pyx_f[0]; __pyx_lineno = 46; __pyx_clineno = __LINE__; goto __pyx_L1_error;}
  __Pyx_DECREF(__pyx_t_1); __pyx_t_1 = 0;

  /* "py_nRFSN.pyx":54
 *     free(addrptr) # free memory after function is complete
 * 
 * def py_setRXAddr(char pipe, addr, char len):             # <<<<<<<<<<<<<<
 *     cdef char *addrptr
 *     addrptr = <char *>malloc(len)
 */
  __pyx_t_1 = PyCFunction_NewEx(&__pyx_mdef_8py_nRFSN_13py_setRXAddr, NULL, __pyx_n_s__py_nRFSN); if (unlikely(!__pyx_t_1)) {__pyx_filename = __pyx_f[0]; __pyx_lineno = 54; __pyx_clineno = __LINE__; goto __pyx_L1_error;}
  __Pyx_GOTREF(__pyx_t_1);
  if (PyObject_SetAttr(__pyx_m, __pyx_n_s__py_setRXAddr, __pyx_t_1) < 0) {__pyx_filename = __pyx_f[0]; __pyx_lineno = 54; __pyx_clineno = __LINE__; goto __pyx_L1_error;}
  __Pyx_DECREF(__pyx_t_1); __pyx_t_1 = 0;

  /* "py_nRFSN.pyx":62
 *     free(addrptr) # free memory after function is complete
 * 
 * def py_getTXAddr():             # <<<<<<<<<<<<<<
 *     cdef char* addr = defns.getTXAddr()
 *     return addr
 */
  __pyx_t_1 = PyCFunction_NewEx(&__pyx_mdef_8py_nRFSN_14py_getTXAddr, NULL, __pyx_n_s__py_nRFSN); if (unlikely(!__pyx_t_1)) {__pyx_filename = __pyx_f[0]; __pyx_lineno = 62; __pyx_clineno = __LINE__; goto __pyx_L1_error;}
  __Pyx_GOTREF(__pyx_t_1);
  if (PyObject_SetAttr(__pyx_m, __pyx_n_s__py_getTXAddr, __pyx_t_1) < 0) {__pyx_filename = __pyx_f[0]; __pyx_lineno = 62; __pyx_clineno = __LINE__; goto __pyx_L1_error;}
  __Pyx_DECREF(__pyx_t_1); __pyx_t_1 = 0;

  /* "py_nRFSN.pyx":66
 *     return addr
 * 
 * def py_getRXAddr(char pipe):             # <<<<<<<<<<<<<<
 *     cdef char* addr = defns.getRXAddr(pipe)
 *     return addr
 */
  __pyx_t_1 = PyCFunction_NewEx(&__pyx_mdef_8py_nRFSN_15py_getRXAddr, NULL, __pyx_n_s__py_nRFSN); if (unlikely(!__pyx_t_1)) {__pyx_filename = __pyx_f[0]; __pyx_lineno = 66; __pyx_clineno = __LINE__; goto __pyx_L1_error;}
  __Pyx_GOTREF(__pyx_t_1);
  if (PyObject_SetAttr(__pyx_m, __pyx_n_s__py_getRXAddr, __pyx_t_1) < 0) {__pyx_filename = __pyx_f[0]; __pyx_lineno = 66; __pyx_clineno = __LINE__; goto __pyx_L1_error;}
  __Pyx_DECREF(__pyx_t_1); __pyx_t_1 = 0;

  /* "py_nRFSN.pyx":70
 *     return addr
 * 
 * def py_clearInt(char intr):             # <<<<<<<<<<<<<<
 *     defns.clearInt(intr)
 * 
 */
  __pyx_t_1 = PyCFunction_NewEx(&__pyx_mdef_8py_nRFSN_16py_clearInt, NULL, __pyx_n_s__py_nRFSN); if (unlikely(!__pyx_t_1)) {__pyx_filename = __pyx_f[0]; __pyx_lineno = 70; __pyx_clineno = __LINE__; goto __pyx_L1_error;}
  __Pyx_GOTREF(__pyx_t_1);
  if (PyObject_SetAttr(__pyx_m, __pyx_n_s__py_clearInt, __pyx_t_1) < 0) {__pyx_filename = __pyx_f[0]; __pyx_lineno = 70; __pyx_clineno = __LINE__; goto __pyx_L1_error;}
  __Pyx_DECREF(__pyx_t_1); __pyx_t_1 = 0;

  /* "py_nRFSN.pyx":73
 *     defns.clearInt(intr)
 * 
 * def py_updateStatus():             # <<<<<<<<<<<<<<
 *     return defns.updateStatus()
 * 
 */
  __pyx_t_1 = PyCFunction_NewEx(&__pyx_mdef_8py_nRFSN_17py_updateStatus, NULL, __pyx_n_s__py_nRFSN); if (unlikely(!__pyx_t_1)) {__pyx_filename = __pyx_f[0]; __pyx_lineno = 73; __pyx_clineno = __LINE__; goto __pyx_L1_error;}
  __Pyx_GOTREF(__pyx_t_1);
  if (PyObject_SetAttr(__pyx_m, __pyx_n_s__py_updateStatus, __pyx_t_1) < 0) {__pyx_filename = __pyx_f[0]; __pyx_lineno = 73; __pyx_clineno = __LINE__; goto __pyx_L1_error;}
  __Pyx_DECREF(__pyx_t_1); __pyx_t_1 = 0;

  /* "py_nRFSN.pyx":76
 *     return defns.updateStatus()
 * 
 * def py_transmit(char len):             # <<<<<<<<<<<<<<
 *     defns.transmit(len)
 * 
 */
  __pyx_t_1 = PyCFunction_NewEx(&__pyx_mdef_8py_nRFSN_18py_transmit, NULL, __pyx_n_s__py_nRFSN); if (unlikely(!__pyx_t_1)) {__pyx_filename = __pyx_f[0]; __pyx_lineno = 76; __pyx_clineno = __LINE__; goto __pyx_L1_error;}
  __Pyx_GOTREF(__pyx_t_1);
  if (PyObject_SetAttr(__pyx_m, __pyx_n_s__py_transmit, __pyx_t_1) < 0) {__pyx_filename = __pyx_f[0]; __pyx_lineno = 76; __pyx_clineno = __LINE__; goto __pyx_L1_error;}
  __Pyx_DECREF(__pyx_t_1); __pyx_t_1 = 0;

  /* "py_nRFSN.pyx":79
 *     defns.transmit(len)
 * 
 * def py_getPayloadSize():             # <<<<<<<<<<<<<<
 *     return defns.getPayloadSize()
 * 
 */
  __pyx_t_1 = PyCFunction_NewEx(&__pyx_mdef_8py_nRFSN_19py_getPayloadSize, NULL, __pyx_n_s__py_nRFSN); if (unlikely(!__pyx_t_1)) {__pyx_filename = __pyx_f[0]; __pyx_lineno = 79; __pyx_clineno = __LINE__; goto __pyx_L1_error;}
  __Pyx_GOTREF(__pyx_t_1);
  if (PyObject_SetAttr(__pyx_m, __pyx_n_s__py_getPayloadSize, __pyx_t_1) < 0) {__pyx_filename = __pyx_f[0]; __pyx_lineno = 79; __pyx_clineno = __LINE__; goto __pyx_L1_error;}
  __Pyx_DECREF(__pyx_t_1); __pyx_t_1 = 0;

  /* "py_nRFSN.pyx":82
 *     return defns.getPayloadSize()
 * 
 * def py_getPayload(char len):             # <<<<<<<<<<<<<<
 *     defns.getPayload(len)
 * 
 */
  __pyx_t_1 = PyCFunction_NewEx(&__pyx_mdef_8py_nRFSN_20py_getPayload, NULL, __pyx_n_s__py_nRFSN); if (unlikely(!__pyx_t_1)) {__pyx_filename = __pyx_f[0]; __pyx_lineno = 82; __pyx_clineno = __LINE__; goto __pyx_L1_error;}
  __Pyx_GOTREF(__pyx_t_1);
  if (PyObject_SetAttr(__pyx_m, __pyx_n_s__py_getPayload, __pyx_t_1) < 0) {__pyx_filename = __pyx_f[0]; __pyx_lineno = 82; __pyx_clineno = __LINE__; goto __pyx_L1_error;}
  __Pyx_DECREF(__pyx_t_1); __pyx_t_1 = 0;

  /* "py_nRFSN.pyx":85
 *     defns.getPayload(len)
 * 
 * def py_putBufOut(buf, char len):             # <<<<<<<<<<<<<<
 *     cdef char *bufptr
 *     bufptr = <char *>malloc(len)
 */
  __pyx_t_1 = PyCFunction_NewEx(&__pyx_mdef_8py_nRFSN_21py_putBufOut, NULL, __pyx_n_s__py_nRFSN); if (unlikely(!__pyx_t_1)) {__pyx_filename = __pyx_f[0]; __pyx_lineno = 85; __pyx_clineno = __LINE__; goto __pyx_L1_error;}
  __Pyx_GOTREF(__pyx_t_1);
  if (PyObject_SetAttr(__pyx_m, __pyx_n_s__py_putBufOut, __pyx_t_1) < 0) {__pyx_filename = __pyx_f[0]; __pyx_lineno = 85; __pyx_clineno = __LINE__; goto __pyx_L1_error;}
  __Pyx_DECREF(__pyx_t_1); __pyx_t_1 = 0;

  /* "py_nRFSN.pyx":93
 *     free(bufptr) # free memory after function is complete
 * 
 * def py_putSingleBufOut(char data):             # <<<<<<<<<<<<<<
 *     defns.putSingleBufOut(data)
 * 
 */
  __pyx_t_1 = PyCFunction_NewEx(&__pyx_mdef_8py_nRFSN_22py_putSingleBufOut, NULL, __pyx_n_s__py_nRFSN); if (unlikely(!__pyx_t_1)) {__pyx_filename = __pyx_f[0]; __pyx_lineno = 93; __pyx_clineno = __LINE__; goto __pyx_L1_error;}
  __Pyx_GOTREF(__pyx_t_1);
  if (PyObject_SetAttr(__pyx_m, __pyx_n_s__py_putSingleBufOut, __pyx_t_1) < 0) {__pyx_filename = __pyx_f[0]; __pyx_lineno = 93; __pyx_clineno = __LINE__; goto __pyx_L1_error;}
  __Pyx_DECREF(__pyx_t_1); __pyx_t_1 = 0;

  /* "py_nRFSN.pyx":96
 *     defns.putSingleBufOut(data)
 * 
 * def py_getBufIn(char len):             # <<<<<<<<<<<<<<
 *     cdef char* data = defns.getBufIn(len)
 *     return data
 */
  __pyx_t_1 = PyCFunction_NewEx(&__pyx_mdef_8py_nRFSN_23py_getBufIn, NULL, __pyx_n_s__py_nRFSN); if (unlikely(!__pyx_t_1)) {__pyx_filename = __pyx_f[0]; __pyx_lineno = 96; __pyx_clineno = __LINE__; goto __pyx_L1_error;}
  __Pyx_GOTREF(__pyx_t_1);
  if (PyObject_SetAttr(__pyx_m, __pyx_n_s__py_getBufIn, __pyx_t_1) < 0) {__pyx_filename = __pyx_f[0]; __pyx_lineno = 96; __pyx_clineno = __LINE__; goto __pyx_L1_error;}
  __Pyx_DECREF(__pyx_t_1); __pyx_t_1 = 0;

  /* "py_nRFSN.pyx":100
 *     return data
 * 
 * def py_flush(int buf):  # (0) RX (1) TX             # <<<<<<<<<<<<<<
 *     defns.flush(buf)
 * 
 */
  __pyx_t_1 = PyCFunction_NewEx(&__pyx_mdef_8py_nRFSN_24py_flush, NULL, __pyx_n_s__py_nRFSN); if (unlikely(!__pyx_t_1)) {__pyx_filename = __pyx_f[0]; __pyx_lineno = 100; __pyx_clineno = __LINE__; goto __pyx_L1_error;}
  __Pyx_GOTREF(__pyx_t_1);
  if (PyObject_SetAttr(__pyx_m, __pyx_n_s__py_flush, __pyx_t_1) < 0) {__pyx_filename = __pyx_f[0]; __pyx_lineno = 100; __pyx_clineno = __LINE__; goto __pyx_L1_error;}
  __Pyx_DECREF(__pyx_t_1); __pyx_t_1 = 0;

  /* "py_nRFSN.pyx":103
 *     defns.flush(buf)
 * 
 * def py_bcmDelay(int ms):             # <<<<<<<<<<<<<<
 *     defns.bcmDelay(ms)
 * 
 */
  __pyx_t_1 = PyCFunction_NewEx(&__pyx_mdef_8py_nRFSN_25py_bcmDelay, NULL, __pyx_n_s__py_nRFSN); if (unlikely(!__pyx_t_1)) {__pyx_filename = __pyx_f[0]; __pyx_lineno = 103; __pyx_clineno = __LINE__; goto __pyx_L1_error;}
  __Pyx_GOTREF(__pyx_t_1);
  if (PyObject_SetAttr(__pyx_m, __pyx_n_s__py_bcmDelay, __pyx_t_1) < 0) {__pyx_filename = __pyx_f[0]; __pyx_lineno = 103; __pyx_clineno = __LINE__; goto __pyx_L1_error;}
  __Pyx_DECREF(__pyx_t_1); __pyx_t_1 = 0;

  /* "py_nRFSN.pyx":106
 *     defns.bcmDelay(ms)
 * 
 * def py_bcmDelayM(int us):             # <<<<<<<<<<<<<<
 *     defns.bcmDelay(us)
 * 
 */
  __pyx_t_1 = PyCFunction_NewEx(&__pyx_mdef_8py_nRFSN_26py_bcmDelayM, NULL, __pyx_n_s__py_nRFSN); if (unlikely(!__pyx_t_1)) {__pyx_filename = __pyx_f[0]; __pyx_lineno = 106; __pyx_clineno = __LINE__; goto __pyx_L1_error;}
  __Pyx_GOTREF(__pyx_t_1);
  if (PyObject_SetAttr(__pyx_m, __pyx_n_s__py_bcmDelayM, __pyx_t_1) < 0) {__pyx_filename = __pyx_f[0]; __pyx_lineno = 106; __pyx_clineno = __LINE__; goto __pyx_L1_error;}
  __Pyx_DECREF(__pyx_t_1); __pyx_t_1 = 0;

  /* "py_nRFSN.pyx":109
 *     defns.bcmDelay(us)
 * 
 * def py_stop():             # <<<<<<<<<<<<<<
 *     defns.stop()
 * 
 */
  __pyx_t_1 = PyCFunction_NewEx(&__pyx_mdef_8py_nRFSN_27py_stop, NULL, __pyx_n_s__py_nRFSN); if (unlikely(!__pyx_t_1)) {__pyx_filename = __pyx_f[0]; __pyx_lineno = 109; __pyx_clineno = __LINE__; goto __pyx_L1_error;}
  __Pyx_GOTREF(__pyx_t_1);
  if (PyObject_SetAttr(__pyx_m, __pyx_n_s__py_stop, __pyx_t_1) < 0) {__pyx_filename = __pyx_f[0]; __pyx_lineno = 109; __pyx_clineno = __LINE__; goto __pyx_L1_error;}
  __Pyx_DECREF(__pyx_t_1); __pyx_t_1 = 0;

  /* "py_nRFSN.pyx":112
 *     defns.stop()
 * 
 * def py_getSensorVals(addr, command, len):             # <<<<<<<<<<<<<<
 *     # addr list to array
 *     cdef char *addrptr
 */
  __pyx_t_1 = PyCFunction_NewEx(&__pyx_mdef_8py_nRFSN_28py_getSensorVals, NULL, __pyx_n_s__py_nRFSN); if (unlikely(!__pyx_t_1)) {__pyx_filename = __pyx_f[0]; __pyx_lineno = 112; __pyx_clineno = __LINE__; goto __pyx_L1_error;}
  __Pyx_GOTREF(__pyx_t_1);
  if (PyObject_SetAttr(__pyx_m, __pyx_n_s__py_getSensorVals, __pyx_t_1) < 0) {__pyx_filename = __pyx_f[0]; __pyx_lineno = 112; __pyx_clineno = __LINE__; goto __pyx_L1_error;}
  __Pyx_DECREF(__pyx_t_1); __pyx_t_1 = 0;

  /* "py_nRFSN.pyx":128
 *     return py_data
 * 
 * def py_setSensorVals(addr, command, data, len):             # <<<<<<<<<<<<<<
 *     # addr list to array
 *     cdef char *addrptr
 */
  __pyx_t_1 = PyCFunction_NewEx(&__pyx_mdef_8py_nRFSN_29py_setSensorVals, NULL, __pyx_n_s__py_nRFSN); if (unlikely(!__pyx_t_1)) {__pyx_filename = __pyx_f[0]; __pyx_lineno = 128; __pyx_clineno = __LINE__; goto __pyx_L1_error;}
  __Pyx_GOTREF(__pyx_t_1);
  if (PyObject_SetAttr(__pyx_m, __pyx_n_s__py_setSensorVals, __pyx_t_1) < 0) {__pyx_filename = __pyx_f[0]; __pyx_lineno = 128; __pyx_clineno = __LINE__; goto __pyx_L1_error;}
  __Pyx_DECREF(__pyx_t_1); __pyx_t_1 = 0;

  /* "py_nRFSN.pyx":145
 *     defns.setSensorVals(addrptr, dataptr, len)
 * 
 * def py_setSensorValsFast(addr, command, data, len):             # <<<<<<<<<<<<<<
 *     # addr list to array
 *     cdef char *addrptr
 */
  __pyx_t_1 = PyCFunction_NewEx(&__pyx_mdef_8py_nRFSN_30py_setSensorValsFast, NULL, __pyx_n_s__py_nRFSN); if (unlikely(!__pyx_t_1)) {__pyx_filename = __pyx_f[0]; __pyx_lineno = 145; __pyx_clineno = __LINE__; goto __pyx_L1_error;}
  __Pyx_GOTREF(__pyx_t_1);
  if (PyObject_SetAttr(__pyx_m, __pyx_n_s_4, __pyx_t_1) < 0) {__pyx_filename = __pyx_f[0]; __pyx_lineno = 145; __pyx_clineno = __LINE__; goto __pyx_L1_error;}
  __Pyx_DECREF(__pyx_t_1); __pyx_t_1 = 0;

  /* "py_nRFSN.pyx":1
 * cimport defns             # <<<<<<<<<<<<<<
 * 
 * cimport cython
 */
  __pyx_t_1 = PyDict_New(); if (unlikely(!__pyx_t_1)) {__pyx_filename = __pyx_f[0]; __pyx_lineno = 1; __pyx_clineno = __LINE__; goto __pyx_L1_error;}
  __Pyx_GOTREF(((PyObject *)__pyx_t_1));
  if (PyObject_SetAttr(__pyx_m, __pyx_n_s____test__, ((PyObject *)__pyx_t_1)) < 0) {__pyx_filename = __pyx_f[0]; __pyx_lineno = 1; __pyx_clineno = __LINE__; goto __pyx_L1_error;}
  __Pyx_DECREF(((PyObject *)__pyx_t_1)); __pyx_t_1 = 0;
  goto __pyx_L0;
  __pyx_L1_error:;
  __Pyx_XDECREF(__pyx_t_1);
  if (__pyx_m) {
    __Pyx_AddTraceback("init py_nRFSN", __pyx_clineno, __pyx_lineno, __pyx_filename);
    Py_DECREF(__pyx_m); __pyx_m = 0;
  } else if (!PyErr_Occurred()) {
    PyErr_SetString(PyExc_ImportError, "init py_nRFSN");
  }
  __pyx_L0:;
  __Pyx_RefNannyFinishContext();
  #if PY_MAJOR_VERSION < 3
  return;
  #else
  return __pyx_m;
  #endif
}

/* Runtime support code */

#if CYTHON_REFNANNY
static __Pyx_RefNannyAPIStruct *__Pyx_RefNannyImportAPI(const char *modname) {
    PyObject *m = NULL, *p = NULL;
    void *r = NULL;
    m = PyImport_ImportModule((char *)modname);
    if (!m) goto end;
    p = PyObject_GetAttrString(m, (char *)"RefNannyAPI");
    if (!p) goto end;
    r = PyLong_AsVoidPtr(p);
end:
    Py_XDECREF(p);
    Py_XDECREF(m);
    return (__Pyx_RefNannyAPIStruct *)r;
}
#endif /* CYTHON_REFNANNY */

static PyObject *__Pyx_GetName(PyObject *dict, PyObject *name) {
    PyObject *result;
    result = PyObject_GetAttr(dict, name);
    if (!result) {
        if (dict != __pyx_b) {
            PyErr_Clear();
            result = PyObject_GetAttr(__pyx_b, name);
        }
        if (!result) {
            PyErr_SetObject(PyExc_NameError, name);
        }
    }
    return result;
}

static void __Pyx_RaiseArgtupleInvalid(
    const char* func_name,
    int exact,
    Py_ssize_t num_min,
    Py_ssize_t num_max,
    Py_ssize_t num_found)
{
    Py_ssize_t num_expected;
    const char *more_or_less;

    if (num_found < num_min) {
        num_expected = num_min;
        more_or_less = "at least";
    } else {
        num_expected = num_max;
        more_or_less = "at most";
    }
    if (exact) {
        more_or_less = "exactly";
    }
    PyErr_Format(PyExc_TypeError,
                 "%s() takes %s %"PY_FORMAT_SIZE_T"d positional argument%s (%"PY_FORMAT_SIZE_T"d given)",
                 func_name, more_or_less, num_expected,
                 (num_expected == 1) ? "" : "s", num_found);
}

static void __Pyx_RaiseDoubleKeywordsError(
    const char* func_name,
    PyObject* kw_name)
{
    PyErr_Format(PyExc_TypeError,
        #if PY_MAJOR_VERSION >= 3
        "%s() got multiple values for keyword argument '%U'", func_name, kw_name);
        #else
        "%s() got multiple values for keyword argument '%s'", func_name,
        PyString_AS_STRING(kw_name));
        #endif
}

static int __Pyx_ParseOptionalKeywords(
    PyObject *kwds,
    PyObject **argnames[],
    PyObject *kwds2,
    PyObject *values[],
    Py_ssize_t num_pos_args,
    const char* function_name)
{
    PyObject *key = 0, *value = 0;
    Py_ssize_t pos = 0;
    PyObject*** name;
    PyObject*** first_kw_arg = argnames + num_pos_args;

    while (PyDict_Next(kwds, &pos, &key, &value)) {
        name = first_kw_arg;
        while (*name && (**name != key)) name++;
        if (*name) {
            values[name-argnames] = value;
        } else {
            #if PY_MAJOR_VERSION < 3
            if (unlikely(!PyString_CheckExact(key)) && unlikely(!PyString_Check(key))) {
            #else
            if (unlikely(!PyUnicode_CheckExact(key)) && unlikely(!PyUnicode_Check(key))) {
            #endif
                goto invalid_keyword_type;
            } else {
                for (name = first_kw_arg; *name; name++) {
                    #if PY_MAJOR_VERSION >= 3
                    if (PyUnicode_GET_SIZE(**name) == PyUnicode_GET_SIZE(key) &&
                        PyUnicode_Compare(**name, key) == 0) break;
                    #else
                    if (PyString_GET_SIZE(**name) == PyString_GET_SIZE(key) &&
                        _PyString_Eq(**name, key)) break;
                    #endif
                }
                if (*name) {
                    values[name-argnames] = value;
                } else {
                    /* unexpected keyword found */
                    for (name=argnames; name != first_kw_arg; name++) {
                        if (**name == key) goto arg_passed_twice;
                        #if PY_MAJOR_VERSION >= 3
                        if (PyUnicode_GET_SIZE(**name) == PyUnicode_GET_SIZE(key) &&
                            PyUnicode_Compare(**name, key) == 0) goto arg_passed_twice;
                        #else
                        if (PyString_GET_SIZE(**name) == PyString_GET_SIZE(key) &&
                            _PyString_Eq(**name, key)) goto arg_passed_twice;
                        #endif
                    }
                    if (kwds2) {
                        if (unlikely(PyDict_SetItem(kwds2, key, value))) goto bad;
                    } else {
                        goto invalid_keyword;
                    }
                }
            }
        }
    }
    return 0;
arg_passed_twice:
    __Pyx_RaiseDoubleKeywordsError(function_name, **name);
    goto bad;
invalid_keyword_type:
    PyErr_Format(PyExc_TypeError,
        "%s() keywords must be strings", function_name);
    goto bad;
invalid_keyword:
    PyErr_Format(PyExc_TypeError,
    #if PY_MAJOR_VERSION < 3
        "%s() got an unexpected keyword argument '%s'",
        function_name, PyString_AsString(key));
    #else
        "%s() got an unexpected keyword argument '%U'",
        function_name, key);
    #endif
bad:
    return -1;
}


static CYTHON_INLINE unsigned char __Pyx_PyInt_AsUnsignedChar(PyObject* x) {
    const unsigned char neg_one = (unsigned char)-1, const_zero = 0;
    const int is_unsigned = neg_one > const_zero;
    if (sizeof(unsigned char) < sizeof(long)) {
        long val = __Pyx_PyInt_AsLong(x);
        if (unlikely(val != (long)(unsigned char)val)) {
            if (!unlikely(val == -1 && PyErr_Occurred())) {
                PyErr_SetString(PyExc_OverflowError,
                    (is_unsigned && unlikely(val < 0)) ?
                    "can't convert negative value to unsigned char" :
                    "value too large to convert to unsigned char");
            }
            return (unsigned char)-1;
        }
        return (unsigned char)val;
    }
    return (unsigned char)__Pyx_PyInt_AsUnsignedLong(x);
}

static CYTHON_INLINE unsigned short __Pyx_PyInt_AsUnsignedShort(PyObject* x) {
    const unsigned short neg_one = (unsigned short)-1, const_zero = 0;
    const int is_unsigned = neg_one > const_zero;
    if (sizeof(unsigned short) < sizeof(long)) {
        long val = __Pyx_PyInt_AsLong(x);
        if (unlikely(val != (long)(unsigned short)val)) {
            if (!unlikely(val == -1 && PyErr_Occurred())) {
                PyErr_SetString(PyExc_OverflowError,
                    (is_unsigned && unlikely(val < 0)) ?
                    "can't convert negative value to unsigned short" :
                    "value too large to convert to unsigned short");
            }
            return (unsigned short)-1;
        }
        return (unsigned short)val;
    }
    return (unsigned short)__Pyx_PyInt_AsUnsignedLong(x);
}

static CYTHON_INLINE unsigned int __Pyx_PyInt_AsUnsignedInt(PyObject* x) {
    const unsigned int neg_one = (unsigned int)-1, const_zero = 0;
    const int is_unsigned = neg_one > const_zero;
    if (sizeof(unsigned int) < sizeof(long)) {
        long val = __Pyx_PyInt_AsLong(x);
        if (unlikely(val != (long)(unsigned int)val)) {
            if (!unlikely(val == -1 && PyErr_Occurred())) {
                PyErr_SetString(PyExc_OverflowError,
                    (is_unsigned && unlikely(val < 0)) ?
                    "can't convert negative value to unsigned int" :
                    "value too large to convert to unsigned int");
            }
            return (unsigned int)-1;
        }
        return (unsigned int)val;
    }
    return (unsigned int)__Pyx_PyInt_AsUnsignedLong(x);
}

static CYTHON_INLINE char __Pyx_PyInt_AsChar(PyObject* x) {
    const char neg_one = (char)-1, const_zero = 0;
    const int is_unsigned = neg_one > const_zero;
    if (sizeof(char) < sizeof(long)) {
        long val = __Pyx_PyInt_AsLong(x);
        if (unlikely(val != (long)(char)val)) {
            if (!unlikely(val == -1 && PyErr_Occurred())) {
                PyErr_SetString(PyExc_OverflowError,
                    (is_unsigned && unlikely(val < 0)) ?
                    "can't convert negative value to char" :
                    "value too large to convert to char");
            }
            return (char)-1;
        }
        return (char)val;
    }
    return (char)__Pyx_PyInt_AsLong(x);
}

static CYTHON_INLINE short __Pyx_PyInt_AsShort(PyObject* x) {
    const short neg_one = (short)-1, const_zero = 0;
    const int is_unsigned = neg_one > const_zero;
    if (sizeof(short) < sizeof(long)) {
        long val = __Pyx_PyInt_AsLong(x);
        if (unlikely(val != (long)(short)val)) {
            if (!unlikely(val == -1 && PyErr_Occurred())) {
                PyErr_SetString(PyExc_OverflowError,
                    (is_unsigned && unlikely(val < 0)) ?
                    "can't convert negative value to short" :
                    "value too large to convert to short");
            }
            return (short)-1;
        }
        return (short)val;
    }
    return (short)__Pyx_PyInt_AsLong(x);
}

static CYTHON_INLINE int __Pyx_PyInt_AsInt(PyObject* x) {
    const int neg_one = (int)-1, const_zero = 0;
    const int is_unsigned = neg_one > const_zero;
    if (sizeof(int) < sizeof(long)) {
        long val = __Pyx_PyInt_AsLong(x);
        if (unlikely(val != (long)(int)val)) {
            if (!unlikely(val == -1 && PyErr_Occurred())) {
                PyErr_SetString(PyExc_OverflowError,
                    (is_unsigned && unlikely(val < 0)) ?
                    "can't convert negative value to int" :
                    "value too large to convert to int");
            }
            return (int)-1;
        }
        return (int)val;
    }
    return (int)__Pyx_PyInt_AsLong(x);
}

static CYTHON_INLINE signed char __Pyx_PyInt_AsSignedChar(PyObject* x) {
    const signed char neg_one = (signed char)-1, const_zero = 0;
    const int is_unsigned = neg_one > const_zero;
    if (sizeof(signed char) < sizeof(long)) {
        long val = __Pyx_PyInt_AsLong(x);
        if (unlikely(val != (long)(signed char)val)) {
            if (!unlikely(val == -1 && PyErr_Occurred())) {
                PyErr_SetString(PyExc_OverflowError,
                    (is_unsigned && unlikely(val < 0)) ?
                    "can't convert negative value to signed char" :
                    "value too large to convert to signed char");
            }
            return (signed char)-1;
        }
        return (signed char)val;
    }
    return (signed char)__Pyx_PyInt_AsSignedLong(x);
}

static CYTHON_INLINE signed short __Pyx_PyInt_AsSignedShort(PyObject* x) {
    const signed short neg_one = (signed short)-1, const_zero = 0;
    const int is_unsigned = neg_one > const_zero;
    if (sizeof(signed short) < sizeof(long)) {
        long val = __Pyx_PyInt_AsLong(x);
        if (unlikely(val != (long)(signed short)val)) {
            if (!unlikely(val == -1 && PyErr_Occurred())) {
                PyErr_SetString(PyExc_OverflowError,
                    (is_unsigned && unlikely(val < 0)) ?
                    "can't convert negative value to signed short" :
                    "value too large to convert to signed short");
            }
            return (signed short)-1;
        }
        return (signed short)val;
    }
    return (signed short)__Pyx_PyInt_AsSignedLong(x);
}

static CYTHON_INLINE signed int __Pyx_PyInt_AsSignedInt(PyObject* x) {
    const signed int neg_one = (signed int)-1, const_zero = 0;
    const int is_unsigned = neg_one > const_zero;
    if (sizeof(signed int) < sizeof(long)) {
        long val = __Pyx_PyInt_AsLong(x);
        if (unlikely(val != (long)(signed int)val)) {
            if (!unlikely(val == -1 && PyErr_Occurred())) {
                PyErr_SetString(PyExc_OverflowError,
                    (is_unsigned && unlikely(val < 0)) ?
                    "can't convert negative value to signed int" :
                    "value too large to convert to signed int");
            }
            return (signed int)-1;
        }
        return (signed int)val;
    }
    return (signed int)__Pyx_PyInt_AsSignedLong(x);
}

static CYTHON_INLINE int __Pyx_PyInt_AsLongDouble(PyObject* x) {
    const int neg_one = (int)-1, const_zero = 0;
    const int is_unsigned = neg_one > const_zero;
    if (sizeof(int) < sizeof(long)) {
        long val = __Pyx_PyInt_AsLong(x);
        if (unlikely(val != (long)(int)val)) {
            if (!unlikely(val == -1 && PyErr_Occurred())) {
                PyErr_SetString(PyExc_OverflowError,
                    (is_unsigned && unlikely(val < 0)) ?
                    "can't convert negative value to int" :
                    "value too large to convert to int");
            }
            return (int)-1;
        }
        return (int)val;
    }
    return (int)__Pyx_PyInt_AsLong(x);
}

static CYTHON_INLINE unsigned long __Pyx_PyInt_AsUnsignedLong(PyObject* x) {
    const unsigned long neg_one = (unsigned long)-1, const_zero = 0;
    const int is_unsigned = neg_one > const_zero;
#if PY_VERSION_HEX < 0x03000000
    if (likely(PyInt_Check(x))) {
        long val = PyInt_AS_LONG(x);
        if (is_unsigned && unlikely(val < 0)) {
            PyErr_SetString(PyExc_OverflowError,
                            "can't convert negative value to unsigned long");
            return (unsigned long)-1;
        }
        return (unsigned long)val;
    } else
#endif
    if (likely(PyLong_Check(x))) {
        if (is_unsigned) {
            if (unlikely(Py_SIZE(x) < 0)) {
                PyErr_SetString(PyExc_OverflowError,
                                "can't convert negative value to unsigned long");
                return (unsigned long)-1;
            }
            return (unsigned long)PyLong_AsUnsignedLong(x);
        } else {
            return (unsigned long)PyLong_AsLong(x);
        }
    } else {
        unsigned long val;
        PyObject *tmp = __Pyx_PyNumber_Int(x);
        if (!tmp) return (unsigned long)-1;
        val = __Pyx_PyInt_AsUnsignedLong(tmp);
        Py_DECREF(tmp);
        return val;
    }
}

static CYTHON_INLINE unsigned PY_LONG_LONG __Pyx_PyInt_AsUnsignedLongLong(PyObject* x) {
    const unsigned PY_LONG_LONG neg_one = (unsigned PY_LONG_LONG)-1, const_zero = 0;
    const int is_unsigned = neg_one > const_zero;
#if PY_VERSION_HEX < 0x03000000
    if (likely(PyInt_Check(x))) {
        long val = PyInt_AS_LONG(x);
        if (is_unsigned && unlikely(val < 0)) {
            PyErr_SetString(PyExc_OverflowError,
                            "can't convert negative value to unsigned PY_LONG_LONG");
            return (unsigned PY_LONG_LONG)-1;
        }
        return (unsigned PY_LONG_LONG)val;
    } else
#endif
    if (likely(PyLong_Check(x))) {
        if (is_unsigned) {
            if (unlikely(Py_SIZE(x) < 0)) {
                PyErr_SetString(PyExc_OverflowError,
                                "can't convert negative value to unsigned PY_LONG_LONG");
                return (unsigned PY_LONG_LONG)-1;
            }
            return (unsigned PY_LONG_LONG)PyLong_AsUnsignedLongLong(x);
        } else {
            return (unsigned PY_LONG_LONG)PyLong_AsLongLong(x);
        }
    } else {
        unsigned PY_LONG_LONG val;
        PyObject *tmp = __Pyx_PyNumber_Int(x);
        if (!tmp) return (unsigned PY_LONG_LONG)-1;
        val = __Pyx_PyInt_AsUnsignedLongLong(tmp);
        Py_DECREF(tmp);
        return val;
    }
}

static CYTHON_INLINE long __Pyx_PyInt_AsLong(PyObject* x) {
    const long neg_one = (long)-1, const_zero = 0;
    const int is_unsigned = neg_one > const_zero;
#if PY_VERSION_HEX < 0x03000000
    if (likely(PyInt_Check(x))) {
        long val = PyInt_AS_LONG(x);
        if (is_unsigned && unlikely(val < 0)) {
            PyErr_SetString(PyExc_OverflowError,
                            "can't convert negative value to long");
            return (long)-1;
        }
        return (long)val;
    } else
#endif
    if (likely(PyLong_Check(x))) {
        if (is_unsigned) {
            if (unlikely(Py_SIZE(x) < 0)) {
                PyErr_SetString(PyExc_OverflowError,
                                "can't convert negative value to long");
                return (long)-1;
            }
            return (long)PyLong_AsUnsignedLong(x);
        } else {
            return (long)PyLong_AsLong(x);
        }
    } else {
        long val;
        PyObject *tmp = __Pyx_PyNumber_Int(x);
        if (!tmp) return (long)-1;
        val = __Pyx_PyInt_AsLong(tmp);
        Py_DECREF(tmp);
        return val;
    }
}

static CYTHON_INLINE PY_LONG_LONG __Pyx_PyInt_AsLongLong(PyObject* x) {
    const PY_LONG_LONG neg_one = (PY_LONG_LONG)-1, const_zero = 0;
    const int is_unsigned = neg_one > const_zero;
#if PY_VERSION_HEX < 0x03000000
    if (likely(PyInt_Check(x))) {
        long val = PyInt_AS_LONG(x);
        if (is_unsigned && unlikely(val < 0)) {
            PyErr_SetString(PyExc_OverflowError,
                            "can't convert negative value to PY_LONG_LONG");
            return (PY_LONG_LONG)-1;
        }
        return (PY_LONG_LONG)val;
    } else
#endif
    if (likely(PyLong_Check(x))) {
        if (is_unsigned) {
            if (unlikely(Py_SIZE(x) < 0)) {
                PyErr_SetString(PyExc_OverflowError,
                                "can't convert negative value to PY_LONG_LONG");
                return (PY_LONG_LONG)-1;
            }
            return (PY_LONG_LONG)PyLong_AsUnsignedLongLong(x);
        } else {
            return (PY_LONG_LONG)PyLong_AsLongLong(x);
        }
    } else {
        PY_LONG_LONG val;
        PyObject *tmp = __Pyx_PyNumber_Int(x);
        if (!tmp) return (PY_LONG_LONG)-1;
        val = __Pyx_PyInt_AsLongLong(tmp);
        Py_DECREF(tmp);
        return val;
    }
}

static CYTHON_INLINE signed long __Pyx_PyInt_AsSignedLong(PyObject* x) {
    const signed long neg_one = (signed long)-1, const_zero = 0;
    const int is_unsigned = neg_one > const_zero;
#if PY_VERSION_HEX < 0x03000000
    if (likely(PyInt_Check(x))) {
        long val = PyInt_AS_LONG(x);
        if (is_unsigned && unlikely(val < 0)) {
            PyErr_SetString(PyExc_OverflowError,
                            "can't convert negative value to signed long");
            return (signed long)-1;
        }
        return (signed long)val;
    } else
#endif
    if (likely(PyLong_Check(x))) {
        if (is_unsigned) {
            if (unlikely(Py_SIZE(x) < 0)) {
                PyErr_SetString(PyExc_OverflowError,
                                "can't convert negative value to signed long");
                return (signed long)-1;
            }
            return (signed long)PyLong_AsUnsignedLong(x);
        } else {
            return (signed long)PyLong_AsLong(x);
        }
    } else {
        signed long val;
        PyObject *tmp = __Pyx_PyNumber_Int(x);
        if (!tmp) return (signed long)-1;
        val = __Pyx_PyInt_AsSignedLong(tmp);
        Py_DECREF(tmp);
        return val;
    }
}

static CYTHON_INLINE signed PY_LONG_LONG __Pyx_PyInt_AsSignedLongLong(PyObject* x) {
    const signed PY_LONG_LONG neg_one = (signed PY_LONG_LONG)-1, const_zero = 0;
    const int is_unsigned = neg_one > const_zero;
#if PY_VERSION_HEX < 0x03000000
    if (likely(PyInt_Check(x))) {
        long val = PyInt_AS_LONG(x);
        if (is_unsigned && unlikely(val < 0)) {
            PyErr_SetString(PyExc_OverflowError,
                            "can't convert negative value to signed PY_LONG_LONG");
            return (signed PY_LONG_LONG)-1;
        }
        return (signed PY_LONG_LONG)val;
    } else
#endif
    if (likely(PyLong_Check(x))) {
        if (is_unsigned) {
            if (unlikely(Py_SIZE(x) < 0)) {
                PyErr_SetString(PyExc_OverflowError,
                                "can't convert negative value to signed PY_LONG_LONG");
                return (signed PY_LONG_LONG)-1;
            }
            return (signed PY_LONG_LONG)PyLong_AsUnsignedLongLong(x);
        } else {
            return (signed PY_LONG_LONG)PyLong_AsLongLong(x);
        }
    } else {
        signed PY_LONG_LONG val;
        PyObject *tmp = __Pyx_PyNumber_Int(x);
        if (!tmp) return (signed PY_LONG_LONG)-1;
        val = __Pyx_PyInt_AsSignedLongLong(tmp);
        Py_DECREF(tmp);
        return val;
    }
}

static int __Pyx_check_binary_version(void) {
    char ctversion[4], rtversion[4];
    PyOS_snprintf(ctversion, 4, "%d.%d", PY_MAJOR_VERSION, PY_MINOR_VERSION);
    PyOS_snprintf(rtversion, 4, "%s", Py_GetVersion());
    if (ctversion[0] != rtversion[0] || ctversion[2] != rtversion[2]) {
        char message[200];
        PyOS_snprintf(message, sizeof(message),
                      "compiletime version %s of module '%.100s' "
                      "does not match runtime version %s",
                      ctversion, __Pyx_MODULE_NAME, rtversion);
        #if PY_VERSION_HEX < 0x02050000
        return PyErr_Warn(NULL, message);
        #else
        return PyErr_WarnEx(NULL, message, 1);
        #endif
    }
    return 0;
}

#include "compile.h"
#include "frameobject.h"
#include "traceback.h"

static void __Pyx_AddTraceback(const char *funcname, int __pyx_clineno,
                               int __pyx_lineno, const char *__pyx_filename) {
    PyObject *py_srcfile = 0;
    PyObject *py_funcname = 0;
    PyObject *py_globals = 0;
    PyCodeObject *py_code = 0;
    PyFrameObject *py_frame = 0;

    #if PY_MAJOR_VERSION < 3
    py_srcfile = PyString_FromString(__pyx_filename);
    #else
    py_srcfile = PyUnicode_FromString(__pyx_filename);
    #endif
    if (!py_srcfile) goto bad;
    if (__pyx_clineno) {
        #if PY_MAJOR_VERSION < 3
        py_funcname = PyString_FromFormat( "%s (%s:%d)", funcname, __pyx_cfilenm, __pyx_clineno);
        #else
        py_funcname = PyUnicode_FromFormat( "%s (%s:%d)", funcname, __pyx_cfilenm, __pyx_clineno);
        #endif
    }
    else {
        #if PY_MAJOR_VERSION < 3
        py_funcname = PyString_FromString(funcname);
        #else
        py_funcname = PyUnicode_FromString(funcname);
        #endif
    }
    if (!py_funcname) goto bad;
    py_globals = PyModule_GetDict(__pyx_m);
    if (!py_globals) goto bad;
    py_code = PyCode_New(
        0,            /*int argcount,*/
        #if PY_MAJOR_VERSION >= 3
        0,            /*int kwonlyargcount,*/
        #endif
        0,            /*int nlocals,*/
        0,            /*int stacksize,*/
        0,            /*int flags,*/
        __pyx_empty_bytes, /*PyObject *code,*/
        __pyx_empty_tuple,  /*PyObject *consts,*/
        __pyx_empty_tuple,  /*PyObject *names,*/
        __pyx_empty_tuple,  /*PyObject *varnames,*/
        __pyx_empty_tuple,  /*PyObject *freevars,*/
        __pyx_empty_tuple,  /*PyObject *cellvars,*/
        py_srcfile,   /*PyObject *filename,*/
        py_funcname,  /*PyObject *name,*/
        __pyx_lineno,   /*int firstlineno,*/
        __pyx_empty_bytes  /*PyObject *lnotab*/
    );
    if (!py_code) goto bad;
    py_frame = PyFrame_New(
        PyThreadState_GET(), /*PyThreadState *tstate,*/
        py_code,             /*PyCodeObject *code,*/
        py_globals,          /*PyObject *globals,*/
        0                    /*PyObject *locals*/
    );
    if (!py_frame) goto bad;
    py_frame->f_lineno = __pyx_lineno;
    PyTraceBack_Here(py_frame);
bad:
    Py_XDECREF(py_srcfile);
    Py_XDECREF(py_funcname);
    Py_XDECREF(py_code);
    Py_XDECREF(py_frame);
}

static int __Pyx_InitStrings(__Pyx_StringTabEntry *t) {
    while (t->p) {
        #if PY_MAJOR_VERSION < 3
        if (t->is_unicode) {
            *t->p = PyUnicode_DecodeUTF8(t->s, t->n - 1, NULL);
        } else if (t->intern) {
            *t->p = PyString_InternFromString(t->s);
        } else {
            *t->p = PyString_FromStringAndSize(t->s, t->n - 1);
        }
        #else  /* Python 3+ has unicode identifiers */
        if (t->is_unicode | t->is_str) {
            if (t->intern) {
                *t->p = PyUnicode_InternFromString(t->s);
            } else if (t->encoding) {
                *t->p = PyUnicode_Decode(t->s, t->n - 1, t->encoding, NULL);
            } else {
                *t->p = PyUnicode_FromStringAndSize(t->s, t->n - 1);
            }
        } else {
            *t->p = PyBytes_FromStringAndSize(t->s, t->n - 1);
        }
        #endif
        if (!*t->p)
            return -1;
        ++t;
    }
    return 0;
}

/* Type Conversion Functions */

static CYTHON_INLINE int __Pyx_PyObject_IsTrue(PyObject* x) {
   int is_true = x == Py_True;
   if (is_true | (x == Py_False) | (x == Py_None)) return is_true;
   else return PyObject_IsTrue(x);
}

static CYTHON_INLINE PyObject* __Pyx_PyNumber_Int(PyObject* x) {
  PyNumberMethods *m;
  const char *name = NULL;
  PyObject *res = NULL;
#if PY_VERSION_HEX < 0x03000000
  if (PyInt_Check(x) || PyLong_Check(x))
#else
  if (PyLong_Check(x))
#endif
    return Py_INCREF(x), x;
  m = Py_TYPE(x)->tp_as_number;
#if PY_VERSION_HEX < 0x03000000
  if (m && m->nb_int) {
    name = "int";
    res = PyNumber_Int(x);
  }
  else if (m && m->nb_long) {
    name = "long";
    res = PyNumber_Long(x);
  }
#else
  if (m && m->nb_int) {
    name = "int";
    res = PyNumber_Long(x);
  }
#endif
  if (res) {
#if PY_VERSION_HEX < 0x03000000
    if (!PyInt_Check(res) && !PyLong_Check(res)) {
#else
    if (!PyLong_Check(res)) {
#endif
      PyErr_Format(PyExc_TypeError,
                   "__%s__ returned non-%s (type %.200s)",
                   name, name, Py_TYPE(res)->tp_name);
      Py_DECREF(res);
      return NULL;
    }
  }
  else if (!PyErr_Occurred()) {
    PyErr_SetString(PyExc_TypeError,
                    "an integer is required");
  }
  return res;
}

static CYTHON_INLINE Py_ssize_t __Pyx_PyIndex_AsSsize_t(PyObject* b) {
  Py_ssize_t ival;
  PyObject* x = PyNumber_Index(b);
  if (!x) return -1;
  ival = PyInt_AsSsize_t(x);
  Py_DECREF(x);
  return ival;
}

static CYTHON_INLINE PyObject * __Pyx_PyInt_FromSize_t(size_t ival) {
#if PY_VERSION_HEX < 0x02050000
   if (ival <= LONG_MAX)
       return PyInt_FromLong((long)ival);
   else {
       unsigned char *bytes = (unsigned char *) &ival;
       int one = 1; int little = (int)*(unsigned char*)&one;
       return _PyLong_FromByteArray(bytes, sizeof(size_t), little, 0);
   }
#else
   return PyInt_FromSize_t(ival);
#endif
}

static CYTHON_INLINE size_t __Pyx_PyInt_AsSize_t(PyObject* x) {
   unsigned PY_LONG_LONG val = __Pyx_PyInt_AsUnsignedLongLong(x);
   if (unlikely(val == (unsigned PY_LONG_LONG)-1 && PyErr_Occurred())) {
       return (size_t)-1;
   } else if (unlikely(val != (unsigned PY_LONG_LONG)(size_t)val)) {
       PyErr_SetString(PyExc_OverflowError,
                       "value too large to convert to size_t");
       return (size_t)-1;
   }
   return (size_t)val;
}


#endif /* Py_PYTHON_H */
